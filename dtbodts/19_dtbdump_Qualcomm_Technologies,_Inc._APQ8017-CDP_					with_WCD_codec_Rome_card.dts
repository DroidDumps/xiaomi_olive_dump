/dts-v1/;

/ {
	model = "Qualcomm Technologies, Inc. APQ8017-CDP \t\t\t\t\twith WCD codec/Rome card";
	qcom,board-id = <0x01 0x02>;
	qcom,msm-id = <0x133 0x00>;

	__fixups__ {
		adsp_fw_mem = "/fragment@40:target:0";
		blsp1_uart1 = "/fragment@37:target:0";
		blsp1_uart2 = "/fragment@2:target:0";
		cam_sensor_front1_default = "/fragment@0/__overlay__/qcom,eeprom@1:pinctrl-0:4\0/fragment@0/__overlay__/qcom,camera@2:pinctrl-0:4";
		cam_sensor_front1_sleep = "/fragment@0/__overlay__/qcom,eeprom@1:pinctrl-1:4\0/fragment@0/__overlay__/qcom,camera@2:pinctrl-1:4";
		cam_sensor_front_default = "/fragment@0/__overlay__/qcom,camera@1:pinctrl-0:4";
		cam_sensor_front_sleep = "/fragment@0/__overlay__/qcom,camera@1:pinctrl-1:4";
		cam_sensor_mclk0_default = "/fragment@0/__overlay__/qcom,eeprom@0:pinctrl-0:0\0/fragment@0/__overlay__/qcom,camera@0:pinctrl-0:0";
		cam_sensor_mclk0_sleep = "/fragment@0/__overlay__/qcom,eeprom@0:pinctrl-1:0\0/fragment@0/__overlay__/qcom,camera@0:pinctrl-1:0";
		cam_sensor_mclk1_default = "/fragment@0/__overlay__/qcom,camera@1:pinctrl-0:0";
		cam_sensor_mclk1_sleep = "/fragment@0/__overlay__/qcom,camera@1:pinctrl-1:0";
		cam_sensor_mclk2_default = "/fragment@0/__overlay__/qcom,eeprom@1:pinctrl-0:0\0/fragment@0/__overlay__/qcom,camera@2:pinctrl-0:0";
		cam_sensor_mclk2_sleep = "/fragment@0/__overlay__/qcom,eeprom@1:pinctrl-1:0\0/fragment@0/__overlay__/qcom,camera@2:pinctrl-1:0";
		cam_sensor_rear_default = "/fragment@0/__overlay__/qcom,eeprom@0:pinctrl-0:4\0/fragment@0/__overlay__/qcom,camera@0:pinctrl-0:4";
		cam_sensor_rear_sleep = "/fragment@0/__overlay__/qcom,eeprom@0:pinctrl-1:4\0/fragment@0/__overlay__/qcom,camera@0:pinctrl-1:4";
		cam_sensor_rear_vdig = "/fragment@0/__overlay__/qcom,camera@0:pinctrl-0:8";
		cam_sensor_rear_vdig_sleep = "/fragment@0/__overlay__/qcom,camera@0:pinctrl-1:8";
		cci = "/fragment@0:target:0";
		clock_gcc = "/fragment@0/__overlay__/qcom,eeprom@0:clocks:0\0/fragment@0/__overlay__/qcom,eeprom@0:clocks:8\0/fragment@0/__overlay__/qcom,eeprom@1:clocks:0\0/fragment@0/__overlay__/qcom,eeprom@1:clocks:8\0/fragment@0/__overlay__/qcom,camera@0:clocks:0\0/fragment@0/__overlay__/qcom,camera@0:clocks:8\0/fragment@0/__overlay__/qcom,camera@1:clocks:0\0/fragment@0/__overlay__/qcom,camera@1:clocks:8\0/fragment@0/__overlay__/qcom,camera@2:clocks:0\0/fragment@0/__overlay__/qcom,camera@2:clocks:8\0/fragment@32/__overlay__/nq@28:clocks:0";
		i2c_5 = "/fragment@32:target:0";
		intc = "/fragment@34/__overlay__:interrupt-map:4\0/fragment@34/__overlay__:interrupt-map:24\0/fragment@38/__overlay__:interrupt-map:4\0/fragment@38/__overlay__:interrupt-map:24";
		led_flash0 = "/fragment@0/__overlay__/qcom,camera@0:qcom,led-flash-src:0";
		mdss_dsi = "/fragment@28:target:0";
		mdss_dsi0 = "/fragment@11/__overlay__/qcom,mdss_dsi_hx8394f_720p_video:qcom,mdss-dsi-panel-controller:0\0/fragment@12/__overlay__/qcom,mdss_dsi_adv7533_1080p:qcom,mdss-dsi-panel-controller:0\0/fragment@13/__overlay__/qcom,mdss_dsi_adv7533_720p:qcom,mdss-dsi-panel-controller:0\0/fragment@18/__overlay__/qcom,mdss_dsi_icn9706_720_1440p_video:qcom,mdss-dsi-panel-controller:0\0/fragment@19/__overlay__/qcom,mdss_dsi_ili9881c_hdplus_video:qcom,mdss-dsi-panel-controller:0\0/fragment@20/__overlay__/qcom,mdss_dsi_ili9881c_hdplus_video_c3e:qcom,mdss-dsi-panel-controller:0\0/fragment@21/__overlay__/qcom,mdss_dsi_ili9881d_hdplus_video_c3e:qcom,mdss-dsi-panel-controller:0\0/fragment@22/__overlay__/qcom,mdss_dsi_jd9365z_hdplus_video_c3e:qcom,mdss-dsi-panel-controller:0\0/fragment@23/__overlay__/qcom,mdss_dsi_ili9881h_hdplus_video_c3i:qcom,mdss-dsi-panel-controller:0\0/fragment@24/__overlay__/qcom,mdss_dsi_nvt36525b_hdplus_video_c3i:qcom,mdss-dsi-panel-controller:0\0/fragment@25/__overlay__/qcom,mdss_dsi_ft8006s_hdplus_video_c3i:qcom,mdss-dsi-panel-controller:0\0/fragment@29:target:0";
		mdss_dsi_active = "/fragment@29/__overlay__:pinctrl-0:0";
		mdss_dsi_suspend = "/fragment@29/__overlay__:pinctrl-1:0";
		mdss_mdp = "/fragment@3:target:0\0/fragment@4:target:0\0/fragment@5:target:0\0/fragment@6:target:0\0/fragment@7:target:0\0/fragment@8:target:0\0/fragment@9:target:0\0/fragment@10:target:0\0/fragment@11:target:0\0/fragment@12:target:0\0/fragment@13:target:0\0/fragment@14:target:0\0/fragment@15:target:0\0/fragment@16:target:0\0/fragment@17:target:0\0/fragment@18:target:0\0/fragment@19:target:0\0/fragment@20:target:0\0/fragment@21:target:0\0/fragment@22:target:0\0/fragment@23:target:0\0/fragment@24:target:0\0/fragment@25:target:0\0/fragment@27:target:0";
		mdss_te_active = "/fragment@29/__overlay__:pinctrl-0:4";
		mdss_te_suspend = "/fragment@29/__overlay__:pinctrl-1:4";
		modem_mem = "/fragment@39:target:0";
		nfc_disable_active = "/fragment@32/__overlay__/nq@28:pinctrl-0:4";
		nfc_disable_suspend = "/fragment@32/__overlay__/nq@28:pinctrl-1:4";
		nfc_int_active = "/fragment@32/__overlay__/nq@28:pinctrl-0:0";
		nfc_int_suspend = "/fragment@32/__overlay__/nq@28:pinctrl-1:0";
		pm8937_gpios = "/fragment@31:target:0\0/fragment@32/__overlay__/nq@28:qcom,nq-clkreq:0\0/fragment@36:target:0";
		pm8937_l10 = "/fragment@1/__overlay__/hbtp:vcc_ana-supply:0";
		pm8937_l11 = "/fragment@34/__overlay__:vdd-supply:0";
		pm8937_l12 = "/fragment@34/__overlay__:vdd-io-supply:0";
		pm8937_l17 = "/fragment@0/__overlay__/qcom,actuator@0:cam_vaf-supply:0\0/fragment@0/__overlay__/qcom,actuator@1:cam_vaf-supply:0\0/fragment@0/__overlay__/qcom,eeprom@0:cam_vaf-supply:0\0/fragment@0/__overlay__/qcom,eeprom@1:cam_vaf-supply:0\0/fragment@0/__overlay__/qcom,camera@0:cam_vaf-supply:0\0/fragment@0/__overlay__/qcom,camera@1:cam_vaf-supply:0\0/fragment@0/__overlay__/qcom,camera@2:cam_vaf-supply:0";
		pm8937_l22 = "/fragment@0/__overlay__/qcom,eeprom@0:cam_vana-supply:0\0/fragment@0/__overlay__/qcom,eeprom@1:cam_vana-supply:0\0/fragment@0/__overlay__/qcom,camera@0:cam_vana-supply:0\0/fragment@0/__overlay__/qcom,camera@1:cam_vana-supply:0\0/fragment@0/__overlay__/qcom,camera@2:cam_vana-supply:0";
		pm8937_l23 = "/fragment@0/__overlay__/qcom,eeprom@0:cam_vdig-supply:0\0/fragment@0/__overlay__/qcom,eeprom@1:cam_vdig-supply:0\0/fragment@0/__overlay__/qcom,camera@1:cam_vdig-supply:0\0/fragment@0/__overlay__/qcom,camera@2:cam_vdig-supply:0";
		pm8937_l5 = "/fragment@1/__overlay__/hbtp:vcc_dig-supply:0\0/fragment@33/__overlay__:vdd-io-supply:0\0/fragment@38/__overlay__:vdd-io-supply:0";
		pm8937_l6 = "/fragment@0/__overlay__/qcom,eeprom@0:cam_vio-supply:0\0/fragment@0/__overlay__/qcom,eeprom@1:cam_vio-supply:0\0/fragment@0/__overlay__/qcom,camera@0:cam_vio-supply:0\0/fragment@0/__overlay__/qcom,camera@1:cam_vio-supply:0\0/fragment@0/__overlay__/qcom,camera@2:cam_vio-supply:0";
		pm8937_l8 = "/fragment@33/__overlay__:vdd-supply:0";
		sdc1_clk_off = "/fragment@33/__overlay__:pinctrl-1:0";
		sdc1_clk_on = "/fragment@33/__overlay__:pinctrl-0:0";
		sdc1_cmd_off = "/fragment@33/__overlay__:pinctrl-1:4";
		sdc1_cmd_on = "/fragment@33/__overlay__:pinctrl-0:4";
		sdc1_data_off = "/fragment@33/__overlay__:pinctrl-1:8";
		sdc1_data_on = "/fragment@33/__overlay__:pinctrl-0:8";
		sdc1_rclk_off = "/fragment@33/__overlay__:pinctrl-1:12";
		sdc1_rclk_on = "/fragment@33/__overlay__:pinctrl-0:12";
		sdc2_cd_on = "/fragment@34/__overlay__:pinctrl-0:12";
		sdc2_clk_off = "/fragment@34/__overlay__:pinctrl-1:0\0/fragment@38/__overlay__:pinctrl-1:0";
		sdc2_clk_on = "/fragment@34/__overlay__:pinctrl-0:0\0/fragment@38/__overlay__:pinctrl-0:0";
		sdc2_cmd_off = "/fragment@34/__overlay__:pinctrl-1:4\0/fragment@38/__overlay__:pinctrl-1:4";
		sdc2_cmd_on = "/fragment@34/__overlay__:pinctrl-0:4\0/fragment@38/__overlay__:pinctrl-0:4";
		sdc2_data_off = "/fragment@34/__overlay__:pinctrl-1:8\0/fragment@38/__overlay__:pinctrl-1:8";
		sdc2_data_on = "/fragment@34/__overlay__:pinctrl-0:8\0/fragment@38/__overlay__:pinctrl-0:8";
		sdc2_wlan_gpio_active = "/fragment@38/__overlay__:pinctrl-0:12";
		sdc2_wlan_gpio_sleep = "/fragment@38/__overlay__:pinctrl-1:12";
		sdhc_1 = "/fragment@33:target:0";
		sdhc_2 = "/fragment@34:target:0\0/fragment@34/__overlay__:interrupt-parent:0\0/fragment@38:target:0\0/fragment@38/__overlay__:interrupt-parent:0";
		secure_mem = "/fragment@42:target:0";
		soc = "/fragment@1:target:0\0/fragment@26:target:0\0/fragment@35:target:0";
		tlmm = "/fragment@0/__overlay__/qcom,eeprom@0:gpios:0\0/fragment@0/__overlay__/qcom,eeprom@0:gpios:12\0/fragment@0/__overlay__/qcom,eeprom@0:gpios:24\0/fragment@0/__overlay__/qcom,eeprom@1:gpios:0\0/fragment@0/__overlay__/qcom,eeprom@1:gpios:12\0/fragment@0/__overlay__/qcom,eeprom@1:gpios:24\0/fragment@0/__overlay__/qcom,camera@0:gpios:0\0/fragment@0/__overlay__/qcom,camera@0:gpios:12\0/fragment@0/__overlay__/qcom,camera@0:gpios:24\0/fragment@0/__overlay__/qcom,camera@0:gpios:36\0/fragment@0/__overlay__/qcom,camera@1:gpios:0\0/fragment@0/__overlay__/qcom,camera@1:gpios:12\0/fragment@0/__overlay__/qcom,camera@1:gpios:24\0/fragment@0/__overlay__/qcom,camera@2:gpios:0\0/fragment@0/__overlay__/qcom,camera@2:gpios:12\0/fragment@0/__overlay__/qcom,camera@2:gpios:24\0/fragment@1/__overlay__/gpio_keys/camera_focus:gpios:0\0/fragment@1/__overlay__/gpio_keys/camera_snapshot:gpios:0\0/fragment@1/__overlay__/gpio_keys/vol_up:gpios:0\0/fragment@1/__overlay__/gpio_keys/home:gpios:0\0/fragment@1/__overlay__/usb_detect:interrupt-parent:0\0/fragment@1/__overlay__/usb_detect:qcom,gpio-mode-sel:0\0/fragment@29/__overlay__:qcom,platform-te-gpio:0\0/fragment@29/__overlay__:qcom,platform-reset-gpio:0\0/fragment@29/__overlay__:qcom,platform-bklight-en-gpio:0\0/fragment@30:target:0\0/fragment@32/__overlay__/nq@28:qcom,nq-irq:0\0/fragment@32/__overlay__/nq@28:qcom,nq-ven:0\0/fragment@32/__overlay__/nq@28:qcom,nq-firm:0\0/fragment@32/__overlay__/nq@28:interrupt-parent:0\0/fragment@34/__overlay__:interrupt-map:44\0/fragment@34/__overlay__:cd-gpios:0\0/fragment@35/__overlay__/qcom,cnss_sdio:qcom,cap-tsf-gpio:0\0/fragment@38/__overlay__:interrupt-map:44";
		uart_console_active = "/fragment@2/__overlay__:pinctrl-0:0";
		usb_mode_select = "/fragment@1/__overlay__/usb_detect:pinctrl-0:0";
		wcnss_fw_mem = "/fragment@41:target:0";
	};

	__local_fixups__ {

		fragment@0 {

			__overlay__ {

				qcom,camera@0 {
					qcom,actuator-src = <0x00>;
					qcom,eeprom-src = <0x00>;
				};

				qcom,camera@2 {
					qcom,actuator-src = <0x00>;
					qcom,eeprom-src = <0x00>;
				};
			};
		};

		fragment@1 {

			__overlay__ {

				gpio_keys {
					pinctrl-0 = <0x00>;
				};
			};
		};

		fragment@18 {

			__overlay__ {

				qcom,mdss_dsi_icn9706_720_1440p_video {
					qcom,panel-supply-entries = <0x00>;
				};
			};
		};

		fragment@19 {

			__overlay__ {

				qcom,mdss_dsi_ili9881c_hdplus_video {
					qcom,panel-supply-entries = <0x00>;
				};
			};
		};

		fragment@20 {

			__overlay__ {

				qcom,mdss_dsi_ili9881c_hdplus_video_c3e {
					qcom,panel-supply-entries = <0x00>;
				};
			};
		};

		fragment@21 {

			__overlay__ {

				qcom,mdss_dsi_ili9881d_hdplus_video_c3e {
					qcom,panel-supply-entries = <0x00>;
				};
			};
		};

		fragment@22 {

			__overlay__ {

				qcom,mdss_dsi_jd9365z_hdplus_video_c3e {
					qcom,panel-supply-entries = <0x00>;
				};
			};
		};

		fragment@23 {

			__overlay__ {

				qcom,mdss_dsi_ili9881h_hdplus_video_c3i {
					qcom,panel-supply-entries = <0x00>;
				};
			};
		};

		fragment@24 {

			__overlay__ {

				qcom,mdss_dsi_nvt36525b_hdplus_video_c3i {
					qcom,panel-supply-entries = <0x00>;
				};
			};
		};

		fragment@25 {

			__overlay__ {

				qcom,mdss_dsi_ft8006s_hdplus_video_c3i {
					qcom,panel-supply-entries = <0x00>;
				};
			};
		};

		fragment@29 {

			__overlay__ {
				qcom,dsi-pref-prim-pan = <0x00>;
			};
		};

		fragment@32 {

			__overlay__ {

				nq@28 {
					pinctrl-0 = <0x08>;
				};
			};
		};

		fragment@7 {

			__overlay__ {

				qcom,mdss_dsi_truly_720p_video {
					qcom,panel-supply-entries = <0x00>;
				};
			};
		};

		fragment@8 {

			__overlay__ {

				qcom,mdss_dsi_truly_720p_cmd {
					qcom,panel-supply-entries = <0x00>;
				};
			};
		};
	};

	__symbols__ {
		actuator0 = "/fragment@0/__overlay__/qcom,actuator@0";
		actuator1 = "/fragment@0/__overlay__/qcom,actuator@1";
		dsi_adv7533_1080p = "/fragment@12/__overlay__/qcom,mdss_dsi_adv7533_1080p";
		dsi_adv7533_720p = "/fragment@13/__overlay__/qcom,mdss_dsi_adv7533_720p";
		dsi_ft8006s_hdplus_c3i_video = "/fragment@25/__overlay__/qcom,mdss_dsi_ft8006s_hdplus_video_c3i";
		dsi_hx8394f_720p_video = "/fragment@11/__overlay__/qcom,mdss_dsi_hx8394f_720p_video";
		dsi_hx8399c_hd_vid = "/fragment@15/__overlay__/qcom,mdss_dsi_hx8399c_hd_video";
		dsi_hx8399c_truly_vid = "/fragment@14/__overlay__/qcom,mdss_dsi_hx8399c_truly_video";
		dsi_icn9706_720_1440_vid = "/fragment@18/__overlay__/qcom,mdss_dsi_icn9706_720_1440p_video";
		dsi_ili9881c_hdplus_c3e_video = "/fragment@20/__overlay__/qcom,mdss_dsi_ili9881c_hdplus_video_c3e";
		dsi_ili9881c_hdplus_video = "/fragment@19/__overlay__/qcom,mdss_dsi_ili9881c_hdplus_video";
		dsi_ili9881d_hdplus_c3e_video = "/fragment@21/__overlay__/qcom,mdss_dsi_ili9881d_hdplus_video_c3e";
		dsi_ili9881h_hdplus_c3i_video = "/fragment@23/__overlay__/qcom,mdss_dsi_ili9881h_hdplus_video_c3i";
		dsi_jd9365z_hdplus_c3e_video = "/fragment@22/__overlay__/qcom,mdss_dsi_jd9365z_hdplus_video_c3e";
		dsi_nt35695b_truly_fhd_cmd = "/fragment@17/__overlay__/qcom,mdss_dsi_nt35695b_truly_fhd_cmd";
		dsi_nt35695b_truly_fhd_video = "/fragment@16/__overlay__/qcom,mdss_dsi_nt35695b_truly_fhd_video";
		dsi_nvt36525b_hdplus_c3i_video = "/fragment@24/__overlay__/qcom,mdss_dsi_nvt36525b_hdplus_video_c3i";
		dsi_panel_pwr_supply = "/fragment@26/__overlay__/dsi_panel_pwr_supply";
		dsi_pm660_panel_pwr_supply = "/fragment@26/__overlay__/dsi_pm660_panel_pwr_supply";
		dsi_r69006_1080p_cmd = "/fragment@9/__overlay__/qcom,mdss_dsi_r69006_1080p_cmd";
		dsi_r69006_1080p_video = "/fragment@10/__overlay__/qcom,mdss_dsi_r69006_1080p_video";
		dsi_sim_cmd = "/fragment@4/__overlay__/qcom,mdss_dsi_sim_cmd";
		dsi_sim_vid = "/fragment@3/__overlay__/qcom,mdss_dsi_sim_video";
		dsi_truly_1080_cmd = "/fragment@6/__overlay__/qcom,mdss_dsi_truly_1080p_cmd";
		dsi_truly_1080_vid = "/fragment@5/__overlay__/qcom,mdss_dsi_truly_1080p_video";
		dsi_truly_720_cmd = "/fragment@8/__overlay__/qcom,mdss_dsi_truly_720p_cmd";
		dsi_truly_720_vid = "/fragment@7/__overlay__/qcom,mdss_dsi_truly_720p_video";
		eeprom0 = "/fragment@0/__overlay__/qcom,eeprom@0";
		eeprom1 = "/fragment@0/__overlay__/qcom,eeprom@1";
		gpio_key_active = "/fragment@30/__overlay__/tlmm_gpio_key/gpio_key_active";
		gpio_key_suspend = "/fragment@30/__overlay__/tlmm_gpio_key/gpio_key_suspend";
		nfc_clk_default = "/fragment@31/__overlay__/nfc_clk/nfc_clk_default";
	};

	fragment@0 {
		target = <0xffffffff>;

		__overlay__ {
			#address-cells = <0x01>;
			#size-cells = <0x00>;

			qcom,actuator@0 {
				cam_vaf-supply = <0xffffffff>;
				cell-index = <0x00>;
				compatible = "qcom,actuator";
				phandle = <0x02>;
				qcom,cam-vreg-max-voltage = <0x2b7cd0>;
				qcom,cam-vreg-min-voltage = <0x2b7cd0>;
				qcom,cam-vreg-name = "cam_vaf";
				qcom,cam-vreg-op-mode = <0x13880>;
				qcom,cci-master = <0x00>;
				reg = <0x00>;
			};

			qcom,actuator@1 {
				cam_vaf-supply = <0xffffffff>;
				cell-index = <0x01>;
				compatible = "qcom,actuator";
				phandle = <0x04>;
				qcom,cam-vreg-max-voltage = <0x2b7cd0>;
				qcom,cam-vreg-min-voltage = <0x2b7cd0>;
				qcom,cam-vreg-name = "cam_vaf";
				qcom,cam-vreg-op-mode = <0x13880>;
				qcom,cci-master = <0x00>;
				reg = <0x01>;
			};

			qcom,camera@0 {
				cam_vaf-supply = <0xffffffff>;
				cam_vana-supply = <0xffffffff>;
				cam_vio-supply = <0xffffffff>;
				cell-index = <0x00>;
				clock-names = "cam_src_clk\0cam_clk";
				clocks = <0xffffffff 0x266b3853 0xffffffff 0x80902deb>;
				compatible = "qcom,camera";
				gpios = <0xffffffff 0x1a 0x00 0xffffffff 0x24 0x00 0xffffffff 0x23 0x00 0xffffffff 0x3e 0x00>;
				pinctrl-0 = <0xffffffff 0xffffffff 0xffffffff>;
				pinctrl-1 = <0xffffffff 0xffffffff 0xffffffff>;
				pinctrl-names = "cam_default\0cam_suspend";
				qcom,actuator-src = <0x02>;
				qcom,cam-vreg-max-voltage = <0x00 0x2ab980 0x2b7cd0>;
				qcom,cam-vreg-min-voltage = <0x00 0x2ab980 0x2b7cd0>;
				qcom,cam-vreg-name = "cam_vio\0cam_vana\0cam_vaf";
				qcom,cam-vreg-op-mode = <0x00 0x13880 0x186a0>;
				qcom,cci-master = <0x00>;
				qcom,clock-rates = <0x16e3600 0x00>;
				qcom,csid-sd-index = <0x00>;
				qcom,csiphy-sd-index = <0x00>;
				qcom,eeprom-src = <0x01>;
				qcom,gpio-req-tbl-flags = <0x01 0x00 0x00 0x00>;
				qcom,gpio-req-tbl-label = "CAMIF_MCLK0\0CAM_RESET0\0CAM_STANDBY0\0CAM_VDIG";
				qcom,gpio-req-tbl-num = <0x00 0x01 0x02 0x03>;
				qcom,gpio-reset = <0x01>;
				qcom,gpio-standby = <0x02>;
				qcom,gpio-vdig = <0x03>;
				qcom,led-flash-src = <0xffffffff>;
				qcom,mount-angle = <0x10e>;
				qcom,sensor-mode = <0x00>;
				qcom,sensor-position = <0x00>;
				reg = <0x00>;
				status = "ok";
			};

			qcom,camera@1 {
				cam_vaf-supply = <0xffffffff>;
				cam_vana-supply = <0xffffffff>;
				cam_vdig-supply = <0xffffffff>;
				cam_vio-supply = <0xffffffff>;
				cell-index = <0x01>;
				clock-names = "cam_src_clk\0cam_clk";
				clocks = <0xffffffff 0xa73cad0c 0xffffffff 0x5002d85f>;
				compatible = "qcom,camera";
				gpios = <0xffffffff 0x1b 0x00 0xffffffff 0x26 0x00 0xffffffff 0x32 0x00>;
				pinctrl-0 = <0xffffffff 0xffffffff>;
				pinctrl-1 = <0xffffffff 0xffffffff>;
				pinctrl-names = "cam_default\0cam_suspend";
				qcom,cam-vreg-max-voltage = <0x124f80 0x00 0x2ab980 0x2b7cd0>;
				qcom,cam-vreg-min-voltage = <0x124f80 0x00 0x2ab980 0x2b7cd0>;
				qcom,cam-vreg-name = "cam_vdig\0cam_vio\0cam_vana\0cam_vaf";
				qcom,cam-vreg-op-mode = <0x30d40 0x00 0x13880 0x186a0>;
				qcom,cci-master = <0x01>;
				qcom,clock-rates = <0x16e3600 0x00>;
				qcom,csid-sd-index = <0x01>;
				qcom,csiphy-sd-index = <0x01>;
				qcom,gpio-req-tbl-flags = <0x01 0x00 0x00>;
				qcom,gpio-req-tbl-label = "CAMIF_MCLK1\0CAM_RESET1\0CAM_STANDBY1";
				qcom,gpio-req-tbl-num = <0x00 0x01 0x02>;
				qcom,gpio-reset = <0x01>;
				qcom,gpio-standby = <0x02>;
				qcom,mount-angle = <0x5a>;
				qcom,sensor-mode = <0x01>;
				qcom,sensor-position = <0x100>;
				reg = <0x01>;
			};

			qcom,camera@2 {
				cam_vaf-supply = <0xffffffff>;
				cam_vana-supply = <0xffffffff>;
				cam_vdig-supply = <0xffffffff>;
				cam_vio-supply = <0xffffffff>;
				cell-index = <0x02>;
				clock-names = "cam_src_clk\0cam_clk";
				clocks = <0xffffffff 0x42545468 0xffffffff 0x222f8fff>;
				compatible = "qcom,camera";
				gpios = <0xffffffff 0x1c 0x00 0xffffffff 0x28 0x00 0xffffffff 0x27 0x00>;
				pinctrl-0 = <0xffffffff 0xffffffff>;
				pinctrl-1 = <0xffffffff 0xffffffff>;
				pinctrl-names = "cam_default\0cam_suspend";
				qcom,actuator-src = <0x04>;
				qcom,cam-vreg-max-voltage = <0x124f80 0x00 0x2ab980 0x2b7cd0>;
				qcom,cam-vreg-min-voltage = <0x124f80 0x00 0x2ab980 0x2b7cd0>;
				qcom,cam-vreg-name = "cam_vdig\0cam_vio\0cam_vana\0cam_vaf";
				qcom,cam-vreg-op-mode = <0x19a28 0x00 0x13880 0x186a0>;
				qcom,cci-master = <0x00>;
				qcom,clock-rates = <0x16e3600 0x00>;
				qcom,csid-sd-index = <0x01>;
				qcom,csiphy-sd-index = <0x01>;
				qcom,eeprom-src = <0x03>;
				qcom,gpio-no-mux = <0x00>;
				qcom,gpio-req-tbl-flags = <0x01 0x00 0x00>;
				qcom,gpio-req-tbl-label = "CAMIF_MCLK2\0CAM_RESET2\0CAM_STANDBY2";
				qcom,gpio-req-tbl-num = <0x00 0x01 0x02>;
				qcom,gpio-reset = <0x01>;
				qcom,gpio-standby = <0x02>;
				qcom,mount-angle = <0x5a>;
				qcom,sensor-mode = <0x00>;
				qcom,sensor-position = <0x01>;
				reg = <0x02>;
				status = "ok";
			};

			qcom,eeprom@0 {
				cam_vaf-supply = <0xffffffff>;
				cam_vana-supply = <0xffffffff>;
				cam_vdig-supply = <0xffffffff>;
				cam_vio-supply = <0xffffffff>;
				cell-index = <0x00>;
				clock-names = "cam_src_clk\0cam_clk";
				clocks = <0xffffffff 0x266b3853 0xffffffff 0x80902deb>;
				compatible = "qcom,eeprom";
				gpios = <0xffffffff 0x1a 0x00 0xffffffff 0x24 0x00 0xffffffff 0x23 0x00>;
				phandle = <0x01>;
				pinctrl-0 = <0xffffffff 0xffffffff>;
				pinctrl-1 = <0xffffffff 0xffffffff>;
				pinctrl-names = "cam_default\0cam_suspend";
				qcom,cam-vreg-max-voltage = <0x124f80 0x00 0x2ab980 0x2b7cd0>;
				qcom,cam-vreg-min-voltage = <0x124f80 0x00 0x2ab980 0x2b7cd0>;
				qcom,cam-vreg-name = "cam_vdig\0cam_vana\0cam_vio\0cam_vaf";
				qcom,cam-vreg-op-mode = <0x30d40 0x00 0x13880 0x186a0>;
				qcom,cci-master = <0x00>;
				qcom,clock-rates = <0x124f800 0x00>;
				qcom,gpio-req-tbl-flags = <0x01 0x00 0x00>;
				qcom,gpio-req-tbl-label = "CAMIF_MCLK0\0CAM_RESET0\0CAM_STANDBY0";
				qcom,gpio-req-tbl-num = <0x00 0x01 0x02>;
				qcom,gpio-reset = <0x01>;
				qcom,gpio-standby = <0x02>;
				reg = <0x00>;
				status = "ok";
			};

			qcom,eeprom@1 {
				cam_vaf-supply = <0xffffffff>;
				cam_vana-supply = <0xffffffff>;
				cam_vdig-supply = <0xffffffff>;
				cam_vio-supply = <0xffffffff>;
				cell-index = <0x01>;
				clock-names = "cam_src_clk\0cam_clk";
				clocks = <0xffffffff 0x42545468 0xffffffff 0x222f8fff>;
				compatible = "qcom,eeprom";
				gpios = <0xffffffff 0x1c 0x00 0xffffffff 0x28 0x00 0xffffffff 0x27 0x00>;
				phandle = <0x03>;
				pinctrl-0 = <0xffffffff 0xffffffff>;
				pinctrl-1 = <0xffffffff 0xffffffff>;
				pinctrl-names = "cam_default\0cam_suspend";
				qcom,cam-power-seq-cfg-val = <0x01 0x01 0x01 0x01 0x01 0x16e3600>;
				qcom,cam-power-seq-delay = <0x01 0x01 0x01 0x1e 0x1e 0x05>;
				qcom,cam-power-seq-type = "sensor_vreg\0sensor_vreg\0sensor_vreg\0sensor_gpio\0sensor_gpio\0sensor_clk";
				qcom,cam-power-seq-val = "cam_vdig\0cam_vana\0cam_vio\0sensor_gpio_reset\0sensor_gpio_standby\0sensor_cam_mclk";
				qcom,cam-vreg-max-voltage = <0x124f80 0x00 0x2ab980 0x2b7cd0>;
				qcom,cam-vreg-min-voltage = <0x124f80 0x00 0x2ab980 0x2b7cd0>;
				qcom,cam-vreg-name = "cam_vdig\0cam_vio\0cam_vana\0cam_vaf";
				qcom,cam-vreg-op-mode = <0x19a28 0x00 0x13880 0x186a0>;
				qcom,cci-master = <0x00>;
				qcom,clock-rates = <0x124f800 0x00>;
				qcom,eeprom-name = "sunny_8865";
				qcom,gpio-no-mux = <0x00>;
				qcom,gpio-req-tbl-flags = <0x01 0x00 0x00>;
				qcom,gpio-req-tbl-label = "CAMIF_MCLK2\0CAM_RESET2\0CAM_STANDBY2";
				qcom,gpio-req-tbl-num = <0x00 0x01 0x02>;
				qcom,gpio-reset = <0x01>;
				qcom,gpio-standby = <0x02>;
				qcom,mem0 = <0x00 0x00 0x02 0x00 0x01 0x00>;
				qcom,mem1 = <0x00 0x00 0x02 0x00 0x01 0x00>;
				qcom,mem2 = <0x00 0x00 0x02 0x00 0x01 0x00>;
				qcom,mem3 = <0x00 0x00 0x02 0x00 0x01 0x00>;
				qcom,mem4 = <0x00 0x00 0x02 0x00 0x01 0x00>;
				qcom,mem5 = <0x00 0x00 0x02 0x00 0x01 0x00>;
				qcom,mem6 = <0x00 0x00 0x02 0x00 0x01 0x00>;
				qcom,mem7 = <0x600 0x7010 0x02 0x00 0x01 0x00>;
				qcom,num-blocks = <0x08>;
				qcom,page0 = <0x01 0x100 0x02 0x01 0x01 0x01>;
				qcom,page1 = <0x01 0x5002 0x02 0x00 0x01 0x00>;
				qcom,page2 = <0x01 0x3d84 0x02 0xc0 0x01 0x00>;
				qcom,page3 = <0x01 0x3d88 0x02 0x70 0x01 0x00>;
				qcom,page4 = <0x01 0x3d89 0x02 0x10 0x01 0x00>;
				qcom,page5 = <0x01 0x3d8a 0x02 0x70 0x01 0x00>;
				qcom,page6 = <0x01 0x3d8b 0x02 0xf4 0x01 0x00>;
				qcom,page7 = <0x01 0x3d81 0x02 0x01 0x01 0x0a>;
				qcom,poll0 = <0x00 0x00 0x02 0x00 0x01 0x00>;
				qcom,poll1 = <0x00 0x00 0x02 0x00 0x01 0x00>;
				qcom,poll2 = <0x00 0x00 0x02 0x00 0x01 0x00>;
				qcom,poll3 = <0x00 0x00 0x02 0x00 0x01 0x00>;
				qcom,poll4 = <0x00 0x00 0x02 0x00 0x01 0x00>;
				qcom,poll5 = <0x00 0x00 0x02 0x00 0x01 0x00>;
				qcom,poll6 = <0x00 0x00 0x02 0x00 0x01 0x00>;
				qcom,poll7 = <0x00 0x00 0x02 0x00 0x01 0x01>;
				qcom,slave-addr = <0x6c>;
				reg = <0x01>;
				status = "ok";
			};
		};
	};

	fragment@1 {
		target = <0xffffffff>;

		__overlay__ {

			gpio_keys {
				compatible = "gpio-keys";
				input-name = "gpio-keys";
				pinctrl-0 = <0x05>;
				pinctrl-names = "default";

				camera_focus {
					debounce-interval = <0x0f>;
					gpio-key,wakeup;
					gpios = <0xffffffff 0x80 0x01>;
					label = "camera_focus";
					linux,can-disable;
					linux,code = <0x210>;
					linux,input-type = <0x01>;
				};

				camera_snapshot {
					debounce-interval = <0x0f>;
					gpio-key,wakeup;
					gpios = <0xffffffff 0x7f 0x01>;
					label = "camera_snapshot";
					linux,can-disable;
					linux,code = <0x2fe>;
					linux,input-type = <0x01>;
				};

				home {
					debounce-interval = <0x0f>;
					gpio-key,wakeup;
					gpios = <0xffffffff 0x56 0x01>;
					label = "home";
					linux,can-disable;
					linux,code = <0x66>;
					linux,input-type = <0x01>;
				};

				vol_up {
					debounce-interval = <0x0f>;
					gpio-key,wakeup;
					gpios = <0xffffffff 0x5b 0x01>;
					label = "volume_up";
					linux,can-disable;
					linux,code = <0x73>;
					linux,input-type = <0x01>;
				};
			};

			hbtp {
				compatible = "qcom,hbtp-input";
				qcom,afe-load = <0xc350>;
				qcom,afe-vtg-max = <0x2b7cd0>;
				qcom,afe-vtg-min = <0x2b7cd0>;
				qcom,dig-load = <0x3a98>;
				qcom,dig-vtg-max = <0x1b7740>;
				qcom,dig-vtg-min = <0x1b7740>;
				vcc_ana-supply = <0xffffffff>;
				vcc_dig-supply = <0xffffffff>;
			};

			usb_detect {
				compatible = "qcom,gpio-usbdetect";
				interrupt-names = "vbus_det_irq";
				interrupt-parent = <0xffffffff>;
				interrupts = <0x82 0x00>;
				pinctrl-0 = <0xffffffff>;
				pinctrl-names = "default";
				qcom,gpio-mode-sel = <0xffffffff 0x82 0x00>;
				qcom,notify-host-mode;
				status = "disabled";
			};
		};
	};

	fragment@10 {
		target = <0xffffffff>;

		__overlay__ {

			qcom,mdss_dsi_r69006_1080p_video {
				phandle = <0x0f>;
				qcom,mdss-dsi-bl-max-level = <0xfff>;
				qcom,mdss-dsi-bl-min-level = <0x01>;
				qcom,mdss-dsi-bl-pmic-control-type = "bl_ctrl_wled";
				qcom,mdss-dsi-bllp-eof-power-mode;
				qcom,mdss-dsi-bllp-power-mode;
				qcom,mdss-dsi-border-color = <0x00>;
				qcom,mdss-dsi-bpp = <0x18>;
				qcom,mdss-dsi-dma-trigger = "trigger_sw";
				qcom,mdss-dsi-h-back-porch = <0x52>;
				qcom,mdss-dsi-h-front-porch = <0x64>;
				qcom,mdss-dsi-h-left-border = <0x00>;
				qcom,mdss-dsi-h-pulse-width = <0x14>;
				qcom,mdss-dsi-h-right-border = <0x00>;
				qcom,mdss-dsi-h-sync-pulse = <0x01>;
				qcom,mdss-dsi-h-sync-skew = <0x00>;
				qcom,mdss-dsi-lane-0-state;
				qcom,mdss-dsi-lane-1-state;
				qcom,mdss-dsi-lane-2-state;
				qcom,mdss-dsi-lane-3-state;
				qcom,mdss-dsi-mdp-trigger = "none";
				qcom,mdss-dsi-off-command = [05 01 00 00 78 00 02 28 00 05 01 00 00 96 00 02 10 00];
				qcom,mdss-dsi-off-command-state = "dsi_hs_mode";
				qcom,mdss-dsi-on-command = [23 01 00 00 00 00 02 b0 00 29 01 00 00 00 00 06 b3 05 10 00 00 00 29 01 00 00 00 00 03 b4 0c 00 29 01 00 00 00 00 04 b6 3b c3 00 23 01 00 00 00 00 02 c0 00 15 01 00 00 00 00 02 36 98 23 01 00 00 00 00 02 cc 04 29 01 00 00 00 00 20 c1 84 00 10 ef 8b f1 ff ff df 9c c5 9a 73 8d ad 63 fe ff ff cb f8 01 00 aa 40 00 c2 01 08 00 01 29 01 00 00 00 00 0a cb 0d fe 1f 2c 00 00 00 00 00 29 01 00 00 00 00 0b c2 01 f7 80 04 63 00 60 00 01 30 29 01 00 00 00 00 07 c3 55 01 00 01 00 00 29 01 00 00 00 00 12 c4 70 00 00 00 00 00 00 00 00 02 01 00 05 01 00 00 00 29 01 00 00 00 00 0f c6 59 07 4a 07 4a 01 0e 01 02 01 02 09 15 07 29 01 00 00 00 00 1f c7 00 30 32 34 42 4e 56 62 44 4a 54 62 6b 73 7f 08 30 32 34 42 4e 56 62 44 4a 54 62 6b 73 7f 29 01 00 00 00 00 14 c8 00 00 00 00 00 fc 00 00 00 00 00 fc 00 00 00 00 00 fc 00 29 01 00 00 00 00 09 c9 1f 68 1f 68 4c 4c c4 11 29 01 00 00 00 00 11 d0 33 01 91 0b d9 19 19 00 00 00 19 99 00 00 00 00 29 01 00 00 00 00 1d d3 1b 3b bb ad a5 33 33 33 00 80 ad a8 6f 6f 33 33 33 f7 f2 1f 7d 7c ff 0f 99 00 ff ff 29 01 00 00 00 00 04 d4 57 33 03 29 01 00 00 00 00 0c d5 66 00 00 01 27 01 27 00 6d 00 6d 23 01 00 00 00 00 02 d6 81 05 01 00 00 78 00 02 11 00 05 01 00 00 78 00 02 29 00];
				qcom,mdss-dsi-on-command-state = "dsi_lp_mode";
				qcom,mdss-dsi-panel-framerate = <0x3c>;
				qcom,mdss-dsi-panel-height = <0x780>;
				qcom,mdss-dsi-panel-max-error-count = <0x03>;
				qcom,mdss-dsi-panel-name = "r69006 1080p video mode dsi panel";
				qcom,mdss-dsi-panel-status-check-mode = "reg_read";
				qcom,mdss-dsi-panel-status-command = <0x6010001 0x500010a>;
				qcom,mdss-dsi-panel-status-command-mode = "dsi_lp_mode";
				qcom,mdss-dsi-panel-status-read-length = <0x01>;
				qcom,mdss-dsi-panel-status-value = <0x1c>;
				qcom,mdss-dsi-panel-timings = <0x7d251d00 0x37332227 0x1e030400>;
				qcom,mdss-dsi-panel-type = "dsi_video_mode";
				qcom,mdss-dsi-panel-width = <0x438>;
				qcom,mdss-dsi-reset-sequence = <0x01 0x14 0x00 0x02 0x01 0x14>;
				qcom,mdss-dsi-stream = <0x00>;
				qcom,mdss-dsi-t-clk-post = <0x20>;
				qcom,mdss-dsi-t-clk-pre = <0x2c>;
				qcom,mdss-dsi-traffic-mode = "burst_mode";
				qcom,mdss-dsi-underflow-color = <0xff>;
				qcom,mdss-dsi-v-back-porch = <0x09>;
				qcom,mdss-dsi-v-bottom-border = <0x00>;
				qcom,mdss-dsi-v-front-porch = <0x03>;
				qcom,mdss-dsi-v-pulse-width = <0x0f>;
				qcom,mdss-dsi-v-top-border = <0x00>;
				qcom,mdss-dsi-virtual-channel-id = <0x00>;
			};
		};
	};

	fragment@11 {
		target = <0xffffffff>;

		__overlay__ {

			qcom,mdss_dsi_hx8394f_720p_video {
				phandle = <0x10>;
				qcom,mdss-dsi-bl-max-level = <0xfff>;
				qcom,mdss-dsi-bl-min-level = <0x01>;
				qcom,mdss-dsi-bl-pmic-control-type = "bl_ctrl_wled";
				qcom,mdss-dsi-bllp-eof-power-mode;
				qcom,mdss-dsi-bllp-power-mode;
				qcom,mdss-dsi-border-color = <0x00>;
				qcom,mdss-dsi-bpp = <0x18>;
				qcom,mdss-dsi-dma-trigger = "trigger_sw";
				qcom,mdss-dsi-h-back-porch = <0x10>;
				qcom,mdss-dsi-h-front-porch = <0x10>;
				qcom,mdss-dsi-h-left-border = <0x00>;
				qcom,mdss-dsi-h-pulse-width = <0x0a>;
				qcom,mdss-dsi-h-right-border = <0x00>;
				qcom,mdss-dsi-h-sync-pulse = <0x01>;
				qcom,mdss-dsi-h-sync-skew = <0x00>;
				qcom,mdss-dsi-lane-0-state;
				qcom,mdss-dsi-lane-1-state;
				qcom,mdss-dsi-lane-2-state;
				qcom,mdss-dsi-lane-3-state;
				qcom,mdss-dsi-lane-map = "lane_map_0123";
				qcom,mdss-dsi-mdp-trigger = "none";
				qcom,mdss-dsi-off-command = [05 01 00 00 78 00 02 28 00 05 01 00 00 96 00 02 10 00];
				qcom,mdss-dsi-off-command-state = "dsi_hs_mode";
				qcom,mdss-dsi-on-command = [39 01 00 00 00 00 04 b9 ff 83 94 39 01 00 00 00 00 07 ba 63 03 68 6b b2 c0 39 01 00 00 00 00 0b b1 50 12 72 09 33 54 b1 31 6b 2f 39 01 00 00 00 00 07 b2 00 80 64 0e 0d 2f 39 01 00 00 00 00 16 b4 73 74 73 74 73 74 01 0c 86 75 00 3f 73 74 73 74 73 74 01 0c 86 39 01 00 00 00 00 22 d3 00 00 07 07 40 07 10 00 08 10 08 00 08 54 15 0e 05 0e 02 15 06 05 06 47 44 0a 0a 4b 10 07 07 0e 40 39 01 00 00 00 00 2d d5 1a 1a 1b 1b 00 01 02 03 04 05 06 07 08 09 0a 0b 24 25 18 18 26 27 18 18 18 18 18 18 18 18 18 18 18 18 18 18 18 18 20 21 18 18 18 18 39 01 00 00 00 00 2d d6 1a 1a 1b 1b 0b 0a 09 08 07 06 05 04 03 02 01 00 21 20 18 18 27 26 18 18 18 18 18 18 18 18 18 18 18 18 18 18 18 18 25 24 18 18 18 18 39 01 00 00 00 00 3b e0 00 0c 19 20 23 26 29 28 51 61 70 6f 76 86 89 8d 99 9a 95 a1 b0 57 55 58 5c 5e 64 6b 7f 00 0c 19 20 23 26 29 28 51 61 70 6f 76 86 89 8d 99 9a 95 a1 b0 57 55 58 5c 5e 64 6b 7f 39 01 00 00 00 00 03 c0 1f 31 15 01 00 00 00 00 02 cc 0b 15 01 00 00 00 00 02 d4 02 15 01 00 00 00 00 02 bd 02 39 01 00 00 00 00 0d d8 ff ff ff ff ff ff ff ff ff ff ff ff 15 01 00 00 00 00 02 bd 00 15 01 00 00 00 00 02 bd 01 15 01 00 00 00 00 02 b1 00 15 01 00 00 00 00 02 bd 00 39 01 00 00 00 00 08 bf 40 81 50 00 1a fc 01 39 01 00 00 00 00 03 b6 7d 7d 05 01 00 00 78 00 02 11 00 39 01 00 00 00 00 0d b2 00 80 64 0e 0d 2f 00 00 00 00 c0 18 05 01 00 00 14 00 02 29 00];
				qcom,mdss-dsi-on-command-state = "dsi_lp_mode";
				qcom,mdss-dsi-panel-controller = <0xffffffff>;
				qcom,mdss-dsi-panel-destination = "display_1";
				qcom,mdss-dsi-panel-framerate = <0x3c>;
				qcom,mdss-dsi-panel-height = <0x500>;
				qcom,mdss-dsi-panel-max-error-count = <0x03>;
				qcom,mdss-dsi-panel-name = "hx8394f 720p video mode dsi panel";
				qcom,mdss-dsi-panel-status-check-mode = "reg_read";
				qcom,mdss-dsi-panel-status-command = <0x6010001 0x50001d9 0x6010001 0x5000109 0x6010001 0x5000145>;
				qcom,mdss-dsi-panel-status-command-state = "dsi_lp_mode";
				qcom,mdss-dsi-panel-status-read-length = <0x04 0x04 0x03>;
				qcom,mdss-dsi-panel-status-valid-params = <0x01 0x03 0x02>;
				qcom,mdss-dsi-panel-status-value = <0x80 0x80 0x73 0x04 0x05 0x0f 0x80 0x80 0x73 0x04 0x05 0x1e>;
				qcom,mdss-dsi-panel-timings = <0x72160e00 0x383c121a 0x10030400>;
				qcom,mdss-dsi-panel-type = "dsi_video_mode";
				qcom,mdss-dsi-panel-width = <0x2d0>;
				qcom,mdss-dsi-reset-sequence = <0x01 0x14 0x00 0x02 0x01 0x14>;
				qcom,mdss-dsi-stream = <0x00>;
				qcom,mdss-dsi-t-clk-post = <0x04>;
				qcom,mdss-dsi-t-clk-pre = <0x18>;
				qcom,mdss-dsi-traffic-mode = "burst_mode";
				qcom,mdss-dsi-underflow-color = <0xff>;
				qcom,mdss-dsi-v-back-porch = <0x0c>;
				qcom,mdss-dsi-v-bottom-border = <0x00>;
				qcom,mdss-dsi-v-front-porch = <0x0f>;
				qcom,mdss-dsi-v-pulse-width = <0x04>;
				qcom,mdss-dsi-v-top-border = <0x00>;
				qcom,mdss-dsi-virtual-channel-id = <0x00>;
			};
		};
	};

	fragment@12 {
		target = <0xffffffff>;

		__overlay__ {

			qcom,mdss_dsi_adv7533_1080p {
				label = "adv7533 1080p video mode dsi panel";
				phandle = <0x11>;
				qcom,bridge-name = "adv7533";
				qcom,dba-panel;
				qcom,mdss-dsi-always-on;
				qcom,mdss-dsi-bl-max-level = <0xfff>;
				qcom,mdss-dsi-bl-min-level = <0x01>;
				qcom,mdss-dsi-bllp-eof-power-mode;
				qcom,mdss-dsi-bllp-power-mode;
				qcom,mdss-dsi-border-color = <0x00>;
				qcom,mdss-dsi-bpp = <0x18>;
				qcom,mdss-dsi-dma-trigger = "trigger_sw";
				qcom,mdss-dsi-force-clock-lane-hs;
				qcom,mdss-dsi-h-back-porch = <0x94>;
				qcom,mdss-dsi-h-front-porch = <0x58>;
				qcom,mdss-dsi-h-left-border = <0x00>;
				qcom,mdss-dsi-h-pulse-width = <0x2c>;
				qcom,mdss-dsi-h-right-border = <0x00>;
				qcom,mdss-dsi-h-sync-pulse = <0x01>;
				qcom,mdss-dsi-h-sync-skew = <0x00>;
				qcom,mdss-dsi-lane-0-state;
				qcom,mdss-dsi-lane-1-state;
				qcom,mdss-dsi-lane-2-state;
				qcom,mdss-dsi-lane-3-state;
				qcom,mdss-dsi-mdp-trigger = "none";
				qcom,mdss-dsi-off-command = [05 01 00 00 00 00 02 28 00 05 01 00 00 00 00 02 10 00];
				qcom,mdss-dsi-off-command-state = "dsi_hs_mode";
				qcom,mdss-dsi-on-command = [05 01 00 00 c8 00 02 11 00 05 01 00 00 0a 00 02 29 00];
				qcom,mdss-dsi-on-command-state = "dsi_lp_mode";
				qcom,mdss-dsi-panel-controller = <0xffffffff>;
				qcom,mdss-dsi-panel-destination = "display_1";
				qcom,mdss-dsi-panel-framerate = <0x3c>;
				qcom,mdss-dsi-panel-height = <0x438>;
				qcom,mdss-dsi-panel-name = "dsi_adv7533_1080p";
				qcom,mdss-dsi-panel-timings = <0xe6382600 0x686c2a3a 0x2c030400>;
				qcom,mdss-dsi-panel-timings-phy-v2 = <0x1d1a0305 0x10304a0 0x1d1a0305 0x10304a0 0x1d1a0305 0x10304a0 0x1d1a0305 0x10304a0 0x1d1a0305 0x10304a0>;
				qcom,mdss-dsi-panel-type = "dsi_video_mode";
				qcom,mdss-dsi-panel-width = <0x780>;
				qcom,mdss-dsi-reset-sequence = <0x01 0x14 0x00 0x01 0x01 0x14>;
				qcom,mdss-dsi-stream = <0x00>;
				qcom,mdss-dsi-t-clk-post = <0x02>;
				qcom,mdss-dsi-t-clk-pre = <0x2b>;
				qcom,mdss-dsi-traffic-mode = "non_burst_sync_pulse";
				qcom,mdss-dsi-underflow-color = <0xff>;
				qcom,mdss-dsi-v-back-porch = <0x24>;
				qcom,mdss-dsi-v-bottom-border = <0x00>;
				qcom,mdss-dsi-v-front-porch = <0x04>;
				qcom,mdss-dsi-v-pulse-width = <0x05>;
				qcom,mdss-dsi-v-top-border = <0x00>;
				qcom,mdss-dsi-virtual-channel-id = <0x00>;
				qcom,mdss-pan-physical-height-dimension = <0x5a>;
				qcom,mdss-pan-physical-width-dimension = <0xa0>;
			};
		};
	};

	fragment@13 {
		target = <0xffffffff>;

		__overlay__ {

			qcom,mdss_dsi_adv7533_720p {
				label = "adv7533 720p video mode dsi panel";
				phandle = <0x12>;
				qcom,bridge-name = "adv7533";
				qcom,dba-panel;
				qcom,mdss-dsi-always-on;
				qcom,mdss-dsi-bl-max-level = <0xfff>;
				qcom,mdss-dsi-bl-min-level = <0x01>;
				qcom,mdss-dsi-bllp-eof-power-mode;
				qcom,mdss-dsi-bllp-power-mode;
				qcom,mdss-dsi-border-color = <0x00>;
				qcom,mdss-dsi-bpp = <0x18>;
				qcom,mdss-dsi-dma-trigger = "trigger_sw";
				qcom,mdss-dsi-force-clock-lane-hs;
				qcom,mdss-dsi-h-back-porch = <0xdc>;
				qcom,mdss-dsi-h-front-porch = <0x6e>;
				qcom,mdss-dsi-h-left-border = <0x00>;
				qcom,mdss-dsi-h-pulse-width = <0x28>;
				qcom,mdss-dsi-h-right-border = <0x00>;
				qcom,mdss-dsi-h-sync-pulse = <0x01>;
				qcom,mdss-dsi-h-sync-skew = <0x00>;
				qcom,mdss-dsi-lane-0-state;
				qcom,mdss-dsi-lane-1-state;
				qcom,mdss-dsi-lane-2-state;
				qcom,mdss-dsi-mdp-trigger = "none";
				qcom,mdss-dsi-off-command = [05 01 00 00 00 00 02 28 00 05 01 00 00 00 00 02 10 00];
				qcom,mdss-dsi-off-command-state = "dsi_hs_mode";
				qcom,mdss-dsi-on-command = [05 01 00 00 c8 00 02 11 00 05 01 00 00 0a 00 02 29 00];
				qcom,mdss-dsi-on-command-state = "dsi_lp_mode";
				qcom,mdss-dsi-panel-controller = <0xffffffff>;
				qcom,mdss-dsi-panel-destination = "display_1";
				qcom,mdss-dsi-panel-framerate = <0x3c>;
				qcom,mdss-dsi-panel-height = <0x2d0>;
				qcom,mdss-dsi-panel-name = "dsi_adv7533_720p";
				qcom,mdss-dsi-panel-timings = <0xa4241800 0x4e521c28 0x1c030400>;
				qcom,mdss-dsi-panel-timings-phy-v2 = <0x1c190203 0x10304a0 0x1c190203 0x10304a0 0x1c190203 0x10304a0 0x1c190203 0x10304a0 0x1c080203 0x10304a0>;
				qcom,mdss-dsi-panel-type = "dsi_video_mode";
				qcom,mdss-dsi-panel-width = <0x500>;
				qcom,mdss-dsi-reset-sequence = <0x01 0x14 0x00 0x01 0x01 0x14>;
				qcom,mdss-dsi-stream = <0x00>;
				qcom,mdss-dsi-t-clk-post = <0x03>;
				qcom,mdss-dsi-t-clk-pre = <0x20>;
				qcom,mdss-dsi-traffic-mode = "non_burst_sync_pulse";
				qcom,mdss-dsi-underflow-color = <0xff>;
				qcom,mdss-dsi-v-back-porch = <0x14>;
				qcom,mdss-dsi-v-bottom-border = <0x00>;
				qcom,mdss-dsi-v-front-porch = <0x05>;
				qcom,mdss-dsi-v-pulse-width = <0x05>;
				qcom,mdss-dsi-v-top-border = <0x00>;
				qcom,mdss-dsi-virtual-channel-id = <0x00>;
				qcom,mdss-pan-physical-height-dimension = <0x5a>;
				qcom,mdss-pan-physical-width-dimension = <0xa0>;
			};
		};
	};

	fragment@14 {
		target = <0xffffffff>;

		__overlay__ {

			qcom,mdss_dsi_hx8399c_truly_video {
				phandle = <0x13>;
				qcom,mdss-dsi-bllp-eof-power-mode;
				qcom,mdss-dsi-bllp-power-mode;
				qcom,mdss-dsi-border-color = <0x00>;
				qcom,mdss-dsi-bpp = <0x18>;
				qcom,mdss-dsi-color-order = "rgb_swap_rgb";
				qcom,mdss-dsi-dma-trigger = "trigger_sw";
				qcom,mdss-dsi-h-back-porch = <0x2a>;
				qcom,mdss-dsi-h-front-porch = <0x2a>;
				qcom,mdss-dsi-h-left-border = <0x00>;
				qcom,mdss-dsi-h-pulse-width = <0x0a>;
				qcom,mdss-dsi-h-right-border = <0x00>;
				qcom,mdss-dsi-h-sync-pulse = <0x00>;
				qcom,mdss-dsi-h-sync-skew = <0x00>;
				qcom,mdss-dsi-lane-0-state;
				qcom,mdss-dsi-lane-1-state;
				qcom,mdss-dsi-lane-2-state;
				qcom,mdss-dsi-lane-3-state;
				qcom,mdss-dsi-lane-map = "lane_map_0123";
				qcom,mdss-dsi-lp11-init;
				qcom,mdss-dsi-mdp-trigger = "none";
				qcom,mdss-dsi-off-command = [05 01 00 00 32 00 02 28 00 05 01 00 00 96 00 02 10 00];
				qcom,mdss-dsi-off-command-state = "dsi_hs_mode";
				qcom,mdss-dsi-on-command = [39 01 00 00 00 00 04 b9 ff 83 99 39 01 00 00 00 00 02 d2 88 39 01 00 00 00 00 0c b1 02 04 72 92 01 32 aa 11 11 52 57 39 01 00 00 00 00 10 b2 00 80 80 cc 05 07 5a 11 10 10 00 1e 70 03 d4 39 01 00 00 00 00 2d b4 00 ff 59 59 01 ab 00 00 09 00 03 05 00 28 03 0b 0d 21 03 02 00 0c a3 80 59 59 02 ab 00 00 09 00 03 05 00 28 03 0b 0d 02 00 0c a3 01 39 01 00 00 05 00 22 d3 00 0c 03 03 00 00 10 10 00 00 03 00 03 00 08 78 08 78 00 00 00 00 00 24 02 05 05 03 00 00 00 05 40 39 01 00 00 05 00 21 d5 20 20 19 19 18 18 02 03 00 01 24 24 18 18 18 18 24 24 00 00 00 00 00 00 00 00 2f 2f 30 30 31 31 39 01 00 00 05 00 21 d6 24 24 18 18 19 19 01 00 03 02 24 24 18 18 18 18 20 20 40 40 40 40 40 40 40 40 2f 2f 30 30 31 31 39 01 00 00 00 00 02 bd 00 39 01 00 00 00 00 11 d8 aa aa aa aa aa aa aa aa aa ba aa aa aa ba aa aa 39 01 00 00 00 00 02 bd 01 39 01 00 00 00 00 11 d8 00 00 00 00 00 00 00 00 82 ea aa aa 82 ea aa aa 39 01 00 00 00 00 02 bd 02 39 01 00 00 00 00 09 d8 ff ff c0 3f ff ff c0 3f 39 01 00 00 00 00 02 bd 00 39 01 00 00 05 00 37 e0 01 21 31 2d 66 6f 7b 75 7a 81 86 89 8c 90 95 97 9a a1 a2 aa 9e ad b0 5b 57 63 7a 01 21 31 2d 66 6f 7b 75 7a 81 86 89 8c 90 95 97 9a a1 a2 aa 9e ad b0 5b 57 63 7a 39 01 00 00 00 00 03 b6 7e 7e 39 01 00 00 00 00 02 cc 08 05 01 00 00 96 00 02 11 00 05 01 00 00 32 00 02 29 00];
				qcom,mdss-dsi-on-command-state = "dsi_lp_mode";
				qcom,mdss-dsi-panel-framerate = <0x3c>;
				qcom,mdss-dsi-panel-height = <0x870>;
				qcom,mdss-dsi-panel-name = "hx8399c video mode dsi truly panel";
				qcom,mdss-dsi-panel-type = "dsi_video_mode";
				qcom,mdss-dsi-panel-width = <0x438>;
				qcom,mdss-dsi-reset-sequence = <0x01 0x0a 0x00 0x0a 0x01 0x0a>;
				qcom,mdss-dsi-stream = <0x00>;
				qcom,mdss-dsi-t-clk-post = <0x0e>;
				qcom,mdss-dsi-t-clk-pre = <0x31>;
				qcom,mdss-dsi-traffic-mode = "non_burst_sync_event";
				qcom,mdss-dsi-tx-eot-append;
				qcom,mdss-dsi-underflow-color = <0xff>;
				qcom,mdss-dsi-v-back-porch = <0x0f>;
				qcom,mdss-dsi-v-bottom-border = <0x00>;
				qcom,mdss-dsi-v-front-porch = <0x0a>;
				qcom,mdss-dsi-v-pulse-width = <0x03>;
				qcom,mdss-dsi-v-top-border = <0x00>;
				qcom,mdss-dsi-virtual-channel-id = <0x00>;
				qcom,mdss-pan-physical-height-dimension = <0x81>;
				qcom,mdss-pan-physical-width-dimension = <0x41>;
			};
		};
	};

	fragment@15 {
		target = <0xffffffff>;

		__overlay__ {

			qcom,mdss_dsi_hx8399c_hd_video {
				phandle = <0x14>;
				qcom,mdss-dsi-bllp-eof-power-mode;
				qcom,mdss-dsi-bllp-power-mode;
				qcom,mdss-dsi-border-color = <0x00>;
				qcom,mdss-dsi-bpp = <0x18>;
				qcom,mdss-dsi-color-order = "rgb_swap_rgb";
				qcom,mdss-dsi-dma-trigger = "trigger_sw";
				qcom,mdss-dsi-h-back-porch = <0x30>;
				qcom,mdss-dsi-h-front-porch = <0x30>;
				qcom,mdss-dsi-h-left-border = <0x00>;
				qcom,mdss-dsi-h-pulse-width = <0x10>;
				qcom,mdss-dsi-h-right-border = <0x00>;
				qcom,mdss-dsi-h-sync-pulse = <0x00>;
				qcom,mdss-dsi-h-sync-skew = <0x00>;
				qcom,mdss-dsi-lane-0-state;
				qcom,mdss-dsi-lane-1-state;
				qcom,mdss-dsi-lane-2-state;
				qcom,mdss-dsi-lane-3-state;
				qcom,mdss-dsi-lane-map = "lane_map_0123";
				qcom,mdss-dsi-lp11-init;
				qcom,mdss-dsi-mdp-trigger = "none";
				qcom,mdss-dsi-off-command = [05 01 00 00 14 00 02 28 00 05 01 00 00 78 00 02 10 00];
				qcom,mdss-dsi-off-command-state = "dsi_hs_mode";
				qcom,mdss-dsi-on-command = <0x39010000 0x4b9 0xff839939 0x1000000 0x2d288 0x39010000 0xcb1 0x2047292 0x132aa11 0x11525739 0x1000000 0x10b200 0x8080cc05 0x75a1110 0x10001e70 0x3d43901 0x00 0x2db400ff 0x595901ab 0x900 0x3050028 0x30b0d21 0x302000c 0xa3805959 0x2ab0000 0x9000305 0x28030b 0xd02000c 0xa3013901 0x500 0x22d3000c 0x3030000 0x10100000 0x3000300 0x8780878 0x00 0x240205 0x5030000 0x54039 0x1000005 0x21d520 0x20191918 0x18020300 0x1242418 0x18181824 0x24000000 0x00 0x2f2f30 0x30313139 0x1000005 0x21d624 0x24181819 0x19010003 0x2242418 0x18181820 0x20404040 0x40404040 0x402f2f30 0x30313139 0x1000000 0x2bd00 0x39010000 0x11d8 0xaaaaaaaa 0xaaaaaaaa 0xaabaaaaa 0xaabaaaaa 0x39010000 0x2bd 0x1390100 0x11 0xd8000000 0x00 0x82eaaa 0xaa82eaaa 0xaa390100 0x02 0xbd023901 0x00 0x9d8ffff 0xc03fffff 0xc03f3901 0x00 0x2bd0039 0x1000005 0x37e001 0x21312d66 0x6f7b757a 0x8186898c 0x9095979a 0xa1a2aa9e 0xadb05b57 0x637a0121 0x312d666f 0x7b757a81 0x86898c90 0x95979aa1 0xa2aa9ead 0xb05b5763 0x7a390100 0x03 0xb67e7e39 0x1000000 0x2cc08 0x39010000 0x235 0x390100 0x02 0xdd030501 0x9600 0x2110005 0x1000014 0x22900>;
				qcom,mdss-dsi-on-command-state = "dsi_lp_mode";
				qcom,mdss-dsi-panel-framerate = <0x3c>;
				qcom,mdss-dsi-panel-height = <0x5a0>;
				qcom,mdss-dsi-panel-name = "hx8399c video mode dsi hd panel";
				qcom,mdss-dsi-panel-timings = <0x7a1a1200 0x3e42161e 0x14030400>;
				qcom,mdss-dsi-panel-type = "dsi_video_mode";
				qcom,mdss-dsi-panel-width = <0x2d0>;
				qcom,mdss-dsi-reset-sequence = <0x01 0x0a 0x00 0x0a 0x01 0x0a>;
				qcom,mdss-dsi-stream = <0x00>;
				qcom,mdss-dsi-t-clk-post = <0x0a>;
				qcom,mdss-dsi-t-clk-pre = <0x1d>;
				qcom,mdss-dsi-traffic-mode = "non_burst_sync_event";
				qcom,mdss-dsi-tx-eot-append;
				qcom,mdss-dsi-underflow-color = <0xff>;
				qcom,mdss-dsi-v-back-porch = <0x28>;
				qcom,mdss-dsi-v-bottom-border = <0x00>;
				qcom,mdss-dsi-v-front-porch = <0x24>;
				qcom,mdss-dsi-v-pulse-width = <0x04>;
				qcom,mdss-dsi-v-top-border = <0x00>;
				qcom,mdss-dsi-virtual-channel-id = <0x00>;
			};
		};
	};

	fragment@16 {
		target = <0xffffffff>;

		__overlay__ {

			qcom,mdss_dsi_nt35695b_truly_fhd_video {
				phandle = <0x15>;
				qcom,mdss-dsi-bl-max-level = <0xfff>;
				qcom,mdss-dsi-bl-min-level = <0x01>;
				qcom,mdss-dsi-bl-pmic-control-type = "bl_ctrl_wled";
				qcom,mdss-dsi-bllp-eof-power-mode;
				qcom,mdss-dsi-bllp-power-mode;
				qcom,mdss-dsi-border-color = <0x00>;
				qcom,mdss-dsi-bpp = <0x18>;
				qcom,mdss-dsi-dma-trigger = "trigger_sw";
				qcom,mdss-dsi-lane-0-state;
				qcom,mdss-dsi-lane-1-state;
				qcom,mdss-dsi-lane-2-state;
				qcom,mdss-dsi-lane-3-state;
				qcom,mdss-dsi-mdp-trigger = "none";
				qcom,mdss-dsi-panel-name = "nt35695b truly fhd video mode dsi panel";
				qcom,mdss-dsi-panel-type = "dsi_video_mode";
				qcom,mdss-dsi-post-init-delay = <0x01>;
				qcom,mdss-dsi-reset-sequence = <0x01 0x0a 0x00 0x0a 0x01 0x0a>;
				qcom,mdss-dsi-stream = <0x00>;
				qcom,mdss-dsi-t-clk-post = <0x0d>;
				qcom,mdss-dsi-t-clk-pre = <0x2f>;
				qcom,mdss-dsi-traffic-mode = "burst_mode";
				qcom,mdss-dsi-tx-eot-append;
				qcom,mdss-dsi-underflow-color = <0xff>;
				qcom,mdss-dsi-virtual-channel-id = <0x00>;

				qcom,mdss-dsi-display-timings {

					timing@0 {
						qcom,mdss-dsi-h-back-porch = <0x3c>;
						qcom,mdss-dsi-h-front-porch = <0x78>;
						qcom,mdss-dsi-h-left-border = <0x00>;
						qcom,mdss-dsi-h-pulse-width = <0x0c>;
						qcom,mdss-dsi-h-right-border = <0x00>;
						qcom,mdss-dsi-h-sync-pulse = <0x00>;
						qcom,mdss-dsi-h-sync-skew = <0x00>;
						qcom,mdss-dsi-off-command = [05 01 00 00 14 00 02 28 00 05 01 00 00 78 00 02 10 00];
						qcom,mdss-dsi-off-command-state = "dsi_lp_mode";
						qcom,mdss-dsi-on-command = [15 01 00 00 10 00 02 ff 20 15 01 00 00 00 00 02 fb 01 15 01 00 00 00 00 02 00 01 15 01 00 00 00 00 02 01 55 15 01 00 00 00 00 02 02 45 15 01 00 00 00 00 02 03 55 15 01 00 00 00 00 02 05 50 15 01 00 00 00 00 02 06 a8 15 01 00 00 00 00 02 07 ad 15 01 00 00 00 00 02 08 0c 15 01 00 00 00 00 02 0b aa 15 01 00 00 00 00 02 0c aa 15 01 00 00 00 00 02 0e b0 15 01 00 00 00 00 02 0f b3 15 01 00 00 00 00 02 11 28 15 01 00 00 00 00 02 12 10 15 01 00 00 00 00 02 13 01 15 01 00 00 00 00 02 14 4a 15 01 00 00 00 00 02 15 12 15 01 00 00 00 00 02 16 12 15 01 00 00 00 00 02 30 01 15 01 00 00 00 00 02 72 11 15 01 00 00 00 00 02 58 82 15 01 00 00 00 00 02 59 00 15 01 00 00 00 00 02 5a 02 15 01 00 00 00 00 02 5b 00 15 01 00 00 00 00 02 5c 82 15 01 00 00 00 00 02 5d 80 15 01 00 00 00 00 02 5e 02 15 01 00 00 00 00 02 5f 00 15 01 00 00 00 00 02 ff 24 15 01 00 00 00 00 02 fb 01 15 01 00 00 00 00 02 00 01 15 01 00 00 00 00 02 01 0b 15 01 00 00 00 00 02 02 0c 15 01 00 00 00 00 02 03 89 15 01 00 00 00 00 02 04 8a 15 01 00 00 00 00 02 05 0f 15 01 00 00 00 00 02 06 10 15 01 00 00 00 00 02 07 10 15 01 00 00 00 00 02 08 1c 15 01 00 00 00 00 02 09 00 15 01 00 00 00 00 02 0a 00 15 01 00 00 00 00 02 0b 00 15 01 00 00 00 00 02 0c 00 15 01 00 00 00 00 02 0d 13 15 01 00 00 00 00 02 0e 15 15 01 00 00 00 00 02 0f 17 15 01 00 00 00 00 02 10 01 15 01 00 00 00 00 02 11 0b 15 01 00 00 00 00 02 12 0c 15 01 00 00 00 00 02 13 89 15 01 00 00 00 00 02 14 8a 15 01 00 00 00 00 02 15 0f 15 01 00 00 00 00 02 16 10 15 01 00 00 00 00 02 17 10 15 01 00 00 00 00 02 18 1c 15 01 00 00 00 00 02 19 00 15 01 00 00 00 00 02 1a 00 15 01 00 00 00 00 02 1b 00 15 01 00 00 00 00 02 1c 00 15 01 00 00 00 00 02 1d 13 15 01 00 00 00 00 02 1e 15 15 01 00 00 00 00 02 1f 17 15 01 00 00 00 00 02 20 00 15 01 00 00 00 00 02 21 01 15 01 00 00 00 00 02 22 00 15 01 00 00 00 00 02 23 40 15 01 00 00 00 00 02 24 40 15 01 00 00 00 00 02 25 6d 15 01 00 00 00 00 02 26 40 15 01 00 00 00 00 02 27 40 15 01 00 00 00 00 02 29 d8 15 01 00 00 00 00 02 2a 2a 15 01 00 00 00 00 02 4b 03 15 01 00 00 00 00 02 4c 11 15 01 00 00 00 00 02 4d 10 15 01 00 00 00 00 02 4e 01 15 01 00 00 00 00 02 4f 01 15 01 00 00 00 00 02 50 10 15 01 00 00 00 00 02 51 00 15 01 00 00 00 00 02 52 80 15 01 00 00 00 00 02 53 00 15 01 00 00 00 00 02 54 07 15 01 00 00 00 00 02 55 25 15 01 00 00 00 00 02 56 00 15 01 00 00 00 00 02 58 07 15 01 00 00 00 00 02 5b 43 15 01 00 00 00 00 02 5c 00 15 01 00 00 00 00 02 5f 73 15 01 00 00 00 00 02 60 73 15 01 00 00 00 00 02 63 22 15 01 00 00 00 00 02 64 00 15 01 00 00 00 00 02 67 08 15 01 00 00 00 00 02 68 04 15 01 00 00 00 00 02 7a 80 15 01 00 00 00 00 02 7b 91 15 01 00 00 00 00 02 7c d8 15 01 00 00 00 00 02 7d 60 15 01 00 00 00 00 02 93 06 15 01 00 00 00 00 02 94 06 15 01 00 00 00 00 02 8a 00 15 01 00 00 00 00 02 9b 0f 15 01 00 00 00 00 02 b3 c0 15 01 00 00 00 00 02 b4 00 15 01 00 00 00 00 02 b5 00 15 01 00 00 00 00 02 b6 21 15 01 00 00 00 00 02 b7 22 15 01 00 00 00 00 02 b8 07 15 01 00 00 00 00 02 b9 07 15 01 00 00 00 00 02 ba 22 15 01 00 00 00 00 02 bd 20 15 01 00 00 00 00 02 be 07 15 01 00 00 00 00 02 bf 07 15 01 00 00 00 00 02 c1 6d 15 01 00 00 00 00 02 c4 24 15 01 00 00 00 00 02 e3 00 15 01 00 00 00 00 02 ec 00 15 01 00 00 00 00 02 ff 10 15 01 00 00 00 00 02 bb 03 05 01 00 00 78 00 02 11 00 05 01 00 00 78 00 02 29 00];
						qcom,mdss-dsi-on-command-state = "dsi_lp_mode";
						qcom,mdss-dsi-panel-framerate = <0x3c>;
						qcom,mdss-dsi-panel-height = <0x780>;
						qcom,mdss-dsi-panel-timings = <0xe6382600 0x686e2a3c 0x44030400>;
						qcom,mdss-dsi-panel-width = <0x438>;
						qcom,mdss-dsi-v-back-porch = <0x02>;
						qcom,mdss-dsi-v-bottom-border = <0x00>;
						qcom,mdss-dsi-v-front-porch = <0x0c>;
						qcom,mdss-dsi-v-pulse-width = <0x02>;
						qcom,mdss-dsi-v-top-border = <0x00>;
					};
				};
			};
		};
	};

	fragment@17 {
		target = <0xffffffff>;

		__overlay__ {

			qcom,mdss_dsi_nt35695b_truly_fhd_cmd {
				phandle = <0x16>;
				qcom,mdss-dsi-bl-max-level = <0xfff>;
				qcom,mdss-dsi-bl-min-level = <0x01>;
				qcom,mdss-dsi-bl-pmic-control-type = "bl_ctrl_wled";
				qcom,mdss-dsi-bllp-eof-power-mode;
				qcom,mdss-dsi-bllp-power-mode;
				qcom,mdss-dsi-border-color = <0x00>;
				qcom,mdss-dsi-bpp = <0x18>;
				qcom,mdss-dsi-dma-trigger = "trigger_sw";
				qcom,mdss-dsi-lane-0-state;
				qcom,mdss-dsi-lane-1-state;
				qcom,mdss-dsi-lane-2-state;
				qcom,mdss-dsi-lane-3-state;
				qcom,mdss-dsi-mdp-trigger = "none";
				qcom,mdss-dsi-panel-name = "nt35695b truly fhd command mode dsi panel";
				qcom,mdss-dsi-panel-type = "dsi_cmd_mode";
				qcom,mdss-dsi-post-init-delay = <0x01>;
				qcom,mdss-dsi-reset-sequence = <0x01 0x0a 0x00 0x0a 0x01 0x0a>;
				qcom,mdss-dsi-stream = <0x00>;
				qcom,mdss-dsi-t-clk-post = <0x0d>;
				qcom,mdss-dsi-t-clk-pre = <0x2f>;
				qcom,mdss-dsi-te-check-enable;
				qcom,mdss-dsi-te-dcs-command = <0x01>;
				qcom,mdss-dsi-te-pin-select = <0x01>;
				qcom,mdss-dsi-te-using-te-pin;
				qcom,mdss-dsi-traffic-mode = "burst_mode";
				qcom,mdss-dsi-tx-eot-append;
				qcom,mdss-dsi-underflow-color = <0xff>;
				qcom,mdss-dsi-virtual-channel-id = <0x00>;
				qcom,ulps-enabled;

				qcom,mdss-dsi-display-timings {

					timing@0 {
						qcom,mdss-dsi-h-back-porch = <0x3c>;
						qcom,mdss-dsi-h-front-porch = <0x78>;
						qcom,mdss-dsi-h-left-border = <0x00>;
						qcom,mdss-dsi-h-pulse-width = <0x0c>;
						qcom,mdss-dsi-h-right-border = <0x00>;
						qcom,mdss-dsi-h-sync-pulse = <0x00>;
						qcom,mdss-dsi-h-sync-skew = <0x00>;
						qcom,mdss-dsi-off-command = [05 01 00 00 14 00 02 28 00 05 01 00 00 78 00 02 10 00];
						qcom,mdss-dsi-off-command-state = "dsi_lp_mode";
						qcom,mdss-dsi-on-command = [15 01 00 00 10 00 02 ff 20 15 01 00 00 00 00 02 fb 01 15 01 00 00 00 00 02 00 01 15 01 00 00 00 00 02 01 55 15 01 00 00 00 00 02 02 45 15 01 00 00 00 00 02 03 55 15 01 00 00 00 00 02 05 50 15 01 00 00 00 00 02 06 a8 15 01 00 00 00 00 02 07 ad 15 01 00 00 00 00 02 08 0c 15 01 00 00 00 00 02 0b aa 15 01 00 00 00 00 02 0c aa 15 01 00 00 00 00 02 0e b0 15 01 00 00 00 00 02 0f b3 15 01 00 00 00 00 02 11 28 15 01 00 00 00 00 02 12 10 15 01 00 00 00 00 02 13 01 15 01 00 00 00 00 02 14 4a 15 01 00 00 00 00 02 15 12 15 01 00 00 00 00 02 16 12 15 01 00 00 00 00 02 30 01 15 01 00 00 00 00 02 72 11 15 01 00 00 00 00 02 58 82 15 01 00 00 00 00 02 59 00 15 01 00 00 00 00 02 5a 02 15 01 00 00 00 00 02 5b 00 15 01 00 00 00 00 02 5c 82 15 01 00 00 00 00 02 5d 80 15 01 00 00 00 00 02 5e 02 15 01 00 00 00 00 02 5f 00 15 01 00 00 00 00 02 ff 24 15 01 00 00 00 00 02 fb 01 15 01 00 00 00 00 02 00 01 15 01 00 00 00 00 02 01 0b 15 01 00 00 00 00 02 02 0c 15 01 00 00 00 00 02 03 89 15 01 00 00 00 00 02 04 8a 15 01 00 00 00 00 02 05 0f 15 01 00 00 00 00 02 06 10 15 01 00 00 00 00 02 07 10 15 01 00 00 00 00 02 08 1c 15 01 00 00 00 00 02 09 00 15 01 00 00 00 00 02 0a 00 15 01 00 00 00 00 02 0b 00 15 01 00 00 00 00 02 0c 00 15 01 00 00 00 00 02 0d 13 15 01 00 00 00 00 02 0e 15 15 01 00 00 00 00 02 0f 17 15 01 00 00 00 00 02 10 01 15 01 00 00 00 00 02 11 0b 15 01 00 00 00 00 02 12 0c 15 01 00 00 00 00 02 13 89 15 01 00 00 00 00 02 14 8a 15 01 00 00 00 00 02 15 0f 15 01 00 00 00 00 02 16 10 15 01 00 00 00 00 02 17 10 15 01 00 00 00 00 02 18 1c 15 01 00 00 00 00 02 19 00 15 01 00 00 00 00 02 1a 00 15 01 00 00 00 00 02 1b 00 15 01 00 00 00 00 02 1c 00 15 01 00 00 00 00 02 1d 13 15 01 00 00 00 00 02 1e 15 15 01 00 00 00 00 02 1f 17 15 01 00 00 00 00 02 20 00 15 01 00 00 00 00 02 21 01 15 01 00 00 00 00 02 22 00 15 01 00 00 00 00 02 23 40 15 01 00 00 00 00 02 24 40 15 01 00 00 00 00 02 25 6d 15 01 00 00 00 00 02 26 40 15 01 00 00 00 00 02 27 40 15 01 00 00 00 00 02 29 d8 15 01 00 00 00 00 02 2a 2a 15 01 00 00 00 00 02 4b 03 15 01 00 00 00 00 02 4c 11 15 01 00 00 00 00 02 4d 10 15 01 00 00 00 00 02 4e 01 15 01 00 00 00 00 02 4f 01 15 01 00 00 00 00 02 50 10 15 01 00 00 00 00 02 51 00 15 01 00 00 00 00 02 52 80 15 01 00 00 00 00 02 53 00 15 01 00 00 00 00 02 54 07 15 01 00 00 00 00 02 55 25 15 01 00 00 00 00 02 56 00 15 01 00 00 00 00 02 58 07 15 01 00 00 00 00 02 5b 43 15 01 00 00 00 00 02 5c 00 15 01 00 00 00 00 02 5f 73 15 01 00 00 00 00 02 60 73 15 01 00 00 00 00 02 63 22 15 01 00 00 00 00 02 64 00 15 01 00 00 00 00 02 67 08 15 01 00 00 00 00 02 68 04 15 01 00 00 00 00 02 7a 80 15 01 00 00 00 00 02 7b 91 15 01 00 00 00 00 02 7c d8 15 01 00 00 00 00 02 7d 60 15 01 00 00 00 00 02 93 06 15 01 00 00 00 00 02 94 06 15 01 00 00 00 00 02 8a 00 15 01 00 00 00 00 02 9b 0f 15 01 00 00 00 00 02 b3 c0 15 01 00 00 00 00 02 b4 00 15 01 00 00 00 00 02 b5 00 15 01 00 00 00 00 02 b6 21 15 01 00 00 00 00 02 b7 22 15 01 00 00 00 00 02 b8 07 15 01 00 00 00 00 02 b9 07 15 01 00 00 00 00 02 ba 22 15 01 00 00 00 00 02 bd 20 15 01 00 00 00 00 02 be 07 15 01 00 00 00 00 02 bf 07 15 01 00 00 00 00 02 c1 6d 15 01 00 00 00 00 02 c4 24 15 01 00 00 00 00 02 e3 00 15 01 00 00 00 00 02 ec 00 15 01 00 00 00 00 02 ff 10 15 01 00 00 00 00 02 bb 10 15 01 00 00 00 00 02 35 00 05 01 00 00 78 00 02 11 00 05 01 00 00 78 00 02 29 00];
						qcom,mdss-dsi-on-command-state = "dsi_lp_mode";
						qcom,mdss-dsi-panel-framerate = <0x3c>;
						qcom,mdss-dsi-panel-height = <0x780>;
						qcom,mdss-dsi-panel-timings = <0xe6382600 0x686e2a3c 0x44030400>;
						qcom,mdss-dsi-panel-width = <0x438>;
						qcom,mdss-dsi-v-back-porch = <0x02>;
						qcom,mdss-dsi-v-bottom-border = <0x00>;
						qcom,mdss-dsi-v-front-porch = <0x0c>;
						qcom,mdss-dsi-v-pulse-width = <0x02>;
						qcom,mdss-dsi-v-top-border = <0x00>;
					};
				};
			};
		};
	};

	fragment@18 {
		target = <0xffffffff>;

		__overlay__ {

			qcom,mdss_dsi_icn9706_720_1440p_video {
				phandle = <0x17>;
				qcom,esd-check-enabled;
				qcom,mdss-dsi-bl-max-level = <0xfff>;
				qcom,mdss-dsi-bl-min-level = <0x01>;
				qcom,mdss-dsi-bl-pmic-control-type = "bl_ctrl_wled";
				qcom,mdss-dsi-bllp-eof-power-mode;
				qcom,mdss-dsi-bllp-power-mode;
				qcom,mdss-dsi-border-color = <0x00>;
				qcom,mdss-dsi-bpp = <0x18>;
				qcom,mdss-dsi-dma-trigger = "trigger_sw";
				qcom,mdss-dsi-h-back-porch = <0x54>;
				qcom,mdss-dsi-h-front-porch = <0x54>;
				qcom,mdss-dsi-h-left-border = <0x00>;
				qcom,mdss-dsi-h-pulse-width = <0x18>;
				qcom,mdss-dsi-h-right-border = <0x00>;
				qcom,mdss-dsi-h-sync-pulse = <0x01>;
				qcom,mdss-dsi-h-sync-skew = <0x00>;
				qcom,mdss-dsi-lane-0-state;
				qcom,mdss-dsi-lane-1-state;
				qcom,mdss-dsi-lane-2-state;
				qcom,mdss-dsi-lane-3-state;
				qcom,mdss-dsi-lane-map = "lane_map_0123";
				qcom,mdss-dsi-mdp-trigger = "none";
				qcom,mdss-dsi-off-command = [05 01 00 00 32 00 02 28 00 05 01 00 00 32 00 02 10 00];
				qcom,mdss-dsi-off-command-state = "dsi_lp_mode";
				qcom,mdss-dsi-on-command = <0x39010000 0x64000201 0x390100 0x03 0xf05a5a39 0x1000000 0x3f15a 0x5a390100 0x03 0xf0b44b39 0x1000000 0x3b610 0x10390100 0x15 0xb40a0812 0x100e0c00 0x300 0x3030303 0x3030304 0x6390100 0x15 0xb30b0913 0x110f0d00 0x300 0x3030303 0x3030305 0x7390100 0x0d 0xb0543223 0x45444444 0x44600160 0x1390100 0x09 0xb1328402 0x83150157 0x1390100 0x02 0xb2333901 0x00 0x7bd5414 0x6a6a2019 0x39010000 0x12b7 0x1010911 0xd15190d 0x211d0000 0x200002ff 0x3c390100 0x06 0xb8230130 0x34533901 0x00 0x5b9a12c 0xffc43901 0x00 0x3ba8823 0x39010000 0x7c1 0x1616040c 0x10043901 0x00 0x3c21268 0x39010000 0x4c3 0x22310439 0x1000000 0x6c705 0x236b4100 0x39010000 0x27c8 0x7c543d2d 0x26161b08 0x25282d4f 0x3e483d3d 0x3525067c 0x543d2d26 0x161b0825 0x282d4f3e 0x483d3d35 0x25063901 0x00 0x9c60000 0x68000060 0x36000501 0x6400 0x2110005 0x1000032 0x22900>;
				qcom,mdss-dsi-on-command-state = "dsi_lp_mode";
				qcom,mdss-dsi-pan-enable-dynamic-fps;
				qcom,mdss-dsi-pan-fps-update = "dfps_immediate_porch_mode_vfp";
				qcom,mdss-dsi-panel-controller = <0xffffffff>;
				qcom,mdss-dsi-panel-destination = "display_1";
				qcom,mdss-dsi-panel-framerate = <0x3c>;
				qcom,mdss-dsi-panel-height = <0x5a0>;
				qcom,mdss-dsi-panel-name = "icn9706 720 1440p video mode dsi panel";
				qcom,mdss-dsi-panel-status-check-mode = "bta_check";
				qcom,mdss-dsi-panel-timings = <0x8b1e1400 0x44481822 0x19030400>;
				qcom,mdss-dsi-panel-type = "dsi_video_mode";
				qcom,mdss-dsi-panel-width = <0x2d0>;
				qcom,mdss-dsi-reset-sequence = <0x01 0x02 0x00 0x14 0x01 0x32>;
				qcom,mdss-dsi-stream = <0x00>;
				qcom,mdss-dsi-t-clk-post = <0x04>;
				qcom,mdss-dsi-t-clk-pre = <0x1c>;
				qcom,mdss-dsi-traffic-mode = "burst_mode";
				qcom,mdss-dsi-tx-eot-append;
				qcom,mdss-dsi-underflow-color = <0xff>;
				qcom,mdss-dsi-v-back-porch = <0x14>;
				qcom,mdss-dsi-v-bottom-border = <0x00>;
				qcom,mdss-dsi-v-front-porch = <0x18>;
				qcom,mdss-dsi-v-pulse-width = <0x08>;
				qcom,mdss-dsi-v-top-border = <0x00>;
				qcom,mdss-dsi-virtual-channel-id = <0x00>;
				qcom,mdss-pan-physical-height-dimension = <0x70>;
				qcom,mdss-pan-physical-width-dimension = <0x3f>;
				qcom,panel-supply-entries = <0x06>;
			};
		};
	};

	fragment@19 {
		target = <0xffffffff>;

		__overlay__ {

			qcom,mdss_dsi_ili9881c_hdplus_video {
				phandle = <0x18>;
				qcom,mdss-dsi-bl-max-level = <0xff>;
				qcom,mdss-dsi-bl-min-level = <0x01>;
				qcom,mdss-dsi-bl-pmic-control-type = "bl_mount";
				qcom,mdss-dsi-bllp-eof-power-mode;
				qcom,mdss-dsi-bllp-power-mode;
				qcom,mdss-dsi-border-color = <0x00>;
				qcom,mdss-dsi-bpp = <0x18>;
				qcom,mdss-dsi-h-back-porch = <0x50>;
				qcom,mdss-dsi-h-front-porch = <0x54>;
				qcom,mdss-dsi-h-left-border = <0x00>;
				qcom,mdss-dsi-h-pulse-width = <0x08>;
				qcom,mdss-dsi-h-right-border = <0x00>;
				qcom,mdss-dsi-h-sync-pulse = <0x01>;
				qcom,mdss-dsi-h-sync-skew = <0x00>;
				qcom,mdss-dsi-lane-0-state;
				qcom,mdss-dsi-lane-1-state;
				qcom,mdss-dsi-lane-2-state;
				qcom,mdss-dsi-lane-3-state;
				qcom,mdss-dsi-lane-map = "lane_map_0123";
				qcom,mdss-dsi-off-command = [29 01 00 00 00 00 04 ff 98 81 00 29 01 00 00 14 00 02 28 00 29 01 00 00 78 00 02 10 00];
				qcom,mdss-dsi-off-command-state = "dsi_lp_mode";
				qcom,mdss-dsi-on-command = [29 01 00 00 00 00 04 ff 98 81 00 29 01 00 00 78 00 02 11 00 29 01 00 00 00 00 02 35 00 29 01 00 00 14 00 02 29 00];
				qcom,mdss-dsi-on-command-state = "dsi_lp_mode";
				qcom,mdss-dsi-panel-controller = <0xffffffff>;
				qcom,mdss-dsi-panel-destination = "display_1";
				qcom,mdss-dsi-panel-framerate = <0x3c>;
				qcom,mdss-dsi-panel-height = <0x5f0>;
				qcom,mdss-dsi-panel-name = "ili9881c hdplus video mode dsi panel";
				qcom,mdss-dsi-panel-timings-phy-12nm = <0xa070a03 0x50308>;
				qcom,mdss-dsi-panel-type = "dsi_video_mode";
				qcom,mdss-dsi-panel-width = <0x2d0>;
				qcom,mdss-dsi-reset-sequence = <0x01 0x14 0x00 0x02 0x01 0x14>;
				qcom,mdss-dsi-stream = <0x00>;
				qcom,mdss-dsi-t-clk-post = <0x04>;
				qcom,mdss-dsi-t-clk-pre = <0x1c>;
				qcom,mdss-dsi-traffic-mode = "burst_mode";
				qcom,mdss-dsi-underflow-color = <0xff>;
				qcom,mdss-dsi-v-back-porch = <0x14>;
				qcom,mdss-dsi-v-bottom-border = <0x00>;
				qcom,mdss-dsi-v-front-porch = <0x0c>;
				qcom,mdss-dsi-v-pulse-width = <0x04>;
				qcom,mdss-dsi-v-top-border = <0x00>;
				qcom,mdss-dsi-virtual-channel-id = <0x00>;
				qcom,panel-supply-entries = <0x06>;
			};
		};
	};

	fragment@2 {
		target = <0xffffffff>;

		__overlay__ {
			pinctrl-0 = <0xffffffff>;
			pinctrl-names = "default";
			status = "ok";
		};
	};

	fragment@20 {
		target = <0xffffffff>;

		__overlay__ {

			qcom,mdss_dsi_ili9881c_hdplus_video_c3e {
				phandle = <0x19>;
				qcom,esd-check-enabled;
				qcom,mdss-brightness-max-level = <0x7ff>;
				qcom,mdss-brightness-max-level-factory = <0xff>;
				qcom,mdss-dsi-CABC_MOVIE_on-command = <0x29010000 0x4ff 0x98810029 0x1000000 0x25503>;
				qcom,mdss-dsi-CABC_STILL_on-command = <0x29010000 0x4ff 0x98810029 0x1000000 0x25502>;
				qcom,mdss-dsi-CABC_UI_on-command = <0x29010000 0x4ff 0x98810029 0x1000000 0x25501>;
				qcom,mdss-dsi-CABC_off-command = <0x29010000 0x4ff 0x98810029 0x1000000 0x25500>;
				qcom,mdss-dsi-CE_off-command = [29 01 00 00 00 00 04 ff 98 81 02 29 01 00 00 00 00 02 10 06 29 01 00 00 00 00 04 ff 98 81 00];
				qcom,mdss-dsi-CE_on-command = [29 01 00 00 00 00 04 ff 98 81 02 29 01 00 00 00 00 02 10 16 29 01 00 00 00 00 02 1a 07 29 01 00 00 00 00 02 1b 09 29 01 00 00 00 00 02 1c 0c 29 01 00 00 00 00 02 68 02 29 01 00 00 00 00 02 69 02 29 01 00 00 00 00 02 6a 02 29 01 00 00 00 00 02 6b 02 29 01 00 00 00 00 02 6c 02 29 01 00 00 00 00 02 6d 02 29 01 00 00 00 00 02 6e 02 29 01 00 00 00 00 02 6f 02 29 01 00 00 00 00 02 70 02 29 01 00 00 00 00 02 71 02 29 01 00 00 00 00 02 72 02 29 01 00 00 00 00 02 73 02 29 01 00 00 00 00 02 74 02 29 01 00 00 00 00 02 75 02 29 01 00 00 00 00 02 76 02 29 01 00 00 00 00 02 77 02 29 01 00 00 00 00 02 78 02 29 01 00 00 00 00 02 79 02 29 01 00 00 00 00 02 7a 02 29 01 00 00 00 00 02 7b 02 29 01 00 00 00 00 02 7c 02 29 01 00 00 00 00 02 7d 02 29 01 00 00 00 00 02 7e 02 29 01 00 00 00 00 02 7f 02 29 01 00 00 00 00 04 ff 98 81 00];
				qcom,mdss-dsi-bl-max-level = <0x7ff>;
				qcom,mdss-dsi-bl-min-level = <0x01>;
				qcom,mdss-dsi-bl-pmic-control-type = "bl_mount";
				qcom,mdss-dsi-bllp-eof-power-mode;
				qcom,mdss-dsi-bllp-power-mode;
				qcom,mdss-dsi-border-color = <0x00>;
				qcom,mdss-dsi-bpp = <0x18>;
				qcom,mdss-dsi-h-back-porch = <0xc0>;
				qcom,mdss-dsi-h-front-porch = <0xc0>;
				qcom,mdss-dsi-h-left-border = <0x00>;
				qcom,mdss-dsi-h-pulse-width = <0x10>;
				qcom,mdss-dsi-h-right-border = <0x00>;
				qcom,mdss-dsi-h-sync-pulse = <0x01>;
				qcom,mdss-dsi-h-sync-skew = <0x00>;
				qcom,mdss-dsi-lane-0-state;
				qcom,mdss-dsi-lane-1-state;
				qcom,mdss-dsi-lane-2-state;
				qcom,mdss-dsi-lane-3-state;
				qcom,mdss-dsi-lane-map = "lane_map_0123";
				qcom,mdss-dsi-off-command = [29 01 00 00 00 00 04 ff 98 81 00 29 01 00 00 14 00 02 28 00 29 01 00 00 78 00 02 10 00];
				qcom,mdss-dsi-off-command-state = "dsi_lp_mode";
				qcom,mdss-dsi-on-command = [29 01 00 00 00 00 04 ff 98 81 00 29 01 00 00 78 00 02 11 00 29 01 00 00 00 00 04 ff 98 81 02 29 01 00 00 00 00 02 06 10 29 01 00 00 00 00 02 07 00 29 01 00 00 00 00 04 ff 98 81 02 29 01 00 00 00 00 02 03 6e 29 01 00 00 00 00 02 04 16 29 01 00 00 00 00 02 05 11 29 01 00 00 00 00 02 00 25 29 01 00 00 00 00 02 01 32 29 01 00 00 00 00 02 36 be 29 01 00 00 00 00 02 33 b5 29 01 00 00 00 00 02 32 77 29 01 00 00 00 00 02 31 78 29 01 00 00 00 00 02 30 39 29 01 00 00 00 00 02 2f 3a 29 01 00 00 00 00 02 2e 3b 29 01 00 00 00 00 02 2d 3d 29 01 00 00 00 00 02 2c 3d 29 01 00 00 00 00 02 29 29 29 01 00 00 00 00 02 28 32 29 01 00 00 00 00 02 27 33 29 01 00 00 00 00 02 26 34 29 01 00 00 00 00 02 24 39 29 01 00 00 00 00 02 23 3c 29 01 00 00 00 00 02 22 3c 29 01 00 00 00 00 02 20 3e 29 01 00 00 00 00 04 ff 98 81 0b 29 01 00 00 00 00 02 07 a1 29 01 00 00 00 00 02 2d ff 29 01 00 00 00 00 02 2e ff 29 01 00 00 00 00 02 2f ff 29 01 00 00 00 00 02 28 90 29 01 00 00 00 00 04 ff 98 81 00 29 01 00 00 00 00 03 51 0f ff 29 01 00 00 00 00 02 53 2c 29 01 00 00 00 00 02 55 00 29 01 00 00 00 00 02 35 00 29 01 00 00 14 00 02 29 00];
				qcom,mdss-dsi-on-command-state = "dsi_lp_mode";
				qcom,mdss-dsi-panel-controller = <0xffffffff>;
				qcom,mdss-dsi-panel-destination = "display_1";
				qcom,mdss-dsi-panel-framerate = <0x3c>;
				qcom,mdss-dsi-panel-height = <0x5a0>;
				qcom,mdss-dsi-panel-max-error-count = <0x03>;
				qcom,mdss-dsi-panel-name = "ili9881c hdplus c3e video mode dsi panel";
				qcom,mdss-dsi-panel-status-check-mode = "reg_read";
				qcom,mdss-dsi-panel-status-command = <0x6010001 0x500010a>;
				qcom,mdss-dsi-panel-status-command-mode = "dsi_lp_mode";
				qcom,mdss-dsi-panel-status-read-length = <0x01>;
				qcom,mdss-dsi-panel-status-valid-params = <0x01>;
				qcom,mdss-dsi-panel-status-value = <0x9c>;
				qcom,mdss-dsi-panel-timings-phy-12nm = <0xa070603 0x50309>;
				qcom,mdss-dsi-panel-type = "dsi_video_mode";
				qcom,mdss-dsi-panel-width = <0x2d0>;
				qcom,mdss-dsi-post-init-delay = <0x01>;
				qcom,mdss-dsi-reset-sequence = <0x01 0x14 0x00 0x02 0x01 0x14>;
				qcom,mdss-dsi-stream = <0x00>;
				qcom,mdss-dsi-t-clk-post = <0x04>;
				qcom,mdss-dsi-t-clk-pre = <0x1c>;
				qcom,mdss-dsi-traffic-mode = "burst_mode";
				qcom,mdss-dsi-underflow-color = <0xff>;
				qcom,mdss-dsi-v-back-porch = <0x14>;
				qcom,mdss-dsi-v-bottom-border = <0x00>;
				qcom,mdss-dsi-v-front-porch = <0x14>;
				qcom,mdss-dsi-v-pulse-width = <0x08>;
				qcom,mdss-dsi-v-top-border = <0x00>;
				qcom,mdss-dsi-virtual-channel-id = <0x00>;
				qcom,mdss-pan-physical-height-dimension = <0x7c>;
				qcom,mdss-pan-physical-width-dimension = <0x3e>;
				qcom,panel-supply-entries = <0x06>;
			};
		};
	};

	fragment@21 {
		target = <0xffffffff>;

		__overlay__ {

			qcom,mdss_dsi_ili9881d_hdplus_video_c3e {
				phandle = <0x1a>;
				qcom,esd-check-enabled;
				qcom,mdss-brightness-max-level = <0x7ff>;
				qcom,mdss-brightness-max-level-factory = <0xff>;
				qcom,mdss-dsi-CABC_MOVIE_on-command = <0x29010000 0x4ff 0x98810029 0x1000000 0x25503>;
				qcom,mdss-dsi-CABC_STILL_on-command = <0x29010000 0x4ff 0x98810029 0x1000000 0x25502>;
				qcom,mdss-dsi-CABC_UI_on-command = <0x29010000 0x4ff 0x98810029 0x1000000 0x25501>;
				qcom,mdss-dsi-CABC_off-command = <0x29010000 0x4ff 0x98810029 0x1000000 0x25500>;
				qcom,mdss-dsi-bl-max-level = <0x7ff>;
				qcom,mdss-dsi-bl-min-level = <0x01>;
				qcom,mdss-dsi-bl-pmic-control-type = "bl_mount";
				qcom,mdss-dsi-bllp-eof-power-mode;
				qcom,mdss-dsi-bllp-power-mode;
				qcom,mdss-dsi-border-color = <0x00>;
				qcom,mdss-dsi-bpp = <0x18>;
				qcom,mdss-dsi-h-back-porch = <0xc0>;
				qcom,mdss-dsi-h-front-porch = <0xc0>;
				qcom,mdss-dsi-h-left-border = <0x00>;
				qcom,mdss-dsi-h-pulse-width = <0x10>;
				qcom,mdss-dsi-h-right-border = <0x00>;
				qcom,mdss-dsi-h-sync-pulse = <0x01>;
				qcom,mdss-dsi-h-sync-skew = <0x00>;
				qcom,mdss-dsi-lane-0-state;
				qcom,mdss-dsi-lane-1-state;
				qcom,mdss-dsi-lane-2-state;
				qcom,mdss-dsi-lane-3-state;
				qcom,mdss-dsi-lane-map = "lane_map_0123";
				qcom,mdss-dsi-off-command = [29 01 00 00 00 00 04 ff 98 81 00 29 01 00 00 14 00 02 28 00 29 01 00 00 78 00 02 10 00];
				qcom,mdss-dsi-off-command-state = "dsi_lp_mode";
				qcom,mdss-dsi-on-command = <0x29010000 0x4ff 0x98810029 0x1000078 0x21100 0x29010000 0x4ff 0x98810229 0x1000000 0x20330 0x29010000 0x204 0x290100 0x04 0xff988102 0x29010000 0x200 0x16290100 0x02 0x1162901 0x00 0x2021629 0x1000000 0x20525 0x29010000 0x206 0x82290100 0x02 0x7a12901 0x00 0x211f629 0x1000000 0x2140d 0x29010000 0x215 0xf290100 0x02 0x16102901 0x00 0x2171129 0x1000000 0x21812 0x29010000 0x219 0x13290100 0x02 0x1a152901 0x00 0x21b1529 0x1000000 0x21e01 0x29010000 0x21f 0xa290100 0x02 0x200b2901 0x00 0x2210c29 0x1000000 0x22311 0x29010000 0x224 0x14290100 0x02 0x25142901 0x00 0x2279629 0x1000000 0x22dff 0x29010000 0x22e 0xff290100 0x02 0x2fff2901 0x00 0x2289029 0x1000000 0x4ff98 0x81042901 0x00 0x23a2429 0x1000000 0x4ff98 0x81002901 0x00 0x3510fff 0x29010000 0x253 0x2c290100 0x02 0x55002901 0x00 0x2350029 0x1000014 0x22900>;
				qcom,mdss-dsi-on-command-state = "dsi_lp_mode";
				qcom,mdss-dsi-panel-controller = <0xffffffff>;
				qcom,mdss-dsi-panel-destination = "display_1";
				qcom,mdss-dsi-panel-framerate = <0x3c>;
				qcom,mdss-dsi-panel-height = <0x5a0>;
				qcom,mdss-dsi-panel-max-error-count = <0x03>;
				qcom,mdss-dsi-panel-name = "ili9881d hdplus c3e video mode dsi panel";
				qcom,mdss-dsi-panel-status-check-mode = "reg_read";
				qcom,mdss-dsi-panel-status-command = <0x6010001 0x500010a>;
				qcom,mdss-dsi-panel-status-command-mode = "dsi_lp_mode";
				qcom,mdss-dsi-panel-status-read-length = <0x01>;
				qcom,mdss-dsi-panel-status-valid-params = <0x01>;
				qcom,mdss-dsi-panel-status-value = <0x9c>;
				qcom,mdss-dsi-panel-timings-phy-12nm = <0xa070603 0x50309>;
				qcom,mdss-dsi-panel-type = "dsi_video_mode";
				qcom,mdss-dsi-panel-width = <0x2d0>;
				qcom,mdss-dsi-post-init-delay = <0x01>;
				qcom,mdss-dsi-reset-sequence = <0x01 0x14 0x00 0x02 0x01 0x14>;
				qcom,mdss-dsi-stream = <0x00>;
				qcom,mdss-dsi-t-clk-post = <0x04>;
				qcom,mdss-dsi-t-clk-pre = <0x1c>;
				qcom,mdss-dsi-traffic-mode = "burst_mode";
				qcom,mdss-dsi-underflow-color = <0xff>;
				qcom,mdss-dsi-v-back-porch = <0x14>;
				qcom,mdss-dsi-v-bottom-border = <0x00>;
				qcom,mdss-dsi-v-front-porch = <0x14>;
				qcom,mdss-dsi-v-pulse-width = <0x08>;
				qcom,mdss-dsi-v-top-border = <0x00>;
				qcom,mdss-dsi-virtual-channel-id = <0x00>;
				qcom,mdss-pan-physical-height-dimension = <0x7c>;
				qcom,mdss-pan-physical-width-dimension = <0x3e>;
				qcom,panel-supply-entries = <0x06>;
			};
		};
	};

	fragment@22 {
		target = <0xffffffff>;

		__overlay__ {

			qcom,mdss_dsi_jd9365z_hdplus_video_c3e {
				phandle = <0x1b>;
				qcom,esd-check-enabled;
				qcom,mdss-brightness-max-level = <0x7ff>;
				qcom,mdss-brightness-max-level-factory = <0xff>;
				qcom,mdss-dsi-CABC_MOVIE_on-command = [29 01 00 00 00 00 02 de 01 29 01 00 00 00 00 02 bb 00 29 01 00 00 00 00 02 de 02 29 01 00 00 1e 00 02 d4 05 29 01 00 00 00 00 02 55 f3 29 01 00 00 00 00 02 53 2c 29 01 00 00 00 00 02 51 ff 29 01 00 00 00 00 02 de 01 29 01 00 00 00 00 02 bb 55 29 01 00 00 00 00 03 b5 06 02 29 01 00 00 00 00 02 b6 00 29 01 00 00 00 00 12 b7 00 66 7e 92 a2 b2 cf ed f6 ff 66 c0 80 34 01 12 0f 29 01 00 00 00 00 02 de 02 29 01 00 00 00 00 02 d2 00 29 01 00 00 00 00 04 ed 11 5b 2d 29 01 00 00 00 00 02 de 00];
				qcom,mdss-dsi-CABC_STILL_on-command = [29 01 00 00 00 00 02 de 01 29 01 00 00 00 00 02 bb 00 29 01 00 00 00 00 02 de 02 29 01 00 00 1e 00 02 d4 05 29 01 00 00 00 00 02 55 f2 29 01 00 00 00 00 02 53 2c 29 01 00 00 00 00 02 51 ff 29 01 00 00 00 00 02 de 01 29 01 00 00 00 00 02 bb 55 29 01 00 00 00 00 03 b5 06 02 29 01 00 00 00 00 02 b6 00 29 01 00 00 00 00 12 b7 00 b2 c0 cd ce d9 e4 ee f7 ff 66 c0 80 34 01 12 0f 29 01 00 00 00 00 02 de 02 29 01 00 00 00 00 02 d2 00 29 01 00 00 00 00 04 ed 11 5b 2d 29 01 00 00 00 00 02 de 00];
				qcom,mdss-dsi-CABC_UI_on-command = [29 01 00 00 00 00 02 de 01 29 01 00 00 00 00 02 bb 00 29 01 00 00 00 00 02 de 02 29 01 00 00 1e 00 02 d4 05 29 01 00 00 00 00 02 55 f1 29 01 00 00 00 00 02 53 2c 29 01 00 00 00 00 02 51 ff 29 01 00 00 00 00 02 de 01 29 01 00 00 00 00 02 bb 55 29 01 00 00 00 00 03 b5 06 02 29 01 00 00 00 00 02 b6 00 29 01 00 00 00 00 12 b7 00 e5 e7 ea ee f2 f5 f8 fc ff 66 c0 80 34 01 12 0f 29 01 00 00 00 00 02 de 02 29 01 00 00 00 00 02 d2 00 29 01 00 00 00 00 04 ed 11 5b 2d 29 01 00 00 00 00 02 de 00];
				qcom,mdss-dsi-CABC_off-command = [29 01 00 00 00 00 02 55 f0];
				qcom,mdss-dsi-CE_off-command = [29 01 00 00 00 00 02 de 01 29 01 00 00 00 00 02 b2 00 29 01 00 00 00 00 02 de 00];
				qcom,mdss-dsi-CE_on-command = [29 01 00 00 00 00 02 de 01 29 01 00 00 00 00 02 b0 00 29 01 00 00 00 00 02 b2 01 29 01 00 00 00 00 24 b3 03 45 30 20 30 05 50 0f ff ff ff 17 13 14 19 1c 18 16 16 17 19 1b 1e 1b 17 14 14 14 12 14 15 16 18 18 17 29 01 00 00 00 00 02 de 00];
				qcom,mdss-dsi-bl-max-level = <0x7ff>;
				qcom,mdss-dsi-bl-min-level = <0x01>;
				qcom,mdss-dsi-bl-pmic-control-type = "bl_mount";
				qcom,mdss-dsi-bllp-eof-power-mode;
				qcom,mdss-dsi-bllp-power-mode;
				qcom,mdss-dsi-border-color = <0x00>;
				qcom,mdss-dsi-bpp = <0x18>;
				qcom,mdss-dsi-h-back-porch = <0x14>;
				qcom,mdss-dsi-h-front-porch = <0x1e>;
				qcom,mdss-dsi-h-left-border = <0x00>;
				qcom,mdss-dsi-h-pulse-width = <0x14>;
				qcom,mdss-dsi-h-right-border = <0x00>;
				qcom,mdss-dsi-h-sync-pulse = <0x01>;
				qcom,mdss-dsi-h-sync-skew = <0x00>;
				qcom,mdss-dsi-lane-0-state;
				qcom,mdss-dsi-lane-1-state;
				qcom,mdss-dsi-lane-2-state;
				qcom,mdss-dsi-lane-3-state;
				qcom,mdss-dsi-lane-map = "lane_map_0123";
				qcom,mdss-dsi-off-command = [29 01 00 00 00 00 04 df 93 65 f8 29 01 00 00 14 00 02 28 00 29 01 00 00 78 00 02 10 00];
				qcom,mdss-dsi-off-command-state = "dsi_lp_mode";
				qcom,mdss-dsi-on-command = [29 01 00 00 00 00 04 df 93 65 f8 29 01 00 00 00 00 02 51 ff 29 01 00 00 00 00 02 53 2c 29 01 00 00 00 00 02 55 00 29 01 00 00 78 00 02 11 00 29 01 00 00 00 00 02 35 00 29 01 00 00 1e 00 02 29 00];
				qcom,mdss-dsi-on-command-state = "dsi_lp_mode";
				qcom,mdss-dsi-panel-controller = <0xffffffff>;
				qcom,mdss-dsi-panel-destination = "display_1";
				qcom,mdss-dsi-panel-framerate = <0x3c>;
				qcom,mdss-dsi-panel-height = <0x5a0>;
				qcom,mdss-dsi-panel-max-error-count = <0x03>;
				qcom,mdss-dsi-panel-name = "jd9365z hdplus c3e video mode dsi panel";
				qcom,mdss-dsi-panel-status-check-mode = "reg_read";
				qcom,mdss-dsi-panel-status-command = <0x6010001 0x500010a>;
				qcom,mdss-dsi-panel-status-command-mode = "dsi_lp_mode";
				qcom,mdss-dsi-panel-status-read-length = <0x01>;
				qcom,mdss-dsi-panel-status-valid-params = <0x01>;
				qcom,mdss-dsi-panel-status-value = <0x1c>;
				qcom,mdss-dsi-panel-timings-phy-12nm = <0x8060502 0x50208>;
				qcom,mdss-dsi-panel-type = "dsi_video_mode";
				qcom,mdss-dsi-panel-width = <0x2d0>;
				qcom,mdss-dsi-post-init-delay = <0x01>;
				qcom,mdss-dsi-reset-sequence = <0x01 0x05 0x00 0x0a 0x01 0x78>;
				qcom,mdss-dsi-stream = <0x00>;
				qcom,mdss-dsi-t-clk-post = <0x04>;
				qcom,mdss-dsi-t-clk-pre = <0x1a>;
				qcom,mdss-dsi-traffic-mode = "burst_mode";
				qcom,mdss-dsi-underflow-color = <0xff>;
				qcom,mdss-dsi-v-back-porch = <0x10>;
				qcom,mdss-dsi-v-bottom-border = <0x00>;
				qcom,mdss-dsi-v-front-porch = <0x08>;
				qcom,mdss-dsi-v-pulse-width = <0x02>;
				qcom,mdss-dsi-v-top-border = <0x00>;
				qcom,mdss-dsi-virtual-channel-id = <0x00>;
				qcom,mdss-pan-physical-height-dimension = <0x7c>;
				qcom,mdss-pan-physical-width-dimension = <0x3e>;
				qcom,panel-supply-entries = <0x06>;
			};
		};
	};

	fragment@23 {
		target = <0xffffffff>;

		__overlay__ {

			qcom,mdss_dsi_ili9881h_hdplus_video_c3i {
				phandle = <0x1c>;
				qcom,esd-check-enabled;
				qcom,mdss-brightness-max-level = <0x7ff>;
				qcom,mdss-brightness-max-level-factory = <0xff>;
				qcom,mdss-dsi-CABC_MOVIE_on-command = <0x29010000 0x4ff 0x98810029 0x1000000 0x25502>;
				qcom,mdss-dsi-CABC_STILL_on-command = <0x29010000 0x4ff 0x98810029 0x1000000 0x25503>;
				qcom,mdss-dsi-CABC_UI_on-command = <0x29010000 0x4ff 0x98810029 0x1000000 0x25501>;
				qcom,mdss-dsi-CABC_off-command = <0x29010000 0x4ff 0x98810029 0x1000000 0x25500>;
				qcom,mdss-dsi-CE_off-command = <0x29010000 0x4ff 0x98810429 0x1000000 0x20083 0x29010000 0x202 0x40290100 0x04 0xff988100>;
				qcom,mdss-dsi-CE_on-command = <0x29010000 0x4ff 0x98810429 0x1000000 0x20083 0x29010000 0x202 0x45290100 0x04 0xff988100>;
				qcom,mdss-dsi-bl-max-level = <0x7ff>;
				qcom,mdss-dsi-bl-min-level = <0x01>;
				qcom,mdss-dsi-bl-pmic-control-type = "bl_mount";
				qcom,mdss-dsi-bllp-eof-power-mode;
				qcom,mdss-dsi-bllp-power-mode;
				qcom,mdss-dsi-border-color = <0x00>;
				qcom,mdss-dsi-bpp = <0x18>;
				qcom,mdss-dsi-h-back-porch = <0x4c>;
				qcom,mdss-dsi-h-front-porch = <0x4c>;
				qcom,mdss-dsi-h-left-border = <0x00>;
				qcom,mdss-dsi-h-pulse-width = <0x20>;
				qcom,mdss-dsi-h-right-border = <0x00>;
				qcom,mdss-dsi-h-sync-pulse = <0x01>;
				qcom,mdss-dsi-h-sync-skew = <0x00>;
				qcom,mdss-dsi-lane-0-state;
				qcom,mdss-dsi-lane-1-state;
				qcom,mdss-dsi-lane-2-state;
				qcom,mdss-dsi-lane-3-state;
				qcom,mdss-dsi-lane-map = "lane_map_0123";
				qcom,mdss-dsi-lp11-init;
				qcom,mdss-dsi-off-command = [29 01 00 00 00 00 04 ff 98 81 00 29 01 00 00 14 00 02 28 00 29 01 00 00 78 00 02 10 00];
				qcom,mdss-dsi-off-command-state = "dsi_lp_mode";
				qcom,mdss-dsi-on-command = <0x29010000 0x4ff 0x98810029 0x1000078 0x21100 0x29010000 0x351 0xffe2901 0x00 0x2532c29 0x1000000 0x25500 0x29010000 0x235 0x290100 0x04 0xff988106 0x29010000 0x23e 0x62290100 0x04 0xff988101 0x29010000 0x200 0x45290100 0x02 0x1322901 0x00 0x204c929 0x1000000 0x20512 0x29010000 0x208 0x81290100 0x02 0xa722901 0x00 0x20c0a29 0x1000000 0x20d0a 0x29010000 0x20e 0x3290100 0x02 0xf032901 0x00 0x2b03429 0x1000000 0x2b204 0x29010000 0x4ff 0x98810229 0x1000000 0x27308 0x29010000 0x240 0x49290100 0x04 0xff98810e 0x29010000 0x247 0x88290100 0x02 0x4e9f2901 0x00 0x24fa029 0x1000000 0x2464e 0x29010000 0x2d0 0x35290100 0x02 0xd9882901 0x00 0x2d89829 0x1000000 0x4ff98 0x810e2901 0x00 0x200a029 0x1000000 0x4ff98 0x81062901 0x00 0x2c70529 0x1000000 0x4ff98 0x81022901 0x00 0x2068829 0x1000000 0x4ff98 0x81052901 0x00 0x2cc7929 0x1000000 0x2cd79 0x29010000 0x2ce 0x79290100 0x02 0xcf792901 0x00 0x2d46b29 0x1000000 0x2d56b 0x29010000 0x2d6 0x6b290100 0x02 0xd76b2901 0x00 0x4ff9881 0x4290100 0x02 0x7072901 0x00 0x2080929 0x1000000 0x2090c 0x29010000 0x23c 0x12290100 0x02 0x3d112901 0x00 0x23e1129 0x1000000 0x23f01 0x29010000 0x240 0x1290100 0x02 0x41022901 0x00 0x2420329 0x1000000 0x24301 0x29010000 0x244 0x290100 0x02 0x45002901 0x00 0x2460129 0x1000000 0x24702 0x29010000 0x248 0x1290100 0x02 0x49022901 0x00 0x24a0929 0x1000000 0x24b06 0x29010000 0x24c 0x4290100 0x02 0x4d032901 0x00 0x24e0129 0x1000000 0x24f11 0x29010000 0x250 0x11290100 0x02 0x51112901 0x00 0x2521229 0x1000000 0x25312 0x29010000 0x20a 0x1290100 0x02 0xb012901 0x00 0x20c0129 0x1000000 0x20d03 0x29010000 0x20e 0x3290100 0x02 0xf022901 0x00 0x2100229 0x1000000 0x21102 0x29010000 0x212 0x2290100 0x02 0x13022901 0x00 0x2140229 0x1000000 0x21502 0x29010000 0x216 0x2290100 0x02 0x17022901 0x00 0x2180229 0x1000000 0x21902 0x29010000 0x21a 0x2290100 0x02 0x1b022901 0x00 0x21c0229 0x1000000 0x21d02 0x29010000 0x21e 0x2290100 0x02 0x1f022901 0x00 0x2200229 0x1000000 0x22101 0x29010000 0x4ff 0x98810329 0x1000000 0x28940 0x29010000 0x290 0x14290100 0x02 0x91f62901 0x00 0x2921629 0x1000000 0x293f7 0x29010000 0x294 0xe290100 0x02 0x950f2901 0x00 0x2961029 0x1000000 0x29711 0x29010000 0x298 0x12290100 0x02 0x99132901 0x00 0x29a1429 0x1000000 0x29b15 0x29010000 0x29c 0x16290100 0x02 0x9d162901 0x00 0x29e0229 0x1000000 0x29f04 0x29010000 0x2a0 0x7290100 0x02 0xa10a2901 0x00 0x2a20d29 0x1000000 0x2a30f 0x29010000 0x2a4 0x11290100 0x02 0xa5132901 0x00 0x2a69529 0x1000000 0x2a796 0x29010000 0x4ff 0x98810029 0x1000014 0x22900>;
				qcom,mdss-dsi-on-command-state = "dsi_lp_mode";
				qcom,mdss-dsi-panel-controller = <0xffffffff>;
				qcom,mdss-dsi-panel-destination = "display_1";
				qcom,mdss-dsi-panel-framerate = <0x3c>;
				qcom,mdss-dsi-panel-height = <0x5f0>;
				qcom,mdss-dsi-panel-max-error-count = <0x03>;
				qcom,mdss-dsi-panel-name = "ili9881h hdplus c3i video mode dsi panel";
				qcom,mdss-dsi-panel-status-check-mode = "reg_read";
				qcom,mdss-dsi-panel-status-command = <0x14010001 0x10a 0x14010001 0x10d>;
				qcom,mdss-dsi-panel-status-command-mode = "dsi_lp_mode";
				qcom,mdss-dsi-panel-status-read-length = <0x01 0x01>;
				qcom,mdss-dsi-panel-status-valid-params = <0x01>;
				qcom,mdss-dsi-panel-status-value = <0x9c 0x00>;
				qcom,mdss-dsi-panel-timings-phy-12nm = <0xb070603 0x50309>;
				qcom,mdss-dsi-panel-type = "dsi_video_mode";
				qcom,mdss-dsi-panel-width = <0x2d0>;
				qcom,mdss-dsi-reset-sequence = <0x01 0x14 0x00 0x02 0x01 0x14>;
				qcom,mdss-dsi-stream = <0x00>;
				qcom,mdss-dsi-t-clk-post = <0x60>;
				qcom,mdss-dsi-t-clk-pre = <0x06>;
				qcom,mdss-dsi-traffic-mode = "burst_mode";
				qcom,mdss-dsi-tx-eot-append;
				qcom,mdss-dsi-underflow-color = <0xff>;
				qcom,mdss-dsi-v-back-porch = <0x14>;
				qcom,mdss-dsi-v-bottom-border = <0x00>;
				qcom,mdss-dsi-v-front-porch = <0x29>;
				qcom,mdss-dsi-v-pulse-width = <0x04>;
				qcom,mdss-dsi-v-top-border = <0x00>;
				qcom,mdss-dsi-virtual-channel-id = <0x00>;
				qcom,mdss-pan-physical-height-dimension = <0x8f>;
				qcom,mdss-pan-physical-width-dimension = <0x44>;
				qcom,panel-supply-entries = <0x06>;
			};
		};
	};

	fragment@24 {
		target = <0xffffffff>;

		__overlay__ {

			qcom,mdss_dsi_nvt36525b_hdplus_video_c3i {
				phandle = <0x1d>;
				qcom,esd-check-enabled;
				qcom,mdss-brightness-max-level = <0x7ff>;
				qcom,mdss-brightness-max-level-factory = <0xff>;
				qcom,mdss-dsi-CABC_MOVIE_on-command = [29 00 00 00 00 00 02 ff 10 29 00 00 00 00 00 02 fb 01 29 01 00 00 00 00 02 55 83];
				qcom,mdss-dsi-CABC_STILL_on-command = [29 00 00 00 00 00 02 ff 10 29 00 00 00 00 00 02 fb 01 29 01 00 00 00 00 02 55 82];
				qcom,mdss-dsi-CABC_UI_on-command = [29 00 00 00 00 00 02 ff 10 29 00 00 00 00 00 02 fb 01 29 01 00 00 00 00 02 55 81];
				qcom,mdss-dsi-CABC_off-command = [29 00 00 00 00 00 02 ff 10 29 00 00 00 00 00 02 fb 01 29 01 00 00 00 00 02 55 80];
				qcom,mdss-dsi-CE_off-command = [29 00 00 00 00 00 02 ff 22 29 00 00 00 00 00 02 fb 01 29 00 00 00 00 00 02 53 00 29 01 00 00 00 00 02 54 00 29 01 00 00 00 00 02 ff 10];
				qcom,mdss-dsi-CE_on-command = [29 00 00 00 00 00 02 ff 22 29 00 00 00 00 00 02 fb 01 29 00 00 00 00 00 02 53 01 29 01 00 00 00 00 02 54 01 29 01 00 00 00 00 02 ff 10];
				qcom,mdss-dsi-bl-max-level = <0x7ff>;
				qcom,mdss-dsi-bl-min-level = <0x01>;
				qcom,mdss-dsi-bl-pmic-control-type = "bl_mount";
				qcom,mdss-dsi-bllp-eof-power-mode;
				qcom,mdss-dsi-bllp-power-mode;
				qcom,mdss-dsi-border-color = <0x00>;
				qcom,mdss-dsi-bpp = <0x18>;
				qcom,mdss-dsi-h-back-porch = <0x64>;
				qcom,mdss-dsi-h-front-porch = <0x65>;
				qcom,mdss-dsi-h-left-border = <0x00>;
				qcom,mdss-dsi-h-pulse-width = <0x08>;
				qcom,mdss-dsi-h-right-border = <0x00>;
				qcom,mdss-dsi-h-sync-pulse = <0x01>;
				qcom,mdss-dsi-h-sync-skew = <0x00>;
				qcom,mdss-dsi-lane-0-state;
				qcom,mdss-dsi-lane-1-state;
				qcom,mdss-dsi-lane-2-state;
				qcom,mdss-dsi-lane-3-state;
				qcom,mdss-dsi-lane-map = "lane_map_0123";
				qcom,mdss-dsi-off-command = <0x29010000 0x2ff 0x10290100 0x02 0xfb012901 0x1400 0x2280029 0x1000078 0x21000>;
				qcom,mdss-dsi-off-command-state = "dsi_lp_mode";
				qcom,mdss-dsi-on-command = <0x29010000 0x2ff 0x20290100 0x02 0xfb013901 0x00 0x11c00203 0x506080d 0xd0e0f10 0x12403824 0x242c3901 0x00 0x11c20203 0x506080d 0xd0e0f10 0x12123824 0x242c2901 0x00 0x2ff2329 0x1000000 0x2fb01 0x29010000 0x200 0x68290100 0x02 0x5122901 0x00 0x2060029 0x1000000 0x20720 0x29010000 0x208 0x1290100 0x02 0x9002901 0x00 0x212ab29 0x1000000 0x2157b 0x29010000 0x216 0xa290100 0x02 0x30ff2901 0x00 0x231fe29 0x1000000 0x232fc 0x29010000 0x233 0xfa290100 0x02 0x34f82901 0x00 0x235f629 0x1000000 0x236f4 0x29010000 0x237 0xf2290100 0x02 0x38f12901 0x00 0x239f029 0x1000000 0x23aef 0x29010000 0x23b 0xed290100 0x02 0x3deb2901 0x00 0x23fe929 0x1000000 0x240e7 0x29010000 0x241 0xe5290100 0x02 0x45ff2901 0x00 0x246fc29 0x1000000 0x247f6 0x29010000 0x248 0xec290100 0x02 0x49df2901 0x00 0x24acd29 0x1000000 0x24bc0 0x29010000 0x24c 0xb3290100 0x02 0x4da62901 0x00 0x24e9829 0x1000000 0x24f8f 0x29010000 0x250 0x86290100 0x02 0x517d2901 0x00 0x2527429 0x1000000 0x2536d 0x29010000 0x254 0x66290100 0x02 0x58ff2901 0x00 0x259fd29 0x1000000 0x25af9 0x29010000 0x25b 0xf2290100 0x02 0x5cec2901 0x00 0x25de629 0x1000000 0x25ede 0x29010000 0x25f 0xd9290100 0x02 0x60d22901 0x00 0x261cc29 0x1000000 0x262c7 0x29010000 0x263 0xc3290100 0x02 0x64be2901 0x00 0x265b929 0x1000000 0x266b5 0x29010000 0x267 0xb3290100 0x02 0xff222901 0x00 0x2fb0129 0x1000000 0x20104 0x29010000 0x202 0x8290100 0x02 0x30c2901 0x00 0x2041029 0x1000000 0x20514 0x29010000 0x206 0x18290100 0x02 0x7202901 0x00 0x2082429 0x1000000 0x20928 0x29010000 0x20a 0x30290100 0x02 0xb382901 0x00 0x20c3829 0x1000000 0x20d30 0x29010000 0x20e 0x28290100 0x02 0xf202901 0x00 0x2101029 0x1000000 0x21100 0x29010000 0x212 0x290100 0x02 0x13002901 0x00 0x21a0029 0x1000000 0x21b00 0x29010000 0x21c 0x4290100 0x02 0x1d082901 0x00 0x21e0c29 0x1000000 0x21f10 0x29010000 0x220 0x14290100 0x02 0x21182901 0x00 0x2222029 0x1000000 0x22318 0x29010000 0x224 0x10290100 0x02 0x25082901 0x00 0x2260029 0x1000000 0x22700 0x29010000 0x228 0x290100 0x02 0x29002901 0x00 0x22a0029 0x1000000 0x22b00 0x29010000 0x22f 0x290100 0x02 0x30002901 0x00 0x2311029 0x1000000 0x2329c 0x29010000 0x233 0x94290100 0x02 0x34942901 0x00 0x2351e29 0x1000000 0x23614 0x29010000 0x237 0x1e290100 0x02 0x381e2901 0x00 0x2391429 0x1000000 0x23a0a 0x29010000 0x23b 0xc290100 0x02 0x3f0e2901 0x00 0x2401529 0x1000000 0x2411b 0x29010000 0x242 0x20290100 0x02 0x43262901 0x00 0x2441e29 0x1000000 0x24517 0x29010000 0x246 0xf290100 0x02 0x47082901 0x00 0x2480a29 0x1000000 0x24912 0x29010000 0x24a 0x23290100 0x02 0x4b282901 0x00 0x24c9c29 0x1000000 0x24d00 0x29010000 0x253 0x290100 0x02 0x54002901 0x00 0x2550029 0x1000000 0x25676 0x29010000 0x268 0x76290100 0x02 0xa2202901 0x00 0x2ff2629 0x1000000 0x2fb01 0x29010000 0x245 0xe290100 0x02 0xff102901 0x00 0x2fb0129 0x1000000 0x25580 0x29010000 0x2ba 0x3290100 0x03 0x510fff29 0x1000000 0x2532c 0x29010000 0x14000229 0x290100 0x640002 0x11002901 0x00 0x2ff2529 0x1000000 0x2fb01 0x29010000 0x224 0xa7290100 0x02 0x46132901 0x00 0x2479429 0x1000000 0x2ff26 0x29010000 0x2fb 0x1290100 0x02 0x31112901 0x00 0x2321829 0x1000000 0x23667>;
				qcom,mdss-dsi-on-command-state = "dsi_lp_mode";
				qcom,mdss-dsi-panel-controller = <0xffffffff>;
				qcom,mdss-dsi-panel-destination = "display_1";
				qcom,mdss-dsi-panel-framerate = <0x3c>;
				qcom,mdss-dsi-panel-height = <0x5f0>;
				qcom,mdss-dsi-panel-max-error-count = <0x03>;
				qcom,mdss-dsi-panel-name = "nvt36525b hdplus c3i video mode dsi panel";
				qcom,mdss-dsi-panel-status-check-mode = "reg_read";
				qcom,mdss-dsi-panel-status-command = <0x6010001 0x500010a>;
				qcom,mdss-dsi-panel-status-command-mode = "dsi_lp_mode";
				qcom,mdss-dsi-panel-status-read-length = <0x01>;
				qcom,mdss-dsi-panel-status-valid-params = <0x01>;
				qcom,mdss-dsi-panel-status-value = <0x9c>;
				qcom,mdss-dsi-panel-timings-phy-12nm = <0xb070603 0x50309>;
				qcom,mdss-dsi-panel-type = "dsi_video_mode";
				qcom,mdss-dsi-panel-width = <0x2d0>;
				qcom,mdss-dsi-reset-sequence = <0x01 0x14 0x00 0x0a 0x01 0x14>;
				qcom,mdss-dsi-stream = <0x00>;
				qcom,mdss-dsi-t-clk-post = <0x60>;
				qcom,mdss-dsi-t-clk-pre = <0x06>;
				qcom,mdss-dsi-traffic-mode = "burst_mode";
				qcom,mdss-dsi-underflow-color = <0xff>;
				qcom,mdss-dsi-v-back-porch = <0x08>;
				qcom,mdss-dsi-v-bottom-border = <0x00>;
				qcom,mdss-dsi-v-front-porch = <0x0a>;
				qcom,mdss-dsi-v-pulse-width = <0x02>;
				qcom,mdss-dsi-v-top-border = <0x00>;
				qcom,mdss-dsi-virtual-channel-id = <0x00>;
				qcom,mdss-pan-physical-height-dimension = <0x8f>;
				qcom,mdss-pan-physical-width-dimension = <0x44>;
				qcom,panel-supply-entries = <0x06>;
			};
		};
	};

	fragment@25 {
		target = <0xffffffff>;

		__overlay__ {

			qcom,mdss_dsi_ft8006s_hdplus_video_c3i {
				phandle = <0x1e>;
				qcom,esd-check-enabled;
				qcom,mdss-brightness-max-level = <0x7ff>;
				qcom,mdss-brightness-max-level-factory = <0xff>;
				qcom,mdss-dsi-CABC_MOVIE_on-command = [15 01 00 00 00 00 02 55 03];
				qcom,mdss-dsi-CABC_STILL_on-command = [15 01 00 00 00 00 02 55 02];
				qcom,mdss-dsi-CABC_UI_on-command = [15 01 00 00 00 00 02 55 01];
				qcom,mdss-dsi-CABC_off-command = [15 01 00 00 00 00 02 55 00];
				qcom,mdss-dsi-CE_off-command = [15 01 00 00 00 00 02 90 00];
				qcom,mdss-dsi-CE_on-command = [15 01 00 00 00 00 02 90 01];
				qcom,mdss-dsi-bl-max-level = <0x7ff>;
				qcom,mdss-dsi-bl-min-level = <0x01>;
				qcom,mdss-dsi-bl-pmic-control-type = "bl_mount";
				qcom,mdss-dsi-bllp-eof-power-mode;
				qcom,mdss-dsi-bllp-power-mode;
				qcom,mdss-dsi-border-color = <0x00>;
				qcom,mdss-dsi-bpp = <0x18>;
				qcom,mdss-dsi-h-back-porch = <0x3c>;
				qcom,mdss-dsi-h-front-porch = <0x50>;
				qcom,mdss-dsi-h-left-border = <0x00>;
				qcom,mdss-dsi-h-pulse-width = <0x10>;
				qcom,mdss-dsi-h-right-border = <0x00>;
				qcom,mdss-dsi-h-sync-pulse = <0x01>;
				qcom,mdss-dsi-h-sync-skew = <0x00>;
				qcom,mdss-dsi-lane-0-state;
				qcom,mdss-dsi-lane-1-state;
				qcom,mdss-dsi-lane-2-state;
				qcom,mdss-dsi-lane-3-state;
				qcom,mdss-dsi-lane-map = "lane_map_0123";
				qcom,mdss-dsi-lp11-init;
				qcom,mdss-dsi-off-command = [05 01 00 00 14 00 01 28 05 01 00 00 0a 00 01 10 15 01 00 00 00 00 02 17 5a 15 01 00 00 96 00 02 18 5a];
				qcom,mdss-dsi-off-command-state = "dsi_lp_mode";
				qcom,mdss-dsi-on-command = [39 01 00 00 00 00 03 41 5a 24 39 01 00 00 00 00 02 8d 5a 39 01 00 00 00 00 03 41 5a 09 39 01 00 00 00 00 02 91 00 39 01 00 00 00 00 03 41 5a 15 39 01 00 00 00 00 02 ff 02 39 01 00 00 00 00 03 41 5a 16 39 01 00 00 00 00 05 80 05 85 82 02 39 01 00 00 00 00 03 41 5a 2f 39 01 00 00 00 00 02 19 00 39 01 00 00 00 00 02 4c 03 39 01 00 00 00 00 03 41 5a 19 39 01 00 00 00 00 03 a1 00 46 39 01 00 00 00 00 03 41 5a 19 39 01 00 00 00 00 11 80 e7 ce bc b5 a7 a1 98 93 8c 89 84 82 00 60 f6 6f 39 01 00 00 00 00 08 90 f6 2f f3 ef 6f bf 0f 39 01 00 00 00 00 03 41 5a 18 39 01 00 00 00 00 11 80 30 4a f9 dc 7b 0b ad 37 b8 68 19 6a ba 9a ba 7a 39 01 00 00 00 00 11 90 ea 19 49 68 49 e9 19 1a 0a fa 69 9a 2a 9a 79 09 39 01 00 00 00 00 0d a0 3a ba 19 2a ca 09 ca a9 88 48 48 09 05 01 00 00 78 00 01 11 05 01 00 00 0a 00 01 29 39 01 00 00 00 00 03 51 ff 0e 15 01 00 00 00 00 02 53 2c 15 01 00 00 00 00 02 55 00 15 01 00 00 00 00 02 35 00];
				qcom,mdss-dsi-on-command-state = "dsi_lp_mode";
				qcom,mdss-dsi-panel-controller = <0xffffffff>;
				qcom,mdss-dsi-panel-destination = "display_1";
				qcom,mdss-dsi-panel-framerate = <0x3c>;
				qcom,mdss-dsi-panel-height = <0x5f0>;
				qcom,mdss-dsi-panel-max-error-count = <0x03>;
				qcom,mdss-dsi-panel-name = "ft8006s hdplus c3i video mode dsi panel";
				qcom,mdss-dsi-panel-status-check-mode = "reg_read";
				qcom,mdss-dsi-panel-status-command = <0x6010001 0x500010a>;
				qcom,mdss-dsi-panel-status-command-mode = "dsi_lp_mode";
				qcom,mdss-dsi-panel-status-read-length = <0x01>;
				qcom,mdss-dsi-panel-status-valid-params = <0x01>;
				qcom,mdss-dsi-panel-status-value = <0x9c>;
				qcom,mdss-dsi-panel-timings-phy-12nm = <0xb070603 0x50309>;
				qcom,mdss-dsi-panel-type = "dsi_video_mode";
				qcom,mdss-dsi-panel-width = <0x2d0>;
				qcom,mdss-dsi-reset-sequence = <0x01 0x05 0x00 0x0a 0x01 0x2d>;
				qcom,mdss-dsi-stream = <0x00>;
				qcom,mdss-dsi-t-clk-post = <0x60>;
				qcom,mdss-dsi-t-clk-pre = <0x06>;
				qcom,mdss-dsi-traffic-mode = "burst_mode";
				qcom,mdss-dsi-underflow-color = <0xff>;
				qcom,mdss-dsi-v-back-porch = <0x25>;
				qcom,mdss-dsi-v-bottom-border = <0x00>;
				qcom,mdss-dsi-v-front-porch = <0x46>;
				qcom,mdss-dsi-v-pulse-width = <0x08>;
				qcom,mdss-dsi-v-top-border = <0x00>;
				qcom,mdss-dsi-virtual-channel-id = <0x00>;
				qcom,mdss-pan-physical-height-dimension = <0x8f>;
				qcom,mdss-pan-physical-width-dimension = <0x44>;
				qcom,panel-supply-entries = <0x06>;
			};
		};
	};

	fragment@26 {
		target = <0xffffffff>;

		__overlay__ {

			dsi_panel_pwr_supply {
				#address-cells = <0x01>;
				#size-cells = <0x00>;
				phandle = <0x06>;

				qcom,panel-supply-entry@0 {
					qcom,supply-disable-load = <0x64>;
					qcom,supply-enable-load = <0x186a0>;
					qcom,supply-max-voltage = <0x2b7cd0>;
					qcom,supply-min-voltage = <0x2b7cd0>;
					qcom,supply-name = "vdd";
					reg = <0x00>;
				};

				qcom,panel-supply-entry@1 {
					qcom,supply-disable-load = <0x64>;
					qcom,supply-enable-load = <0x186a0>;
					qcom,supply-max-voltage = <0x1b7740>;
					qcom,supply-min-voltage = <0x1b7740>;
					qcom,supply-name = "vddio";
					reg = <0x01>;
				};

				qcom,panel-supply-entry@2 {
					qcom,supply-disable-load = <0x64>;
					qcom,supply-enable-load = <0x186a0>;
					qcom,supply-max-voltage = <0x5b8d80>;
					qcom,supply-min-voltage = <0x4630c0>;
					qcom,supply-name = "lab";
					reg = <0x02>;
				};

				qcom,panel-supply-entry@3 {
					qcom,supply-disable-load = <0x64>;
					qcom,supply-enable-load = <0x186a0>;
					qcom,supply-max-voltage = <0x5b8d80>;
					qcom,supply-min-voltage = <0x4630c0>;
					qcom,supply-name = "ibb";
					qcom,supply-post-on-sleep = <0x0a>;
					reg = <0x03>;
				};
			};

			dsi_pm660_panel_pwr_supply {
				#address-cells = <0x01>;
				#size-cells = <0x00>;
				phandle = <0x1f>;

				qcom,panel-supply-entry@0 {
					qcom,supply-disable-load = <0x64>;
					qcom,supply-enable-load = <0x186a0>;
					qcom,supply-max-voltage = <0x2ab980>;
					qcom,supply-min-voltage = <0x2ab980>;
					qcom,supply-name = "vdd";
					reg = <0x00>;
				};

				qcom,panel-supply-entry@1 {
					qcom,supply-disable-load = <0x64>;
					qcom,supply-enable-load = <0x186a0>;
					qcom,supply-max-voltage = <0x1b7740>;
					qcom,supply-min-voltage = <0x1b7740>;
					qcom,supply-name = "vddio";
					reg = <0x01>;
				};
			};
		};
	};

	fragment@27 {
		target = <0xffffffff>;

		__overlay__ {
			qcom,mdss-pref-prim-intf = "dsi";
		};
	};

	fragment@28 {
		target = <0xffffffff>;

		__overlay__ {
			hw-config = "single_dsi";
		};
	};

	fragment@29 {
		target = <0xffffffff>;

		__overlay__ {
			pinctrl-0 = <0xffffffff 0xffffffff>;
			pinctrl-1 = <0xffffffff 0xffffffff>;
			pinctrl-names = "mdss_default\0mdss_sleep";
			qcom,dsi-pref-prim-pan = <0x07>;
			qcom,platform-bklight-en-gpio = <0xffffffff 0x62 0x00>;
			qcom,platform-reset-gpio = <0xffffffff 0x3c 0x00>;
			qcom,platform-te-gpio = <0xffffffff 0x18 0x00>;
		};
	};

	fragment@3 {
		target = <0xffffffff>;

		__overlay__ {

			qcom,mdss_dsi_sim_video {
				phandle = <0x09>;
				qcom,mdss-dsi-bllp-eof-power-mode;
				qcom,mdss-dsi-bllp-power-mode;
				qcom,mdss-dsi-border-color = <0x00>;
				qcom,mdss-dsi-bpp = <0x18>;
				qcom,mdss-dsi-dma-trigger = "trigger_sw";
				qcom,mdss-dsi-lane-0-state;
				qcom,mdss-dsi-lane-1-state;
				qcom,mdss-dsi-lane-2-state;
				qcom,mdss-dsi-lane-3-state;
				qcom,mdss-dsi-mdp-trigger = "none";
				qcom,mdss-dsi-panel-blackness-level = <0xc9e>;
				qcom,mdss-dsi-panel-hdr-color-primaries = <0x38a4 0x3c8c 0x7d00 0x4268 0x3c8c 0x7530 0x1f40 0xbb8>;
				qcom,mdss-dsi-panel-hdr-enabled;
				qcom,mdss-dsi-panel-name = "Simulator video mode dsi panel";
				qcom,mdss-dsi-panel-peak-brightness = <0x401640>;
				qcom,mdss-dsi-panel-type = "dsi_video_mode";
				qcom,mdss-dsi-reset-sequence = <0x01 0x00 0x00 0x00 0x01 0x00>;
				qcom,mdss-dsi-stream = <0x00>;
				qcom,mdss-dsi-t-clk-post = <0x04>;
				qcom,mdss-dsi-t-clk-pre = <0x1b>;
				qcom,mdss-dsi-traffic-mode = "non_burst_sync_event";
				qcom,mdss-dsi-underflow-color = <0xff>;
				qcom,mdss-dsi-virtual-channel-id = <0x00>;
				qcom,panel-ack-disabled;

				qcom,mdss-dsi-display-timings {

					timing@0 {
						qcom,mdss-dsi-h-back-porch = <0x08>;
						qcom,mdss-dsi-h-front-porch = <0x08>;
						qcom,mdss-dsi-h-left-border = <0x00>;
						qcom,mdss-dsi-h-pulse-width = <0x08>;
						qcom,mdss-dsi-h-right-border = <0x00>;
						qcom,mdss-dsi-h-sync-pulse = <0x00>;
						qcom,mdss-dsi-h-sync-skew = <0x00>;
						qcom,mdss-dsi-off-command = [22 01 00 00 00 00 02 00 00];
						qcom,mdss-dsi-off-command-state = "dsi_lp_mode";
						qcom,mdss-dsi-on-command = [32 01 00 00 00 00 02 00 00];
						qcom,mdss-dsi-on-command-state = "dsi_lp_mode";
						qcom,mdss-dsi-panel-framerate = <0x3c>;
						qcom,mdss-dsi-panel-height = <0x1e0>;
						qcom,mdss-dsi-panel-timings = <0x00 0x00 0x00>;
						qcom,mdss-dsi-panel-width = <0x280>;
						qcom,mdss-dsi-v-back-porch = <0x06>;
						qcom,mdss-dsi-v-bottom-border = <0x00>;
						qcom,mdss-dsi-v-front-porch = <0x06>;
						qcom,mdss-dsi-v-pulse-width = <0x02>;
						qcom,mdss-dsi-v-top-border = <0x00>;
					};
				};
			};
		};
	};

	fragment@30 {
		target = <0xffffffff>;

		__overlay__ {

			tlmm_gpio_key {

				gpio_key_active {
					phandle = <0x05>;

					config {
						pins = "gpio86\0gpio91\0gpio127\0gpio128";
					};

					mux {
						function = "gpio";
						pins = "gpio86\0gpio91\0gpio127\0gpio128";
					};
				};

				gpio_key_suspend {
					phandle = <0x20>;

					config {
						pins = "gpio86\0gpio91\0gpio127\0gpio128";
					};

					mux {
						function = "gpio";
						pins = "gpio86\0gpio91\0gpio127\0gpio128";
					};
				};
			};
		};
	};

	fragment@31 {
		target = <0xffffffff>;

		__overlay__ {

			nfc_clk {

				nfc_clk_default {
					function = "normal";
					input-enable;
					phandle = <0x08>;
					pins = "gpio5";
					power-source = <0x01>;
				};
			};
		};
	};

	fragment@32 {
		target = <0xffffffff>;

		__overlay__ {
			#address-cells = <0x01>;
			#size-cells = <0x00>;
			status = "ok";

			nq@28 {
				clock-names = "ref_clk";
				clocks = <0xffffffff 0x498938e5>;
				compatible = "qcom,nq-nci";
				interrupt-names = "nfc_irq";
				interrupt-parent = <0xffffffff>;
				interrupts = <0x11 0x00>;
				pinctrl-0 = <0xffffffff 0xffffffff 0x08>;
				pinctrl-1 = <0xffffffff 0xffffffff>;
				pinctrl-names = "nfc_active\0nfc_suspend";
				qcom,clk-src = "BBCLK2";
				qcom,nq-clkreq = <0xffffffff 0x05 0x00>;
				qcom,nq-firm = <0xffffffff 0x82 0x00>;
				qcom,nq-irq = <0xffffffff 0x11 0x00>;
				qcom,nq-ven = <0xffffffff 0x10 0x00>;
				reg = <0x28>;
			};
		};
	};

	fragment@33 {
		target = <0xffffffff>;

		__overlay__ {
			pinctrl-0 = <0xffffffff 0xffffffff 0xffffffff 0xffffffff>;
			pinctrl-1 = <0xffffffff 0xffffffff 0xffffffff 0xffffffff>;
			pinctrl-names = "active\0sleep";
			qcom,bus-speed-mode = "HS400_1p8v\0HS200_1p8v\0DDR_1p8v";
			qcom,clk-rates = <0x61a80 0x1312d00 0x17d7840 0x2faf080 0x5f5e100 0xb71b000 0x16e36000>;
			qcom,nonremovable;
			qcom,vdd-current-level = <0xc8 0x8b290>;
			qcom,vdd-io-always-on;
			qcom,vdd-io-current-level = <0xc8 0x4f588>;
			qcom,vdd-io-lpm-sup;
			qcom,vdd-io-voltage-level = <0x1b7740 0x1b7740>;
			qcom,vdd-voltage-level = <0x2c4020 0x2c4020>;
			status = "ok";
			vdd-io-supply = <0xffffffff>;
			vdd-supply = <0xffffffff>;
		};
	};

	fragment@34 {
		target = <0xffffffff>;

		__overlay__ {
			#address-cells = <0x00>;
			#interrupt-cells = <0x01>;
			cd-gpios = <0xffffffff 0x43 0x01>;
			interrupt-map = <0x00 0xffffffff 0x00 0x7d 0x00 0x01 0xffffffff 0x00 0xdd 0x00 0x02 0xffffffff 0x43 0x00>;
			interrupt-map-mask = <0xffffffff>;
			interrupt-names = "hc_irq\0pwr_irq\0status_irq";
			interrupt-parent = <0xffffffff>;
			interrupts = <0x00 0x01 0x02>;
			pinctrl-0 = <0xffffffff 0xffffffff 0xffffffff 0xffffffff>;
			pinctrl-1 = <0xffffffff 0xffffffff 0xffffffff>;
			pinctrl-names = "active\0sleep";
			qcom,bus-speed-mode = "SDR12\0SDR25\0SDR50\0DDR50\0SDR104";
			qcom,clk-rates = <0x61a80 0x1312d00 0x17d7840 0x2faf080 0x5f5e100 0xbebc200>;
			qcom,vdd-current-level = <0x3a98 0xc3500>;
			qcom,vdd-io-current-level = <0xc8 0x55f0>;
			qcom,vdd-io-voltage-level = <0x1b7740 0x2d0370>;
			qcom,vdd-voltage-level = <0x2d0370 0x2d0370>;
			status = "ok";
			vdd-io-supply = <0xffffffff>;
			vdd-supply = <0xffffffff>;
		};
	};

	fragment@35 {
		target = <0xffffffff>;

		__overlay__ {

			qcom,cnss_sdio {
				compatible = "qcom,cnss_sdio";
				qcom,cap-tsf-gpio = <0xffffffff 0x7e 0x01>;
				qcom,wlan-ramdump-dynamic = <0x200000>;
				subsys-name = "AR6320";
			};
		};
	};

	fragment@36 {
		target = <0xffffffff>;

		__overlay__ {

			gpio@c100 {
				qcom,master-en = <0x01>;
				qcom,mode = <0x01>;
				qcom,out-strength = <0x02>;
				qcom,pull = <0x04>;
				qcom,src-sel = <0x02>;
				qcom,vin-sel = <0x03>;
				status = "okay";
			};
		};
	};

	fragment@37 {
		target = <0xffffffff>;

		__overlay__ {
			status = "ok";
		};
	};

	fragment@38 {
		target = <0xffffffff>;

		__overlay__ {
			#address-cells = <0x00>;
			#interrupt-cells = <0x01>;
			interrupt-map = <0x00 0xffffffff 0x00 0x7d 0x00 0x01 0xffffffff 0x00 0xdd 0x00 0x02 0xffffffff 0x7c 0x04>;
			interrupt-map-mask = <0xffffffff>;
			interrupt-names = "hc_irq\0pwr_irq\0sdiowakeup_irq";
			interrupt-parent = <0xffffffff>;
			interrupts = <0x00 0x01 0x02>;
			pinctrl-0 = <0xffffffff 0xffffffff 0xffffffff 0xffffffff>;
			pinctrl-1 = <0xffffffff 0xffffffff 0xffffffff 0xffffffff>;
			pinctrl-names = "active\0sleep";
			qcom,core_3_0v_support;
			qcom,nonremovable;
			qcom,vdd-io-always-on;
			qcom,vdd-io-current-level = <0xc8 0x4f588>;
			qcom,vdd-io-voltage-level = <0x1b7740 0x1b7740>;
			status = "ok";
			vdd-io-supply = <0xffffffff>;
		};
	};

	fragment@39 {
		target = <0xffffffff>;

		__overlay__ {
			reg = <0x00 0x86800000 0x00 0x1500000>;
		};
	};

	fragment@4 {
		target = <0xffffffff>;

		__overlay__ {

			qcom,mdss_dsi_sim_cmd {
				phandle = <0x0a>;
				qcom,mdss-dsi-bl-max-level = <0xfff>;
				qcom,mdss-dsi-bllp-eof-power-mode;
				qcom,mdss-dsi-bllp-power-mode;
				qcom,mdss-dsi-border-color = <0x00>;
				qcom,mdss-dsi-bpp = <0x18>;
				qcom,mdss-dsi-color-order = "rgb_swap_rgb";
				qcom,mdss-dsi-dma-trigger = "trigger_sw";
				qcom,mdss-dsi-lane-0-state;
				qcom,mdss-dsi-lane-1-state;
				qcom,mdss-dsi-lane-2-state;
				qcom,mdss-dsi-lane-3-state;
				qcom,mdss-dsi-mdp-trigger = "none";
				qcom,mdss-dsi-panel-blackness-level = <0xc9e>;
				qcom,mdss-dsi-panel-hdr-color-primaries = <0x38a4 0x3c8c 0x7d00 0x4268 0x3c8c 0x7530 0x1f40 0xbb8>;
				qcom,mdss-dsi-panel-hdr-enabled;
				qcom,mdss-dsi-panel-name = "Simulator cmd mode dsi panel";
				qcom,mdss-dsi-panel-peak-brightness = <0x401640>;
				qcom,mdss-dsi-panel-type = "dsi_cmd_mode";
				qcom,mdss-dsi-reset-sequence = <0x01 0x0a 0x00 0x0a 0x01 0x0a>;
				qcom,mdss-dsi-stream = <0x00>;
				qcom,mdss-dsi-t-clk-post = <0x03>;
				qcom,mdss-dsi-t-clk-pre = <0x27>;
				qcom,mdss-dsi-te-check-enable;
				qcom,mdss-dsi-te-dcs-command = <0x01>;
				qcom,mdss-dsi-te-pin-select = <0x01>;
				qcom,mdss-dsi-te-using-te-pin;
				qcom,mdss-dsi-te-using-wd;
				qcom,mdss-dsi-traffic-mode = "non_burst_sync_event";
				qcom,mdss-dsi-underflow-color = <0xff>;
				qcom,mdss-dsi-virtual-channel-id = <0x00>;
				qcom,mdss-dsi-wr-mem-continue = <0x3c>;
				qcom,mdss-dsi-wr-mem-start = <0x2c>;
				qcom,panel-ack-disabled;
				qcom,ulps-enabled;

				qcom,mdss-dsi-display-timings {

					timing@0 {
						qcom,compression-mode = "dsc";
						qcom,mdss-dsc-bit-per-component = <0x08>;
						qcom,mdss-dsc-bit-per-pixel = <0x08>;
						qcom,mdss-dsc-block-prediction-enable;
						qcom,mdss-dsc-slice-height = <0x28>;
						qcom,mdss-dsc-slice-per-pkt = <0x01>;
						qcom,mdss-dsc-slice-width = <0x2d0>;
						qcom,mdss-dsi-h-back-porch = <0x64>;
						qcom,mdss-dsi-h-front-porch = <0x78>;
						qcom,mdss-dsi-h-left-border = <0x00>;
						qcom,mdss-dsi-h-pulse-width = <0x28>;
						qcom,mdss-dsi-h-right-border = <0x00>;
						qcom,mdss-dsi-h-sync-skew = <0x00>;
						qcom,mdss-dsi-off-command = [05 01 00 00 32 00 02 28 00 05 01 00 00 78 00 02 10 00];
						qcom,mdss-dsi-off-command-state = "dsi_hs_mode";
						qcom,mdss-dsi-on-command = <0x29010000 0x2b0 0x3050100 0xa0001 0x150100 0xa0002 0x3a773901 0xa00 0x52a0000 0x4ff3901 0xa00 0x52b0000 0x59f1501 0xa00 0x2350039 0x100000a 0x34400 0x150100 0xa0002 0x51ff1501 0xa00 0x2532415 0x100000a 0x25500 0x5010000 0x78000111 0x5010000 0x10000129>;
						qcom,mdss-dsi-on-command-state = "dsi_lp_mode";
						qcom,mdss-dsi-panel-framerate = <0x3c>;
						qcom,mdss-dsi-panel-height = <0xa00>;
						qcom,mdss-dsi-panel-timings = <0x210909 0x24230808 0x8030400>;
						qcom,mdss-dsi-panel-width = <0x5a0>;
						qcom,mdss-dsi-v-back-porch = <0x64>;
						qcom,mdss-dsi-v-bottom-border = <0x00>;
						qcom,mdss-dsi-v-front-porch = <0x64>;
						qcom,mdss-dsi-v-pulse-width = <0x28>;
						qcom,mdss-dsi-v-top-border = <0x00>;
					};

					timing@1 {
						qcom,compression-mode = "dsc";
						qcom,mdss-dsc-bit-per-component = <0x08>;
						qcom,mdss-dsc-bit-per-pixel = <0x08>;
						qcom,mdss-dsc-block-prediction-enable;
						qcom,mdss-dsc-slice-height = <0x28>;
						qcom,mdss-dsc-slice-per-pkt = <0x01>;
						qcom,mdss-dsc-slice-width = <0x21c>;
						qcom,mdss-dsi-h-back-porch = <0x1cc>;
						qcom,mdss-dsi-h-front-porch = <0x78>;
						qcom,mdss-dsi-h-left-border = <0x00>;
						qcom,mdss-dsi-h-pulse-width = <0x28>;
						qcom,mdss-dsi-h-right-border = <0x00>;
						qcom,mdss-dsi-h-sync-skew = <0x00>;
						qcom,mdss-dsi-off-command = [05 01 00 00 32 00 02 28 00 05 01 00 00 78 00 02 10 00];
						qcom,mdss-dsi-off-command-state = "dsi_hs_mode";
						qcom,mdss-dsi-on-command = <0x29010000 0x2b0 0x3050100 0xa0001 0x150100 0xa0002 0x3a773901 0xa00 0x52a0000 0x4ff3901 0xa00 0x52b0000 0x59f1501 0xa00 0x2350039 0x100000a 0x34400 0x150100 0xa0002 0x51ff1501 0xa00 0x2532415 0x100000a 0x25500 0x5010000 0x78000111 0x5010000 0x10000129>;
						qcom,mdss-dsi-on-command-state = "dsi_lp_mode";
						qcom,mdss-dsi-panel-framerate = <0x3c>;
						qcom,mdss-dsi-panel-height = <0x780>;
						qcom,mdss-dsi-panel-timings = <0x210909 0x24230808 0x8030400>;
						qcom,mdss-dsi-panel-width = <0x438>;
						qcom,mdss-dsi-v-back-porch = <0x64>;
						qcom,mdss-dsi-v-bottom-border = <0x00>;
						qcom,mdss-dsi-v-front-porch = <0x2e4>;
						qcom,mdss-dsi-v-pulse-width = <0x28>;
						qcom,mdss-dsi-v-top-border = <0x00>;
					};

					timing@2 {
						qcom,compression-mode = "dsc";
						qcom,mdss-dsc-bit-per-component = <0x08>;
						qcom,mdss-dsc-bit-per-pixel = <0x08>;
						qcom,mdss-dsc-block-prediction-enable;
						qcom,mdss-dsc-slice-height = <0x28>;
						qcom,mdss-dsc-slice-per-pkt = <0x01>;
						qcom,mdss-dsc-slice-width = <0x168>;
						qcom,mdss-dsi-h-back-porch = <0x348>;
						qcom,mdss-dsi-h-front-porch = <0x64>;
						qcom,mdss-dsi-h-left-border = <0x00>;
						qcom,mdss-dsi-h-pulse-width = <0x28>;
						qcom,mdss-dsi-h-right-border = <0x00>;
						qcom,mdss-dsi-h-sync-skew = <0x00>;
						qcom,mdss-dsi-off-command = [05 01 00 00 32 00 02 28 00 05 01 00 00 78 00 02 10 00];
						qcom,mdss-dsi-off-command-state = "dsi_hs_mode";
						qcom,mdss-dsi-on-command = <0x29010000 0x2b0 0x3050100 0xa0001 0x150100 0xa0002 0x3a773901 0xa00 0x52a0000 0x4ff3901 0xa00 0x52b0000 0x59f1501 0xa00 0x2350039 0x100000a 0x34400 0x150100 0xa0002 0x51ff1501 0xa00 0x2532415 0x100000a 0x25500 0x5010000 0x78000111 0x5010000 0x10000129>;
						qcom,mdss-dsi-on-command-state = "dsi_lp_mode";
						qcom,mdss-dsi-panel-framerate = <0x3c>;
						qcom,mdss-dsi-panel-height = <0x500>;
						qcom,mdss-dsi-panel-timings = <0x210909 0x24230808 0x8030400>;
						qcom,mdss-dsi-panel-width = <0x2d0>;
						qcom,mdss-dsi-v-back-porch = <0x64>;
						qcom,mdss-dsi-v-bottom-border = <0x00>;
						qcom,mdss-dsi-v-front-porch = <0x564>;
						qcom,mdss-dsi-v-pulse-width = <0x28>;
						qcom,mdss-dsi-v-top-border = <0x00>;
					};
				};
			};
		};
	};

	fragment@40 {
		target = <0xffffffff>;

		__overlay__ {
			reg = <0x00 0x87d00000 0x00 0x1100000>;
		};
	};

	fragment@41 {
		target = <0xffffffff>;

		__overlay__ {
			reg = <0x00 0x88e00000 0x00 0x700000>;
		};
	};

	fragment@42 {
		target = <0xffffffff>;

		__overlay__ {
			status = "disabled";
		};
	};

	fragment@5 {
		target = <0xffffffff>;

		__overlay__ {

			qcom,mdss_dsi_truly_1080p_video {
				phandle = <0x0b>;
				qcom,mdss-dsi-bl-max-level = <0xfff>;
				qcom,mdss-dsi-bl-min-level = <0x01>;
				qcom,mdss-dsi-bl-pmic-control-type = "bl_ctrl_wled";
				qcom,mdss-dsi-bllp-eof-power-mode;
				qcom,mdss-dsi-bllp-power-mode;
				qcom,mdss-dsi-border-color = <0x00>;
				qcom,mdss-dsi-bpp = <0x18>;
				qcom,mdss-dsi-dma-trigger = "trigger_sw";
				qcom,mdss-dsi-h-back-porch = <0x40>;
				qcom,mdss-dsi-h-front-porch = <0x60>;
				qcom,mdss-dsi-h-left-border = <0x00>;
				qcom,mdss-dsi-h-pulse-width = <0x10>;
				qcom,mdss-dsi-h-right-border = <0x00>;
				qcom,mdss-dsi-h-sync-pulse = <0x00>;
				qcom,mdss-dsi-h-sync-skew = <0x00>;
				qcom,mdss-dsi-lane-0-state;
				qcom,mdss-dsi-lane-1-state;
				qcom,mdss-dsi-lane-2-state;
				qcom,mdss-dsi-lane-3-state;
				qcom,mdss-dsi-mdp-trigger = "none";
				qcom,mdss-dsi-off-command = [05 01 00 00 14 00 02 28 00 05 01 00 00 78 00 02 10 00];
				qcom,mdss-dsi-off-command-state = "dsi_lp_mode";
				qcom,mdss-dsi-on-command = [15 01 00 00 00 00 02 35 00 15 01 00 00 00 00 02 51 ff 15 01 00 00 00 00 02 53 2c 15 01 00 00 00 00 02 55 00 05 01 00 00 78 00 02 11 00 23 01 00 00 00 00 02 b0 00 29 01 00 00 00 00 07 b3 14 00 00 00 00 00 29 01 00 00 00 00 03 b6 3a d3 29 01 00 00 00 00 03 c0 00 00 29 01 00 00 00 00 23 c1 84 60 10 eb ff 6f ce ff ff 17 02 58 73 ae b1 20 c6 ff ff 1f f3 ff 5f 10 10 10 10 00 02 01 22 22 00 01 29 01 00 00 00 00 08 c2 31 f7 80 06 08 00 00 29 01 00 00 00 00 17 c4 70 00 00 00 00 04 00 00 00 0c 06 00 00 00 00 00 04 00 00 00 0c 06 29 01 00 00 00 00 29 c6 00 69 00 69 00 69 00 00 00 00 00 69 00 69 00 69 10 19 07 00 01 00 69 00 69 00 69 00 00 00 00 00 69 00 69 00 69 10 19 07 29 01 00 00 00 00 0a cb 31 fc 3f 8c 00 00 00 00 c0 23 01 00 00 00 00 02 cc 0b 29 01 00 00 00 00 0b d0 11 81 bb 1e 1e 4c 19 19 0c 00 29 01 00 00 00 00 1a d3 1b 33 bb bb b3 33 33 33 00 01 00 a0 d8 a0 0d 4e 4e 33 3b 22 72 07 3d bf 33 29 01 00 00 00 00 08 d5 06 00 00 01 51 01 32 29 01 00 00 00 00 1f c7 01 0a 11 18 26 33 3e 50 38 42 52 60 67 6e 77 01 0a 11 18 26 33 3e 50 38 42 52 60 67 6e 77 29 01 00 00 14 00 14 c8 01 00 00 00 00 fc 00 00 00 00 00 fc 00 00 00 00 00 fc 00 05 01 00 00 14 00 02 29 00];
				qcom,mdss-dsi-on-command-state = "dsi_lp_mode";
				qcom,mdss-dsi-panel-framerate = <0x3c>;
				qcom,mdss-dsi-panel-height = <0x780>;
				qcom,mdss-dsi-panel-name = "truly 1080p video mode dsi panel";
				qcom,mdss-dsi-panel-timings = <0xe6382600 0x686e2a3c 0x44030400>;
				qcom,mdss-dsi-panel-type = "dsi_video_mode";
				qcom,mdss-dsi-panel-width = <0x438>;
				qcom,mdss-dsi-post-init-delay = <0x01>;
				qcom,mdss-dsi-reset-sequence = <0x01 0x0a 0x00 0x0a 0x01 0x0a>;
				qcom,mdss-dsi-stream = <0x00>;
				qcom,mdss-dsi-t-clk-post = <0x02>;
				qcom,mdss-dsi-t-clk-pre = <0x2d>;
				qcom,mdss-dsi-traffic-mode = "burst_mode";
				qcom,mdss-dsi-tx-eot-append;
				qcom,mdss-dsi-underflow-color = <0xff>;
				qcom,mdss-dsi-v-back-porch = <0x10>;
				qcom,mdss-dsi-v-bottom-border = <0x00>;
				qcom,mdss-dsi-v-front-porch = <0x04>;
				qcom,mdss-dsi-v-pulse-width = <0x01>;
				qcom,mdss-dsi-v-top-border = <0x00>;
				qcom,mdss-dsi-virtual-channel-id = <0x00>;
			};
		};
	};

	fragment@6 {
		target = <0xffffffff>;

		__overlay__ {

			qcom,mdss_dsi_truly_1080p_cmd {
				phandle = <0x0c>;
				qcom,mdss-dsi-bl-max-level = <0xfff>;
				qcom,mdss-dsi-bl-min-level = <0x01>;
				qcom,mdss-dsi-bl-pmic-control-type = "bl_ctrl_wled";
				qcom,mdss-dsi-bllp-eof-power-mode;
				qcom,mdss-dsi-bllp-power-mode;
				qcom,mdss-dsi-border-color = <0x00>;
				qcom,mdss-dsi-bpp = <0x18>;
				qcom,mdss-dsi-dma-trigger = "trigger_sw";
				qcom,mdss-dsi-h-back-porch = <0x40>;
				qcom,mdss-dsi-h-front-porch = <0x60>;
				qcom,mdss-dsi-h-left-border = <0x00>;
				qcom,mdss-dsi-h-pulse-width = <0x10>;
				qcom,mdss-dsi-h-right-border = <0x00>;
				qcom,mdss-dsi-h-sync-pulse = <0x00>;
				qcom,mdss-dsi-h-sync-skew = <0x00>;
				qcom,mdss-dsi-lane-0-state;
				qcom,mdss-dsi-lane-1-state;
				qcom,mdss-dsi-lane-2-state;
				qcom,mdss-dsi-lane-3-state;
				qcom,mdss-dsi-mdp-trigger = "none";
				qcom,mdss-dsi-off-command = [05 01 00 00 14 00 02 28 00 05 01 00 00 78 00 02 10 00];
				qcom,mdss-dsi-off-command-state = "dsi_lp_mode";
				qcom,mdss-dsi-on-command = [23 01 00 00 00 00 02 d6 01 15 01 00 00 00 00 02 35 00 15 01 00 00 00 00 02 51 ff 15 01 00 00 00 00 02 53 2c 15 01 00 00 00 00 02 55 00 05 01 00 00 78 00 02 11 00 23 01 00 00 00 00 02 b0 04 29 01 00 00 00 00 07 b3 04 00 00 00 00 00 29 01 00 00 00 00 03 b6 3a d3 29 01 00 00 00 00 03 c0 00 00 29 01 00 00 00 00 23 c1 84 60 10 eb ff 6f ce ff ff 17 02 58 73 ae b1 20 c6 ff ff 1f f3 ff 5f 10 10 10 10 00 02 01 22 22 00 01 29 01 00 00 00 00 08 c2 31 f7 80 06 08 00 00 29 01 00 00 00 00 17 c4 70 00 00 00 00 04 00 00 00 0c 06 00 00 00 00 00 04 00 00 00 0c 06 29 01 00 00 00 00 29 c6 78 69 00 69 00 69 00 00 00 00 00 69 00 69 00 69 10 19 07 00 78 00 69 00 69 00 69 00 00 00 00 00 69 00 69 00 69 10 19 07 29 01 00 00 00 00 0a cb 31 fc 3f 8c 00 00 00 00 c0 23 01 00 00 00 00 02 cc 0b 29 01 00 00 00 00 0b d0 11 81 bb 1e 1e 4c 19 19 0c 00 29 01 00 00 00 00 1a d3 1b 33 bb bb b3 33 33 33 00 01 00 a0 d8 a0 0d 4e 4e 33 3b 22 72 07 3d bf 33 29 01 00 00 00 00 08 d5 06 00 00 01 51 01 32 29 01 00 00 00 00 1f c7 01 0a 11 18 26 33 3e 50 38 42 52 60 67 6e 77 01 0a 11 18 26 33 3e 50 38 42 52 60 67 6e 77 29 01 00 00 14 00 14 c8 01 00 00 00 00 fc 00 00 00 00 00 fc 00 00 00 00 00 fc 00 05 01 00 00 14 00 02 29 00];
				qcom,mdss-dsi-on-command-state = "dsi_lp_mode";
				qcom,mdss-dsi-panel-framerate = <0x3c>;
				qcom,mdss-dsi-panel-height = <0x780>;
				qcom,mdss-dsi-panel-name = "truly 1080p cmd mode dsi panel";
				qcom,mdss-dsi-panel-timings = <0xe6382600 0x686e2a3c 0x44030400>;
				qcom,mdss-dsi-panel-type = "dsi_cmd_mode";
				qcom,mdss-dsi-panel-width = <0x438>;
				qcom,mdss-dsi-post-init-delay = <0x01>;
				qcom,mdss-dsi-reset-sequence = <0x01 0x0a 0x00 0x0a 0x01 0x0a>;
				qcom,mdss-dsi-stream = <0x00>;
				qcom,mdss-dsi-t-clk-post = <0x02>;
				qcom,mdss-dsi-t-clk-pre = <0x2d>;
				qcom,mdss-dsi-te-check-enable;
				qcom,mdss-dsi-te-dcs-command = <0x01>;
				qcom,mdss-dsi-te-pin-select = <0x01>;
				qcom,mdss-dsi-te-using-te-pin;
				qcom,mdss-dsi-traffic-mode = "burst_mode";
				qcom,mdss-dsi-tx-eot-append;
				qcom,mdss-dsi-underflow-color = <0xff>;
				qcom,mdss-dsi-v-back-porch = <0x10>;
				qcom,mdss-dsi-v-bottom-border = <0x00>;
				qcom,mdss-dsi-v-front-porch = <0x04>;
				qcom,mdss-dsi-v-pulse-width = <0x01>;
				qcom,mdss-dsi-v-top-border = <0x00>;
				qcom,mdss-dsi-virtual-channel-id = <0x00>;
			};
		};
	};

	fragment@7 {
		target = <0xffffffff>;

		__overlay__ {

			qcom,mdss_dsi_truly_720p_video {
				phandle = <0x07>;
				qcom,mdss-dsi-bl-max-level = <0xfff>;
				qcom,mdss-dsi-bl-min-level = <0x01>;
				qcom,mdss-dsi-bl-pmic-control-type = "bl_ctrl_wled";
				qcom,mdss-dsi-bllp-eof-power-mode;
				qcom,mdss-dsi-bllp-power-mode;
				qcom,mdss-dsi-border-color = <0x00>;
				qcom,mdss-dsi-bpp = <0x18>;
				qcom,mdss-dsi-dma-trigger = "trigger_sw";
				qcom,mdss-dsi-h-back-porch = <0x64>;
				qcom,mdss-dsi-h-front-porch = <0x64>;
				qcom,mdss-dsi-h-left-border = <0x00>;
				qcom,mdss-dsi-h-pulse-width = <0x06>;
				qcom,mdss-dsi-h-right-border = <0x00>;
				qcom,mdss-dsi-h-sync-pulse = <0x00>;
				qcom,mdss-dsi-h-sync-skew = <0x00>;
				qcom,mdss-dsi-lane-0-state;
				qcom,mdss-dsi-lane-1-state;
				qcom,mdss-dsi-lane-2-state;
				qcom,mdss-dsi-lane-3-state;
				qcom,mdss-dsi-lp11-init;
				qcom,mdss-dsi-max-refresh-rate = <0x3c>;
				qcom,mdss-dsi-mdp-trigger = "none";
				qcom,mdss-dsi-min-refresh-rate = <0x30>;
				qcom,mdss-dsi-off-command = [05 01 00 00 14 00 02 28 00 05 01 00 00 78 00 02 10 00];
				qcom,mdss-dsi-off-command-state = "dsi_lp_mode";
				qcom,mdss-dsi-on-command = <0x29010000 0x6f0 0x55aa5208 0x290100 0x03 0xb1782123 0x1000000 0x2b60f 0x29010000 0x3bc 0x2901 0x00 0x6bd02b0 0x1e1e0029 0x1000000 0xbe7f2 0xe6d8ccbf 0xb2a59999 0x95290100 0x0b 0xe8f2e6d8 0xccbfb2a5 0x99999529 0x1000000 0x6f055 0xaa520801 0x29010000 0x3bc 0xa0002901 0x00 0x3bda000 0x23010000 0x2ca 0x1230100 0x02 0xc00c2301 0x00 0x2be4e29 0x1000000 0x3b338 0x38290100 0x03 0xb4111129 0x1000000 0x3b605 0x5290100 0x03 0xb9454529 0x1000000 0x3ba25 0x25290100 0x03 0xc4111123 0x1000000 0x2c666 0x29010000 0x6f0 0x55aa5208 0x2230100 0x02 0xee002901 0x00 0x11b00037 0x480069 0x8a00ab 0xcb00eb 0x11c2901 0x00 0x11b10141 0x17c01aa 0x1f3022d 0x22e0263 0x29d2901 0x00 0x11b202c3 0x2f60319 0x3540385 0x3b203c1 0x3d12901 0x00 0x5b303e0 0x3e82901 0x00 0x11bc0037 0x480069 0x8a00ab 0xcb00eb 0x11c2901 0x00 0x11bd0141 0x17c01aa 0x1f3022d 0x22e0263 0x29d2901 0x00 0x11be02c3 0x2f60319 0x3540385 0x3b203c1 0x3d12901 0x00 0x5bf03e0 0x3e82901 0x00 0x11b400d1 0xd700e4 0xf100fe 0x1120126 0x1482901 0x00 0x11b50164 0x19501bd 0x2010236 0x238026c 0x2a72901 0x00 0x11b602ce 0x304032b 0x35b0389 0x3b203c1 0x3d12901 0x00 0x5b703e0 0x3e82901 0x00 0x11c000d1 0xd700e4 0xf100fe 0x1120126 0x1482901 0x00 0x11c10164 0x19501bd 0x2010236 0x238026c 0x2a72901 0x00 0x11c202ce 0x304032b 0x35b0389 0x3b203c1 0x3d12901 0x00 0x5c303e0 0x3e82901 0x00 0x11b80037 0x450061 0x7d009a 0xbb00dc 0x10b2901 0x00 0x11b90131 0x16e019e 0x1ea0224 0x2250258 0x2902901 0x00 0x11ba02b4 0x2e40304 0x344037f 0x3b203c1 0x3d12901 0x00 0x5bb03e0 0x3e82901 0x00 0x11c40037 0x450061 0x7d009a 0xbb00dc 0x10b2901 0x00 0x11c50131 0x16e019e 0x1ea0224 0x2250258 0x2902901 0x00 0x11c602b4 0x2e40304 0x344037f 0x3b203c1 0x3d12901 0x00 0x5c703e0 0x3e82901 0x00 0x6f055aa 0x52080629 0x1000000 0x3b029 0x2a290100 0x03 0xb1101229 0x1000000 0x3b214 0x16290100 0x03 0xb3181a29 0x1000000 0x3b402 0x4290100 0x03 0xb5343429 0x1000000 0x3b634 0x2e290100 0x03 0xb72e2e29 0x1000000 0x3b834 0x290100 0x03 0xb9343429 0x1000000 0x3ba34 0x34290100 0x03 0xbb013429 0x1000000 0x3bc2e 0x2e290100 0x03 0xbd2e3429 0x1000000 0x3be34 0x34290100 0x03 0xbf050329 0x1000000 0x3c01b 0x19290100 0x03 0xc1171529 0x1000000 0x3c213 0x11290100 0x03 0xc32a2929 0x1000000 0x3e52e 0x2e290100 0x03 0xc4292a29 0x1000000 0x3c51b 0x19290100 0x03 0xc6171529 0x1000000 0x3c713 0x11290100 0x03 0xc8010529 0x1000000 0x3c934 0x34290100 0x03 0xca342e29 0x1000000 0x3cb2e 0x2e290100 0x03 0xcc340329 0x1000000 0x3cd34 0x34290100 0x03 0xce343429 0x1000000 0x3cf02 0x34290100 0x03 0xd02e2e29 0x1000000 0x3d12e 0x34290100 0x03 0xd2343429 0x1000000 0x3d304 0x290100 0x03 0xd4101229 0x1000000 0x3d514 0x16290100 0x03 0xd6181a29 0x1000000 0x3d72a 0x29290100 0x03 0xe62e2e29 0x1000000 0x6d800 0x5400 0x29010000 0x6d9 0x150000 0x230100 0x02 0xe7002901 0x00 0x6f055aa 0x52080329 0x1000000 0x3b100 0x290100 0x03 0xb0000029 0x1000000 0x6b205 0x00 0x29010000 0x6b3 0x5000000 0x290100 0x06 0xb4050000 0x2901 0x00 0x6b50500 0x17000029 0x1000000 0x6b612 0x190000 0x29010000 0x6b7 0x12001900 0x290100 0x06 0xb8120019 0x2901 0x00 0x6b91200 0x19000029 0x1000000 0x6ba57 0x00 0x29010000 0x6bb 0x57000000 0x290100 0x06 0xbc75001a 0x2901 0x00 0x6bd5300 0x1a000029 0x1000000 0x5c000 0x34000029 0x1000000 0x5c100 0x34000029 0x1000000 0x5c200 0x34000029 0x1000000 0x5c300 0x34000023 0x1000000 0x2c420 0x23010000 0x2c5 0x230100 0x02 0xc6002301 0x00 0x2c70029 0x1000000 0x6f055 0xaa520805 0x23010000 0x2ed 0x30290100 0x03 0xb0170623 0x1000000 0x2b808 0x29010000 0x6bd 0x3070003 0x290100 0x03 0xb1170623 0x1000000 0x2b900 0x29010000 0x3b2 0x2301 0x00 0x2ba0029 0x1000000 0x3b317 0x6230100 0x02 0xbb0a2901 0x00 0x3b41706 0x29010000 0x3b5 0x17062901 0x00 0x3b61403 0x29010000 0x3b7 0x2301 0x00 0x2bc0223 0x1000000 0x2e506 0x23010000 0x2e6 0x6230100 0x02 0xe7002301 0x00 0x2e80623 0x1000000 0x2e906 0x23010000 0x2ea 0x6230100 0x02 0xeb002301 0x00 0x2ec0023 0x1000000 0x2c007 0x23010000 0x2c1 0x80230100 0x02 0xc2a42301 0x00 0x2c30523 0x1000000 0x2c400 0x23010000 0x2c5 0x2230100 0x02 0xc6222301 0x00 0x2c70329 0x1000000 0x3c805 0x30290100 0x03 0xc9013129 0x1000000 0x3ca03 0x21290100 0x03 0xcb012029 0x1000000 0x6d100 0x5090710 0x29010000 0x6d2 0x10050e03 0x10290100 0x06 0xd3200048 0x7102901 0x00 0x6d43000 0x43071023 0x1000000 0x2d000 0x29010000 0x4cc 0x3e29 0x1000000 0x4cd00 0x3e2901 0x00 0x4ce0000 0x2290100 0x04 0xcf000002 0x23010000 0x26f 0x11230100 0x02 0xf3011501 0x00 0x251ff15 0x1000000 0x2532c 0x15010000 0x255 0x3150100 0xc80002 0x35000501 0x7800 0x2110005 0x100000a 0x22900>;
				qcom,mdss-dsi-on-command-state = "dsi_lp_mode";
				qcom,mdss-dsi-pan-enable-dynamic-fps;
				qcom,mdss-dsi-pan-fps-update = "dfps_immediate_porch_mode_vfp";
				qcom,mdss-dsi-panel-framerate = <0x3c>;
				qcom,mdss-dsi-panel-height = <0x500>;
				qcom,mdss-dsi-panel-name = "truly 720p video mode dsi panel";
				qcom,mdss-dsi-panel-timings = <0x872c1200 0x4044161e 0x17030400>;
				qcom,mdss-dsi-panel-type = "dsi_video_mode";
				qcom,mdss-dsi-panel-width = <0x2d0>;
				qcom,mdss-dsi-post-init-delay = <0x01>;
				qcom,mdss-dsi-reset-sequence = <0x01 0x0a 0x00 0x0a 0x01 0x0a>;
				qcom,mdss-dsi-stream = <0x00>;
				qcom,mdss-dsi-t-clk-post = <0x04>;
				qcom,mdss-dsi-t-clk-pre = <0x1b>;
				qcom,mdss-dsi-traffic-mode = "burst_mode";
				qcom,mdss-dsi-tx-eot-append;
				qcom,mdss-dsi-underflow-color = <0xff>;
				qcom,mdss-dsi-v-back-porch = <0x20>;
				qcom,mdss-dsi-v-bottom-border = <0x00>;
				qcom,mdss-dsi-v-front-porch = <0x20>;
				qcom,mdss-dsi-v-pulse-width = <0x02>;
				qcom,mdss-dsi-v-top-border = <0x00>;
				qcom,mdss-dsi-virtual-channel-id = <0x00>;
				qcom,panel-supply-entries = <0x06>;
			};
		};
	};

	fragment@8 {
		target = <0xffffffff>;

		__overlay__ {

			qcom,mdss_dsi_truly_720p_cmd {
				phandle = <0x0d>;
				qcom,mdss-dsi-bl-max-level = <0xfff>;
				qcom,mdss-dsi-bl-min-level = <0x01>;
				qcom,mdss-dsi-bl-pmic-control-type = "bl_ctrl_wled";
				qcom,mdss-dsi-bllp-eof-power-mode;
				qcom,mdss-dsi-bllp-power-mode;
				qcom,mdss-dsi-border-color = <0x00>;
				qcom,mdss-dsi-bpp = <0x18>;
				qcom,mdss-dsi-dma-trigger = "trigger_sw";
				qcom,mdss-dsi-h-back-porch = <0x64>;
				qcom,mdss-dsi-h-front-porch = <0x64>;
				qcom,mdss-dsi-h-left-border = <0x00>;
				qcom,mdss-dsi-h-pulse-width = <0x06>;
				qcom,mdss-dsi-h-right-border = <0x00>;
				qcom,mdss-dsi-h-sync-pulse = <0x00>;
				qcom,mdss-dsi-h-sync-skew = <0x00>;
				qcom,mdss-dsi-lane-0-state;
				qcom,mdss-dsi-lane-1-state;
				qcom,mdss-dsi-lane-2-state;
				qcom,mdss-dsi-lane-3-state;
				qcom,mdss-dsi-lp11-init;
				qcom,mdss-dsi-mdp-trigger = "none";
				qcom,mdss-dsi-off-command = [05 01 00 00 14 00 02 28 00 05 01 00 00 78 00 02 10 00];
				qcom,mdss-dsi-off-command-state = "dsi_lp_mode";
				qcom,mdss-dsi-on-command = <0x29010000 0x6f0 0x55aa5208 0x290100 0x03 0xb1782123 0x1000000 0x2b60f 0x29010000 0x3bc 0x2901 0x00 0x6bd0267 0x20200029 0x1000000 0xbe7f2 0xe6d8ccbf 0xb2a59999 0x95290100 0x0b 0xe8f2e6d8 0xccbfb2a5 0x99999529 0x1000000 0x6f055 0xaa520801 0x29010000 0x3bc 0xa0002901 0x00 0x3bda000 0x23010000 0x2ca 0x1230100 0x02 0xc00c2301 0x00 0x2be4e29 0x1000000 0x3b338 0x38290100 0x03 0xb4111129 0x1000000 0x3b605 0x5290100 0x03 0xb9454529 0x1000000 0x3ba25 0x25290100 0x03 0xc4111123 0x1000000 0x2c666 0x29010000 0x6f0 0x55aa5208 0x2230100 0x02 0xee002901 0x00 0x11b00037 0x480069 0x8a00ab 0xcb00eb 0x11c2901 0x00 0x11b10141 0x17c01aa 0x1f3022d 0x22e0263 0x29d2901 0x00 0x11b202c3 0x2f60319 0x3540385 0x3b203c1 0x3d12901 0x00 0x5b303e0 0x3e82901 0x00 0x11bc0037 0x480069 0x8a00ab 0xcb00eb 0x11c2901 0x00 0x11bd0141 0x17c01aa 0x1f3022d 0x22e0263 0x29d2901 0x00 0x11be02c3 0x2f60319 0x3540385 0x3b203c1 0x3d12901 0x00 0x5bf03e0 0x3e82901 0x00 0x11b400d1 0xd700e4 0xf100fe 0x1120126 0x1482901 0x00 0x11b50164 0x19501bd 0x2010236 0x238026c 0x2a72901 0x00 0x11b602ce 0x304032b 0x35b0389 0x3b203c1 0x3d12901 0x00 0x5b703e0 0x3e82901 0x00 0x11c000d1 0xd700e4 0xf100fe 0x1120126 0x1482901 0x00 0x11c10164 0x19501bd 0x2010236 0x238026c 0x2a72901 0x00 0x11c202ce 0x304032b 0x35b0389 0x3b203c1 0x3d12901 0x00 0x5c303e0 0x3e82901 0x00 0x11b80037 0x450061 0x7d009a 0xbb00dc 0x10b2901 0x00 0x11b90131 0x16e019e 0x1ea0224 0x2250258 0x2902901 0x00 0x11ba02b4 0x2e40304 0x344037f 0x3b203c1 0x3d12901 0x00 0x5bb03e0 0x3e82901 0x00 0x11c40037 0x450061 0x7d009a 0xbb00dc 0x10b2901 0x00 0x11c50131 0x16e019e 0x1ea0224 0x2250258 0x2902901 0x00 0x11c602b4 0x2e40304 0x344037f 0x3b203c1 0x3d12901 0x00 0x5c703e0 0x3e82901 0x00 0x6f055aa 0x52080629 0x1000000 0x3b029 0x2a290100 0x03 0xb1101229 0x1000000 0x3b214 0x16290100 0x03 0xb3181a29 0x1000000 0x3b402 0x4290100 0x03 0xb5343429 0x1000000 0x3b634 0x2e290100 0x03 0xb72e2e29 0x1000000 0x3b834 0x290100 0x03 0xb9343429 0x1000000 0x3ba34 0x34290100 0x03 0xbb013429 0x1000000 0x3bc2e 0x2e290100 0x03 0xbd2e3429 0x1000000 0x3be34 0x34290100 0x03 0xbf050329 0x1000000 0x3c01b 0x19290100 0x03 0xc1171529 0x1000000 0x3c213 0x11290100 0x03 0xc32a2929 0x1000000 0x3e52e 0x2e290100 0x03 0xc4292a29 0x1000000 0x3c51b 0x19290100 0x03 0xc6171529 0x1000000 0x3c713 0x11290100 0x03 0xc8010529 0x1000000 0x3c934 0x34290100 0x03 0xca342e29 0x1000000 0x3cb2e 0x2e290100 0x03 0xcc340329 0x1000000 0x3cd34 0x34290100 0x03 0xce343429 0x1000000 0x3cf02 0x34290100 0x03 0xd02e2e29 0x1000000 0x3d12e 0x34290100 0x03 0xd2343429 0x1000000 0x3d304 0x290100 0x03 0xd4101229 0x1000000 0x3d514 0x16290100 0x03 0xd6181a29 0x1000000 0x3d72a 0x29290100 0x03 0xe62e2e29 0x1000000 0x6d800 0x5400 0x29010000 0x6d9 0x150000 0x230100 0x02 0xe7002901 0x00 0x6f055aa 0x52080329 0x1000000 0x3b100 0x290100 0x03 0xb0000029 0x1000000 0x6b205 0x00 0x29010000 0x6b3 0x5000000 0x290100 0x06 0xb4050000 0x2901 0x00 0x6b50500 0x17000029 0x1000000 0x6b612 0x190000 0x29010000 0x6b7 0x12001900 0x290100 0x06 0xb8120019 0x2901 0x00 0x6b91200 0x19000029 0x1000000 0x6ba57 0x00 0x29010000 0x6bb 0x57000000 0x290100 0x06 0xbc75001a 0x2901 0x00 0x6bd5300 0x1a000029 0x1000000 0x5c000 0x34000029 0x1000000 0x5c100 0x34000029 0x1000000 0x5c200 0x34000029 0x1000000 0x5c300 0x34000023 0x1000000 0x2c420 0x23010000 0x2c5 0x230100 0x02 0xc6002301 0x00 0x2c70029 0x1000000 0x6f055 0xaa520805 0x23010000 0x2ed 0x30290100 0x03 0xb0170623 0x1000000 0x2b808 0x29010000 0x6bd 0x3070003 0x290100 0x03 0xb1170623 0x1000000 0x2b900 0x29010000 0x3b2 0x2301 0x00 0x2ba0029 0x1000000 0x3b317 0x6230100 0x02 0xbb0a2901 0x00 0x3b41706 0x29010000 0x3b5 0x17062901 0x00 0x3b61403 0x29010000 0x3b7 0x2301 0x00 0x2bc0223 0x1000000 0x2e506 0x23010000 0x2e6 0x6230100 0x02 0xe7002301 0x00 0x2e80623 0x1000000 0x2e906 0x23010000 0x2ea 0x6230100 0x02 0xeb002301 0x00 0x2ec0023 0x1000000 0x2c007 0x23010000 0x2c1 0x80230100 0x02 0xc2a42301 0x00 0x2c30523 0x1000000 0x2c400 0x23010000 0x2c5 0x2230100 0x02 0xc6222301 0x00 0x2c70329 0x1000000 0x3c805 0x30290100 0x03 0xc9013129 0x1000000 0x3ca03 0x21290100 0x03 0xcb012029 0x1000000 0x6d100 0x5090710 0x29010000 0x6d2 0x10050e03 0x10290100 0x06 0xd3200048 0x7102901 0x00 0x6d43000 0x43071023 0x1000000 0x2d000 0x29010000 0x4cc 0x3e29 0x1000000 0x4cd00 0x3e2901 0x00 0x4ce0000 0x2290100 0x04 0xcf000002 0x23010000 0x26f 0x11230100 0x02 0xf3011501 0x00 0x251ff15 0x1000000 0x2532c 0x15010000 0x255 0x3150100 0xc80002 0x35000501 0x7800 0x2110005 0x100000a 0x22900>;
				qcom,mdss-dsi-on-command-state = "dsi_lp_mode";
				qcom,mdss-dsi-panel-framerate = <0x3c>;
				qcom,mdss-dsi-panel-height = <0x500>;
				qcom,mdss-dsi-panel-name = "truly 720p cmd mode dsi panel";
				qcom,mdss-dsi-panel-timings = <0x872c1200 0x4044161e 0x17030400>;
				qcom,mdss-dsi-panel-type = "dsi_cmd_mode";
				qcom,mdss-dsi-panel-width = <0x2d0>;
				qcom,mdss-dsi-post-init-delay = <0x01>;
				qcom,mdss-dsi-reset-sequence = <0x01 0x0a 0x00 0x0a 0x01 0x0a>;
				qcom,mdss-dsi-stream = <0x00>;
				qcom,mdss-dsi-t-clk-post = <0x04>;
				qcom,mdss-dsi-t-clk-pre = <0x1b>;
				qcom,mdss-dsi-te-check-enable;
				qcom,mdss-dsi-te-dcs-command = <0x01>;
				qcom,mdss-dsi-te-pin-select = <0x01>;
				qcom,mdss-dsi-te-using-te-pin;
				qcom,mdss-dsi-traffic-mode = "burst_mode";
				qcom,mdss-dsi-tx-eot-append;
				qcom,mdss-dsi-underflow-color = <0xff>;
				qcom,mdss-dsi-v-back-porch = <0x20>;
				qcom,mdss-dsi-v-bottom-border = <0x00>;
				qcom,mdss-dsi-v-front-porch = <0x20>;
				qcom,mdss-dsi-v-pulse-width = <0x02>;
				qcom,mdss-dsi-v-top-border = <0x00>;
				qcom,mdss-dsi-virtual-channel-id = <0x00>;
				qcom,mdss-dsi-wr-mem-continue = <0x3c>;
				qcom,mdss-dsi-wr-mem-start = <0x2c>;
				qcom,panel-roi-alignment = <0x02 0x02 0x02 0x02 0x02 0x02>;
				qcom,panel-supply-entries = <0x06>;
				qcom,partial-update-enabled;
				qcom,ulps-enabled;
			};
		};
	};

	fragment@9 {
		target = <0xffffffff>;

		__overlay__ {

			qcom,mdss_dsi_r69006_1080p_cmd {
				phandle = <0x0e>;
				qcom,mdss-dsi-bl-max-level = <0xfff>;
				qcom,mdss-dsi-bl-min-level = <0x01>;
				qcom,mdss-dsi-bl-pmic-control-type = "bl_ctrl_wled";
				qcom,mdss-dsi-bllp-eof-power-mode;
				qcom,mdss-dsi-bllp-power-mode;
				qcom,mdss-dsi-border-color = <0x00>;
				qcom,mdss-dsi-bpp = <0x18>;
				qcom,mdss-dsi-dma-trigger = "trigger_sw";
				qcom,mdss-dsi-h-back-porch = <0x52>;
				qcom,mdss-dsi-h-front-porch = <0x64>;
				qcom,mdss-dsi-h-left-border = <0x00>;
				qcom,mdss-dsi-h-pulse-width = <0x14>;
				qcom,mdss-dsi-h-right-border = <0x00>;
				qcom,mdss-dsi-h-sync-skew = <0x00>;
				qcom,mdss-dsi-lane-0-state;
				qcom,mdss-dsi-lane-1-state;
				qcom,mdss-dsi-lane-2-state;
				qcom,mdss-dsi-lane-3-state;
				qcom,mdss-dsi-mdp-trigger = "none";
				qcom,mdss-dsi-off-command = [05 01 00 00 0a 00 02 28 00 29 01 00 00 00 00 1d d3 13 3b bb a5 a5 33 33 33 00 80 a4 a8 37 33 33 33 33 f7 f2 1f 7d 7c ff 0f 99 00 ff ff 05 01 00 00 5a 00 02 10 00];
				qcom,mdss-dsi-off-command-state = "dsi_hs_mode";
				qcom,mdss-dsi-on-command = [23 01 00 00 00 00 02 b0 00 29 01 00 00 00 00 06 b3 04 10 00 00 00 29 01 00 00 00 00 03 b4 0c 00 29 01 00 00 00 00 04 b6 3b d3 00 23 01 00 00 00 00 02 c0 00 15 01 00 00 00 00 02 36 98 23 01 00 00 00 00 02 cc 04 29 01 00 00 00 00 20 c1 84 00 10 ef 8b f1 ff ff df 9c c5 9a 73 8d ad 63 fe ff ff cb f8 01 00 aa 40 02 c2 01 08 00 01 29 01 00 00 00 00 0a cb 0d fe 1f 2c 00 00 00 00 00 29 01 00 00 00 00 0b c2 01 f7 80 04 63 00 60 00 01 30 29 01 00 00 00 00 07 c3 55 01 00 01 00 00 29 01 00 00 00 00 12 c4 70 00 00 00 00 00 00 00 00 02 01 00 05 01 00 00 00 29 01 00 00 00 00 0f c6 57 07 4a 07 4a 01 0e 01 02 01 02 09 15 07 29 01 00 00 00 00 1f c7 00 06 0c 16 27 35 3f 4d 33 3c 49 5b 64 66 67 00 06 0c 16 27 35 3f 4d 33 3c 49 5b 64 66 67 29 01 00 00 00 00 14 c8 00 00 fe 01 08 e7 00 00 fd 02 03 a8 00 00 fc e7 e9 c9 00 29 01 00 00 00 00 09 c9 1f 68 1f 68 4c 4c c4 11 29 01 00 00 00 00 11 d0 11 01 91 0b d9 19 19 00 00 00 19 99 00 00 00 00 29 01 00 00 00 00 1d d3 1b 3b bb ad a5 33 33 33 00 80 ad a8 37 33 33 33 33 f7 f2 1f 7d 7c ff 0f 99 00 ff ff 29 01 00 00 00 00 04 d4 57 33 03 29 01 00 00 00 00 0c d5 66 00 00 01 32 01 32 00 0b 00 0b 29 01 00 00 00 00 02 be 04 29 01 00 00 00 00 11 cf 40 10 00 00 00 00 32 00 00 00 00 00 00 00 00 00 29 01 00 00 00 00 06 de 00 00 3f ff 10 29 01 00 00 00 00 02 e9 00 29 01 00 00 00 00 02 f2 00 23 01 00 00 00 00 02 d6 01 39 01 00 00 00 00 02 35 00 39 01 00 00 00 00 02 51 ff 39 01 00 00 00 00 02 53 2c 39 01 00 00 00 00 02 55 00 05 01 00 00 78 00 02 11 00 05 01 00 00 14 00 02 29 00];
				qcom,mdss-dsi-on-command-state = "dsi_lp_mode";
				qcom,mdss-dsi-panel-framerate = <0x3c>;
				qcom,mdss-dsi-panel-height = <0x780>;
				qcom,mdss-dsi-panel-max-error-count = <0x03>;
				qcom,mdss-dsi-panel-name = "r69006 1080p cmd mode dsi panel";
				qcom,mdss-dsi-panel-status-check-mode = "reg_read";
				qcom,mdss-dsi-panel-status-command = <0x6010001 0x500010a>;
				qcom,mdss-dsi-panel-status-command-mode = "dsi_lp_mode";
				qcom,mdss-dsi-panel-status-read-length = <0x01>;
				qcom,mdss-dsi-panel-status-value = <0x1c>;
				qcom,mdss-dsi-panel-timings = <0x6e3f3600 0x5a4f3841 0x54030400>;
				qcom,mdss-dsi-panel-type = "dsi_cmd_mode";
				qcom,mdss-dsi-panel-width = <0x438>;
				qcom,mdss-dsi-reset-sequence = <0x01 0x0a 0x00 0x0a 0x01 0x0a>;
				qcom,mdss-dsi-rx-eot-ignore;
				qcom,mdss-dsi-stream = <0x00>;
				qcom,mdss-dsi-t-clk-post = <0x1e>;
				qcom,mdss-dsi-t-clk-pre = <0x30>;
				qcom,mdss-dsi-te-check-enable;
				qcom,mdss-dsi-te-dcs-command = <0x01>;
				qcom,mdss-dsi-te-pin-select = <0x01>;
				qcom,mdss-dsi-te-using-te-pin;
				qcom,mdss-dsi-traffic-mode = "burst_mode";
				qcom,mdss-dsi-tx-eot-append;
				qcom,mdss-dsi-underflow-color = <0xff>;
				qcom,mdss-dsi-v-back-porch = <0x09>;
				qcom,mdss-dsi-v-bottom-border = <0x00>;
				qcom,mdss-dsi-v-front-porch = <0x03>;
				qcom,mdss-dsi-v-pulse-width = <0x0f>;
				qcom,mdss-dsi-v-top-border = <0x00>;
				qcom,mdss-dsi-virtual-channel-id = <0x00>;
				qcom,mdss-dsi-wr-mem-continue = <0x3c>;
				qcom,mdss-dsi-wr-mem-start = <0x2c>;
			};
		};
	};
};
